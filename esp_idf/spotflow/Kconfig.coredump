## esp_idf/spotflow/device_sdk/test/example/unit_test/test/sdkconfig.defaults
```kconfig
CONFIG_ESP_TASK_WDT_EN=n
CONFIG_SPOTFLOW_DEBUG_MESSAGE_TERMINAL=y
CONFIG_SPOTFLOW_DEVICE_ID="qemu"
CONFIG_SPOTFLOW_INGEST_KEY=""
CONFIG_LOG_MAXIMUM_EQUALS_DEFAULT=n
CONFIG_LOG_MAXIMUM_LEVEL_DEBUG=y
CONFIG_EXAMPLE_CONNECT_ETHERNET=y
CONFIG_EXAMPLE_CONNECT_WIFI=n
CONFIG_EXAMPLE_USE_OPENETH=y
CONFIG_EXAMPLE_CONNECT_IPV6=n
```

## esp_idf/spotflow/examples/Coredump/sdkconfig.defaults
```kconfig
CONFIG_SPOTFLOW_COREDUMP_BACKEND=y
CONFIG_SPOTFLOW_GENERATE_BUILD_ID=y
CONFIG_SPOTFLOW_DEBUG_MESSAGE_TERMINAL=y
```

## esp_idf/spotflow/examples/coredump/sdkconfig.defaults
```kconfig
CONFIG_SPOTFLOW_COREDUMP_BACKEND=y
CONFIG_SPOTFLOW_USE_BUILD_ID=y
CONFIG_SPOTFLOW_DEBUG_MESSAGE_TERMINAL=y
CONFIG_EXAMPLE_WIFI_SSID=""
CONFIG_EXAMPLE_WIFI_PASSWORD=""
CONFIG_SPOTFLOW_DEVICE_ID=""
CONFIG_SPOTFLOW_INGEST_KEY=""
CONFIG_PARTITION_TABLE_CUSTOM=y
CONFIG_PARTITION_TABLE_CUSTOM_FILENAME="partitions.csv"
CONFIG_PARTITION_TABLE_FILENAME="partitions.csv"
CONFIG_LOG_MAXIMUM_EQUALS_DEFAULT=n
CONFIG_LOG_MAXIMUM_LEVEL_DEBUG=y
```

## esp_idf/spotflow/examples/logs/sdkconfig.defaults
```kconfig
CONFIG_SPOTFLOW_DEBUG_MESSAGE_TERMINAL=y
CONFIG_EXAMPLE_WIFI_SSID=""
CONFIG_EXAMPLE_WIFI_PASSWORD=""
CONFIG_SPOTFLOW_DEVICE_ID=""
CONFIG_SPOTFLOW_INGEST_KEY=""
```

## zephyr/Kconfig
```kconfig
menuconfig SPOTFLOW
	bool "Enable Spotflow Observability"
	default n
	select HWINFO
	select ZCBOR
	help
		Enables Zephyr integration with Spotflow observability platform.

if SPOTFLOW

rsource "src/net/Kconfig"

rsource "src/logging/KConfig"
rsource "src/coredumps/KConfig"
rsource "src/metrics/Kconfig"
rsource "src/metrics/system/Kconfig"


config SPOTFLOW_GENERATE_BUILD_ID
	bool "Generate build ID"
	default y
	# Use binary descriptors when possible
	select BINDESC if ARCH_SUPPORTS_ROM_START || ARCH_POSIX
	select BINDESC_DEFINE if ARCH_SUPPORTS_ROM_START || ARCH_POSIX
	help
		Generate build ID and embed it as a binary descriptor.
		Build ID allows to match core dumps with the original .elf file.

configdefault MBEDTLS_SSL_MAX_CONTENT_LEN
	default 4608 if SPOTFLOW

if NRF_SECURITY
configdefault MBEDTLS_MPI_MAX_SIZE
	int
	default 512 if SPOTFLOW
endif #NRF_SECURITY

configdefault ZVFS_OPEN_MAX
	default 32 if SPOTFLOW

# It's generally better to use a separate heap for mbedtls so that
# there is a dedicated heap for TLS operations without fragmentation.
# Skipped when nRF Security is used, as the default of MBEDTLS_HEAP_SIZE
# doesn't propagate correctly, leading to TLS handshake failures.
configdefault MBEDTLS_ENABLE_HEAP
	default y if SPOTFLOW && !NRF_SECURITY

if MBEDTLS_ENABLE_HEAP
# Needed to be able to verify the whole Let's Encrypt certificate chain
configdefault MBEDTLS_HEAP_SIZE
	default 36864
endif # MBEDTLS_ENABLE_HEAP

config SPOTFLOW_DEVICE_ID
	string "Device ID device will use to connect to Spotflow observability platform"
	help
		Device ID is a unique identifier for your device in Spotflow observability
		platform. If empty, the hexadecimal representation of the result of
		hwinfo_get_device_id(...) will be used. You can provide the device ID
		in the code by defining the function char* spotflow_override_device_id().
config SPOTFLOW_MODULE_DEFAULT_LOG_LEVEL
	int "Spotflow SDK backend level"
	default LOG_DEFAULT_LEVEL
	range 0 4
	help
		Sets default log level for all Spotflow components.
		Not the overall log levels.
		Defaults to 2 (WARNING).
		Levels are:
		- 0 OFF, do not write
		- 1 ERROR, only write LOG_ERR
		- 2 WARNING, write LOG_WRN in addition to previous level
		- 3 INFO, write LOG_INF in addition to previous level
		- 4 DEBUG, write LOG_DBG in addition to previous level

config SPOTFLOW_PROCESSING_THREAD_CUSTOM_PRIORITY
	bool "Use custom priority for Spotflow processing thread"
	default n
	help
		Enable this option to use a custom priority for the Spotflow processing thread.
		The same priority is also used for the thread preparing coredumps.
		If disabled, the thread will use default K_LOWEST_APPLICATION_THREAD_PRIO.

config SPOTFLOW_PROCESSING_THREAD_PRIORITY
	int "Spotflow processing thread priority"
	default 14
	depends on SPOTFLOW_PROCESSING_THREAD_CUSTOM_PRIORITY
	help
		Priority of the Spotflow processing thread.
		To take effect, you need to enable SPOTFLOW_PROCESSING_THREAD_CUSTOM_PRIORITY.
		Increase this value if you experience issues with logs being sent.

config SPOTFLOW_PROCESSING_THREAD_STACK_SIZE
	int "Size of Spotflow processing thread stack"
	default 4608 if DEBUG_OPTIMIZATIONS
	default 4096
	help
		Size of the stack used by the Spotflow processing thread.
		Increase this value if you experience issues with logs/tls handshake.

config SPOTFLOW_SETTINGS
	bool "Enable persistence of Spotflow configuration using Zephyr settings subsystem"
	default y
	depends on SETTINGS
	help
		Enable this option to persist Spotflow configuration using Zephyr settings subsystem.
		If disabled, the configuration set from the cloud will be lost after reboot and loaded
		only after the connection to the cloud is established.

endif #SPOTFLOW
```

## zephyr/samples/coredumps/boards/nrf7002dk_nrf5340_cpuapp_ns.conf
```kconfig
# This value isn't propagated from Spotflow Kconfig on Nordic boards, so it must be set manually
# (necessary to validate the MQTT broker certificate)
CONFIG_MBEDTLS_MPI_MAX_SIZE=512
```

## zephyr/samples/coredumps/boards/rpi_pico_rp2040_w.conf
```kconfig
# No hardware random number generator is available on this board
CONFIG_TEST_RANDOM_GENERATOR=y

# Increased TLS connection timeout
CONFIG_NET_SOCKETS_CONNECT_TIMEOUT=6000

# This board has no default storage partition, skipping configuration persistence
CONFIG_NVS=n
CONFIG_SETTINGS=n
CONFIG_SETTINGS_NVS=n
```

## zephyr/samples/logs/boards/frdm_rw612.conf
```kconfig
# These configs are automatically enabled for FRDM-RW612 board from kconfig
#WIFI_NXP
#NXP_WIFI_TX_RX_ZERO_COPY
#NET_IF_MAX_IPV4_COUNT=2

# Fix buffer size for RW612 on Zephyr 4.1.0+
CONFIG_NET_BUF_DATA_SIZE=256

CONFIG_NXP_WIFI_SOFTAP_SUPPORT=n
```

## zephyr/samples/logs/boards/imx95_evk_mimx9596_a55.conf
```kconfig
# No hardware random number generator is available on this board
# TODO: Check if that's true (e.g., try enabling in devicetree)
CONFIG_TEST_RANDOM_GENERATOR=y
```

## zephyr/samples/logs/boards/rpi_pico_rp2040_w.conf
```kconfig
# No hardware random number generator is available on this board
CONFIG_TEST_RANDOM_GENERATOR=y

# Increased TLS connection timeout
CONFIG_NET_SOCKETS_CONNECT_TIMEOUT=6000

# This board has no default storage partition, skipping configuration persistence
CONFIG_SPOTFLOW_SAMPLE_CONFIG_PERSISTENCE_FLASH=n
```

## zephyr/samples/logs/boards/stm32f469i_disco.conf
```kconfig
# No hardware random number generator is available on this board by default, it might be necessary
# to enable it in the devicetree or add an external one
CONFIG_TEST_RANDOM_GENERATOR=y
```

## zephyr/samples/metrics/boards/rpi_pico_rp2040_w.conf
```kconfig
# No hardware random number generator is available on this board
CONFIG_TEST_RANDOM_GENERATOR=y

# Increased TLS connection timeout
CONFIG_NET_SOCKETS_CONNECT_TIMEOUT=6000
```
