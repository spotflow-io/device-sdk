## esp_idf/spotflow/Kconfig.coredump
```kconfig
menu "Spotflow Core Dump Settings"

        # Enable ESP-IDF core dump
        config SPOTFLOW_COREDUMP_BACKEND
            bool "Enable core dump"
            default n
            select ESP_COREDUMP_DATA_FORMAT_ELF
            imply ESP_COREDUMP_CAPTURE_DRAM

        if SPOTFLOW_COREDUMP_BACKEND

            choice ESP_COREDUMP_TO_FLASH_OR_UART
                default ESP_COREDUMP_ENABLE_TO_FLASH
            endchoice

            config SPOTFLOW_COREDUMPS_CHUNK_SIZE
                int "Coredump Chunk Size"
                default 2048
                help
                    Coredump chunk size while uploading to cloud. 
                    Bigger size means less chunks and quick uploads. 
                    But with bigger chunks more memory buffer is used for preparing and sending
                    each one via MQTT.

            config SPOTFLOW_MAX_QUEUE_SIZE
                int "Coredump Max Queue size"
                default 2
                help
                    Maximum number of coredump chunks saved in the queue before sending.
                    Memory usage is SPOTFLOW_MAX_QUEUE_SIZE*SPOTFLOW_COREDUMP_CHUNK_SIZE.

        endif

endmenu
```

## esp_idf/spotflow/Kconfig.projbuild
```kconfig
menu "Spotflow"

    config SPOTFLOW_SERVER_HOSTNAME
        string "Hostname of Spotflow observability platform"
        default "mqtts://mqtt.spotflow.io:8883"
        help
            URL of an mqtt broker which Spotflow connects to.

    config SPOTFLOW_DEVICE_ID
        string "Device ID device will use to connect to Spotflow observability platform"
        help
            Device ID is a unique identifier for your device in Spotflow observability
            platform. If empty, the Device MAC Address will be used. Keep it less than 32 characters.

    config SPOTFLOW_INGEST_KEY
        string "Password device will use to connect to Spotflow observability platform"
        help
            Ingest key is a secret key used to authenticate your device
            It can be found in Spotflow observability platform

    config BROKER_CERTIFICATE_OVERRIDE
        string "Broker certificate override"
        default ""
        help
            Please leave empty if broker certificate included from a textfile; otherwise fill in a base64 part of PEM
            format certificate

    config BROKER_CERTIFICATE_OVERRIDDEN
        bool
        default y if BROKER_CERTIFICATE_OVERRIDE != ""

    choice SPOTFLOW_INTERNAL_LOGS
        prompt "Set log level of spotflow internal logs"
        default SPOTFLOW_INTERNAL_LOGS_DISABLED
        help
            Select the log level for spotflow to display.
            - "Debug" : Display all logs debug and others.
            - "logs"  : Only display info logs
            - "Disabled" : Disable the spotflow component logs.
        config SPOTFLOW_DEBUG_MESSAGE_TERMINAL
            bool "Debug"

        config SPOTFLOW_MESSAGE_TERMINAL
            bool "logs"
        
        config SPOTFLOW_INTERNAL_LOGS_DISABLED
            bool "Disabled"

    endchoice

    rsource "./Kconfig.buildid"
    rsource "./Kconfig.logging"
    rsource "./Kconfig.configs"
    rsource "./Kconfig.coredump"

endmenu
```

## esp_idf/spotflow/device_sdk/Kconfig.buildid
```kconfig
config SPOTFLOW_USE_BUILD_ID
	bool "Use build ID"
	default y
	help
		Build ID allows to match core dumps with the original .elf file.
```

## esp_idf/spotflow/device_sdk/Kconfig.configs
```kconfig
menu "Spotflow cloud log level configuration"
    config SPOTFLOW_DEFAULT_SENT_LOG_LEVEL
        int "Spotflow default sent log level"
        default 3
        range 0 4
        help
            Filters the logs sent to Spotflow cloud according to their severity level.
            This is the default value that can be dynamically overridden from the cloud.
            Levels are:
            - 0 OFF, do not send any logs
            - 1 ERROR, send ESP_LOGE
            - 2 WARNING, send ESP_LOGW in addition to previous level
            - 3 INFO, send ESP_LOGI in addition to previous level
            - 4 DEBUG, send ESP_LOGD in addition to previous level

    config SPOTFLOW_LOG_BACKEND_SET_RUNTIME_FILTERING
        bool "To set the cloud received logs using esp_set_log_level() for all log instances."
        default n

    config SPOTFLOW_ERASE_NVS_FLASH
        bool "To try to erase and initialize the nvs again if the log savings fails."
        default n

endmenu
```

## esp_idf/spotflow/device_sdk/Kconfig.logging
```kconfig
menu "Spotflow log menu"
	    config SPOTFLOW_LOG_BACKEND
	    bool "Spotflow logging backend"
	    default y
	    depends on LOG_VERSION_1
	    help
	        Enable sending logs to Spotflow cloud. This backend requires ESP-IDF Log V1
	        because it parses the combined log prefix from the vprintf hook.

    config SPOTFLOW_LOG_BUFFER_SIZE
        int "Size of Spotflow log buffer"
        default 512
        help
            Size of the buffer used by Spotflow logging backend to store logs before serialization.
            Make this at least as big as your longest expected log line.
            Increase this value if you experience issues with logs being dropped because of buffer overflow.

    config SPOTFLOW_CBOR_LOG_MAX_LEN
        int "Size of Spotflow CBOR log buffer"
        default 1024
        help
            Size of the buffer used by Spotflow logging backend to serialize the logs to CBOR format.
            Increase this value if you experience issues with logs being dropped because of buffer overflow.

    config SPOTFLOW_MESSAGE_QUEUE_SIZE
        int "Number of messages to retain in case of disconnection"
        default 5

    
endmenu
```

## esp_idf/spotflow/device_sdk/Kconfig.metrics
```kconfig
menuconfig SPOTFLOW_METRICS
	bool "Enable Spotflow metrics collection and reporting"
	default n
	help
	  Enable metrics collection and reporting feature for the Spotflow SDK.
	  Allows devices to collect, aggregate, and transmit metrics to the cloud.

    if SPOTFLOW_METRICS
        config SPOTFLOW_METRICS_QUEUE_SIZE
            int "Metrics message queue size"
            range 4 128
            default 64 if SPOTFLOW_METRICS_SYSTEM
            default 16
            help
                Maximum number of encoded metric messages buffered before transmission.
                Messages are dropped if queue is full. Default 64 when system metrics
                are enabled (to handle burst from multiple time series), otherwise 16.

        config SPOTFLOW_METRICS_CBOR_BUFFER_SIZE
            int "CBOR encoding buffer size (bytes)"
            range 256 2048
            default 512
            help
                Size of buffer for CBOR encoding.
                Must be large enough for the largest metric message.
                Default 512 bytes is sufficient for most use cases.

        config SPOTFLOW_METRICS_MAX_REGISTERED
            int "Maximum number of registered metrics"
            range 1 128
            default 32
            help
                Maximum number of metrics that can be registered simultaneously.
                Each metric consumes heap memory for aggregation context and time series storage.

        config SPOTFLOW_METRICS_DEFAULT_AGGREGATION_INTERVAL
            int "Default aggregation interval (seconds)"
            default 60
            help
                Default aggregation period for metrics registered without explicit interval.
                Allowed values: 0, 60, 3600, 86400 (validated at build time).
                0 = PT0S (no aggregation, immediate - not recommended for production)
                60 = PT1M (1 minute, recommended default)
                3600 = PT1H (1 hour)
                86400 = P1D (1 day)

        config SPOTFLOW_METRICS_MAX_LABELS_PER_METRIC
            int "Maximum labels per metric"
            range 1 8
            default 4
            help
                Maximum number of label key-value pairs per metric report.
                Affects memory consumption per time series (~48 bytes per label).
                System metrics use only 1 label, so default of 4 is sufficient
                for most use cases.

        config SPOTFLOW_METRICS_HEARTBEAT
            bool "Enable device heartbeat"
            default y
            help
                Send periodic heartbeat messages with device uptime.
                Heartbeats have higher priority than regular metrics.

        config SPOTFLOW_METRICS_HEARTBEAT_INTERVAL
            int "Heartbeat interval (seconds)"
            depends on SPOTFLOW_METRICS_HEARTBEAT
            default 60
            range 10 3600
            help
                How often to send heartbeat messages.

    endif # SPOTFLOW_METRICS
rsource "./Kconfig.metrics_systems"
```

## esp_idf/spotflow/device_sdk/Kconfig.metrics_systems
```kconfig
menuconfig SPOTFLOW_METRICS_SYSTEM
	bool "Enable Spotflow system metrics auto-collection"
	default y
	help
	  Enable automatic collection of system-level metrics (memory, network, CPU, etc.).
	  These metrics are collected periodically and reported to the cloud without
	  requiring any application code.

if SPOTFLOW_METRICS_SYSTEM
config SPOTFLOW_METRICS_SYSTEM_HEAP
	bool "Enable heap metrics"
	default y
	help
	  Collect heap memory statistics (free/allocated bytes).

config SPOTFLOW_METRICS_SYSTEM_NETWORK
	bool "Enable network metrics"
	select LWIP_STATS
	default y
	help
	  Collect network traffic statistics (TX/RX bytes).

if SPOTFLOW_METRICS_SYSTEM_NETWORK

config SPOTFLOW_METRICS_SYSTEM_NETWORK_MAX_INTERFACES
	int "Maximum number of network interfaces to track"
	range 1 16
	default 4
	help
	  Maximum number of network interfaces for metrics collection.
	  Each interface is tracked with separate TX/RX metrics.

endif # SPOTFLOW_METRICS_SYSTEM_NETWORK

config SPOTFLOW_METRICS_SYSTEM_CPU
	bool "Enable CPU utilization metrics"
	select FREERTOS_USE_STATS_FORMATTING_FUNCTIONS
	select FREERTOS_GENERATE_RUN_TIME_STATS
	default y
	help
	  Collect CPU utilization percentage.

config SPOTFLOW_METRICS_SYSTEM_CONNECTION
	bool "Enable connection state metrics"
	default y
	help
	  Report MQTT connection state changes (connected=1, disconnected=0).
	  Event-driven metric (not periodic).

config SPOTFLOW_METRICS_SYSTEM_RESET_CAUSE
	bool "Enable reset cause metric"
	default y
	help
	  Report device reset cause on boot (power-on, watchdog, etc.).
	  Event-driven metric (reported once on boot, not periodic).

config SPOTFLOW_METRICS_SYSTEM_STACK
	bool "Enable thread stack metrics"
	select FREERTOS_USE_TRACE_FACILITY
	select FREERTOS_SUPPORT_STATIC_ALLOCATION
	default y
	help
	  Collect thread stack usage statistics (free bytes per thread).
	  Requires FREERTOS_USE_TRACE_FACILITY and FREERTOS_SUPPORT_STATIC_ALLOCATION to be enabled.

if SPOTFLOW_METRICS_SYSTEM_STACK

config SPOTFLOW_METRICS_SYSTEM_STACK_ALL_THREADS
	bool "Automatically track all threads"
	default y
	help
	  Automatically collect stack metrics for all threads in the system.

config SPOTFLOW_METRICS_SYSTEM_STACK_MAX_THREADS
	int "Maximum number of tracked threads"
	range 1 128
	default 32
	help
	  Maximum number of threads for stack metrics.
	  This sets the max time series allocated for the metric.
	  When automatic tracking is disabled, also limits the
	  number of threads that can be manually registered.

endif # SPOTFLOW_METRICS_SYSTEM_STACK

config SPOTFLOW_METRICS_SYSTEM_COLLECTION_INTERVAL
	int "System metrics collection interval (seconds)"
	default 10
	range 1 360
	help
	  How often to sample system metrics (memory, CPU, network, etc.).
	  Valid range: 1-360 seconds.
	  Lower values increase CPU overhead but provide finer granularity.

config SPOTFLOW_METRICS_SYSTEM_AGGREGATION_INTERVAL
	int "System metrics aggregation interval (seconds)"
	default 60
	help
	  Aggregation window for system metrics before sending to cloud.
	  Allowed values: 0, 60, 3600, 86400 (validated at build time).
	  0 = PT0S (no aggregation - send each sample immediately)
	  60 = PT1M (1 minute aggregation window)
	  3600 = PT1H (1 hour aggregation window)
	  86400 = P1D (1 day aggregation window)

	  With PT0S, each collection produces a separate message.
	  With aggregation, samples within the window are combined (min/max/sum/count).

endif # SPOTFLOW_METRICS_SYSTEM
```

## esp_idf/spotflow/device_sdk/Kconfig.projbuild
```kconfig
menu "Spotflow"
    config SPOTFLOW_MQTT_TASK_PRIORITY
        int "Task priority for MQTT tasks to send logs, coredump and other logs data to cloud"
        default 6
        help
            Lower values indicate lower priority, with 0 being the lowest.
    	    A medium to high priority is recommended to ensure timely data delivery.

    config SPOTFLOW_SERVER_HOSTNAME
        string "Hostname of Spotflow observability platform"
        default "mqtts://mqtt.spotflow.io:8883"
        help
            URL of an mqtt broker which Spotflow connects to.

    config SPOTFLOW_DEVICE_ID
        string "Device ID device will use to connect to Spotflow observability platform"
        help
            Device ID is a unique identifier for your device in Spotflow observability
            platform. If empty, the Device MAC Address will be used. Keep it less than 32 characters.

    config SPOTFLOW_INGEST_KEY
        string "Password device will use to connect to Spotflow observability platform"
        help
            Ingest key is a secret key used to authenticate your device
            It can be found in Spotflow observability platform

    config BROKER_CERTIFICATE_OVERRIDE
        string "Broker certificate override"
        default ""
        help
            Please leave empty if broker certificate included from a textfile; otherwise fill in a base64 part of PEM
            format certificate

    config BROKER_CERTIFICATE_OVERRIDDEN
        bool
        default y if BROKER_CERTIFICATE_OVERRIDE != ""
        help
            This option is automatically set when BROKER_CERTIFICATE_OVERRIDE is filled in. It indicates that the broker certificate is provided directly in the configuration.

    config SPOTFLOW_MQTT_TASK_SIZE
        int "MQTT Task Stack Size"
        default 3096
        help
          MQTT task size. Calculated as 2x CONFIG_SPOTFLOW_CBOR_LOG_MAX_LEN.

    choice SPOTFLOW_INTERNAL_LOGS
        prompt "Set log level of spotflow internal logs"
        default SPOTFLOW_INTERNAL_LOGS_DISABLED
        help
            Select the log level for spotflow to display.
            - "Debug" : Display all logs debug and others.
            - "logs"  : Only display info logs
            - "Disabled" : Disable the spotflow component logs.
        config SPOTFLOW_DEBUG_MESSAGE_TERMINAL
            bool "Debug"

        config SPOTFLOW_MESSAGE_TERMINAL
            bool "logs"

        config SPOTFLOW_INTERNAL_LOGS_DISABLED
            bool "Disabled"

    endchoice

    rsource "./Kconfig.buildid"
    rsource "./Kconfig.logging"
    rsource "./Kconfig.configs"
    rsource "./Kconfig.coredump"
    rsource "./Kconfig.metrics"

endmenu
```

## esp_idf/spotflow/device_sdk/examples/metrics/sdkconfig.defaults
```kconfig
CONFIG_SPOTFLOW_DEVICE_ID="qemu"
CONFIG_SPOTFLOW_INGEST_KEY="sf_ikv1_KX68PsFr2f950XZplnRXRE100_zPeTB5x4vp2xAGM1rLlBA7l4oYqfn6pV0axxGnD36IG5"
CONFIG_SPOTFLOW_DEBUG_MESSAGE_TERMINAL=y
CONFIG_EXAMPLE_CONNECT_ETHERNET=y
CONFIG_EXAMPLE_CONNECT_WIFI=n
CONFIG_EXAMPLE_USE_OPENETH=y
CONFIG_EXAMPLE_CONNECT_IPV6=n
CONFIG_LOG_MAXIMUM_LEVEL_DEBUG=y
CONFIG_LOG_MAXIMUM_EQUALS_DEFAULT=n
CONFIG_SPOTFLOW_METRICS=y
CONFIG_SPOTFLOW_METRICS_SYSTEM=y
```

## esp_idf/spotflow/device_sdk/examples/unit_test/test/sdkconfig.defaults
```kconfig
CONFIG_ESP_TASK_WDT_EN=n
CONFIG_SPOTFLOW_DEBUG_MESSAGE_TERMINAL=y
CONFIG_EXAMPLE_WIFI_SSID=""
CONFIG_EXAMPLE_WIFI_PASSWORD=""
CONFIG_SPOTFLOW_DEVICE_ID=""
CONFIG_SPOTFLOW_INGEST_KEY=""
CONFIG_LOG_MAXIMUM_EQUALS_DEFAULT=n
CONFIG_LOG_MAXIMUM_LEVEL_DEBUG=y
```
