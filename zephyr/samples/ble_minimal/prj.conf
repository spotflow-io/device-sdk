## CMakeLists.txt
```
cmake_minimum_required(VERSION 3.20.0)

find_package(Zephyr REQUIRED HINTS $ENV{ZEPHYR_BASE})
project(spotflow_ble_minimal)

target_sources(app PRIVATE src/main.c)
```

## prj.conf
```kconfig
CONFIG_SPOTFLOW=y
CONFIG_SPOTFLOW_TRANSPORT_BLE=y
CONFIG_SPOTFLOW_TELEMETRY_BACKEND_MINIMAL=y
CONFIG_SPOTFLOW_LOG_BACKEND=y
CONFIG_SPOTFLOW_COREDUMPS=y

CONFIG_SPOTFLOW_METRICS=y
CONFIG_SPOTFLOW_METRICS_HEARTBEAT=y
CONFIG_SPOTFLOW_METRICS_SYSTEM=y
CONFIG_SPOTFLOW_METRICS_SYSTEM_HEAP=y
CONFIG_SPOTFLOW_METRICS_SYSTEM_CPU=n
CONFIG_SPOTFLOW_METRICS_SYSTEM_NETWORK=n
CONFIG_SPOTFLOW_METRICS_SYSTEM_CONNECTION=y
CONFIG_SPOTFLOW_METRICS_SYSTEM_RESET_CAUSE=y
CONFIG_SPOTFLOW_METRICS_SYSTEM_STACK=y
CONFIG_SPOTFLOW_METRICS_SYSTEM_STACK_ALL_THREADS=n

CONFIG_BT=y
CONFIG_BT_PERIPHERAL=y
CONFIG_BT_DEVICE_APPEARANCE=0

CONFIG_GPIO=y
CONFIG_LOG=y
CONFIG_LOG_BACKEND_UART=y
CONFIG_PRINTK=y
CONFIG_CONSOLE=y
CONFIG_UART_CONSOLE=y
```

## boards/lp_em_cc2340r5.conf
```kconfig
CONFIG_BT_DEVICE_NAME="Spotflow TI Minimal"
CONFIG_SPOTFLOW_DEVICE_ID="testing_device_ti_minimal"

CONFIG_SPOTFLOW_SESSION_METADATA_BUFFER_SIZE=64
CONFIG_SPOTFLOW_TELEMETRY_CBOR_BUFFER_SIZE=256
CONFIG_SPOTFLOW_METRICS_MAX_REGISTERED=9
CONFIG_SPOTFLOW_METRICS_MAX_TIMESERIES=9
CONFIG_SPOTFLOW_METRICS_MAX_NAME_LENGTH=32
CONFIG_SPOTFLOW_METRICS_MAX_LABELS_PER_METRIC=1
CONFIG_SPOTFLOW_METRICS_SYSTEM_STACK_MAX_THREADS=1
CONFIG_SPOTFLOW_METRICS_SYSTEM_COLLECTION_INTERVAL=30
CONFIG_SPOTFLOW_METRICS_SYSTEM_AGGREGATION_INTERVAL=60
CONFIG_SPOTFLOW_METRICS_HEARTBEAT_INTERVAL=60

CONFIG_SPOTFLOW_SETTINGS=n
CONFIG_SPOTFLOW_COREDUMPS_REBOOT_WARM=y
CONFIG_DEBUG_COREDUMP_MEMORY_DUMP_MIN=y
CONFIG_SPOTFLOW_COREDUMPS_CHUNK_SIZE=128

CONFIG_ENTROPY_GENERATOR=y
CONFIG_MBEDTLS=n
CONFIG_CTR_DRBG_CSPRNG_GENERATOR=y
CONFIG_ENTROPY_CC23X0_NOISE_INPUT_WORD_LENGTH=256
CONFIG_ENTROPY_CC23X0_ENTROPY_BYTE_LENGTH=64

# The entropy driver temporarily allocates 1024 bytes at startup. Telemetry does
# not allocate from this heap; lower this only after measuring allocator overhead.
CONFIG_HEAP_MEM_POOL_SIZE=1536
CONFIG_HEAP_MEM_POOL_IGNORE_MIN=y

CONFIG_BT_HOST_CRYPTO_PRNG=n

CONFIG_LOG_MODE_DEFERRED=y
CONFIG_LOG_DEFAULT_LEVEL=3
CONFIG_LOG_MAX_LEVEL=3
CONFIG_LOG_BUFFER_SIZE=256
CONFIG_LOG_PROCESS_THREAD_STACK_SIZE=640

CONFIG_MAIN_STACK_SIZE=896
CONFIG_SPOTFLOW_PROCESSING_THREAD_STACK_SIZE=1152

CONFIG_SPOTFLOW_LOG_BACKEND_QUEUE_SIZE=2
CONFIG_SPOTFLOW_LOG_BUFFER_SIZE=96
CONFIG_SPOTFLOW_DEFAULT_SENT_LOG_LEVEL=3
CONFIG_SPOTFLOW_MODULE_DEFAULT_LOG_LEVEL=2
CONFIG_SPOTFLOW_LOGS_PROCESSING_LOG_LEVEL=2
CONFIG_SPOTFLOW_COREDUMPS_PROCESSING_LOG_LEVEL=2

CONFIG_BT_L2CAP_TX_MTU=23
CONFIG_BT_BUF_ACL_TX_SIZE=27
CONFIG_BT_BUF_ACL_RX_SIZE=27
CONFIG_BT_BUF_ACL_TX_COUNT=3
CONFIG_BT_BUF_ACL_RX_COUNT=2
CONFIG_BT_L2CAP_TX_BUF_COUNT=3
CONFIG_BT_ATT_TX_COUNT=3
CONFIG_BT_CONN_TX_MAX=3

CONFIG_BT_SMP=n
CONFIG_BT_GATT_SERVICE_CHANGED=n
CONFIG_BT_GATT_CACHING=n
CONFIG_BT_PHY_UPDATE=n
CONFIG_BT_DATA_LEN_UPDATE=n

CONFIG_BT_BUF_EVT_RX_SIZE=68
CONFIG_BT_BUF_EVT_RX_COUNT=3
CONFIG_BT_BUF_EVT_DISCARDABLE_COUNT=1
CONFIG_BT_BUF_CMD_TX_SIZE=65

CONFIG_THREAD_NAME=n
CONFIG_INIT_STACKS=y
CONFIG_STACK_SENTINEL=y
CONFIG_STACK_USAGE=y
CONFIG_SYSTEM_WORKQUEUE_STACK_SIZE=1280
CONFIG_ISR_STACK_SIZE=1536
```

## boards/lp_em_cc2340r5.overlay
```dts
/delete-node/ &storage_partition;

&flash0 {
	partitions {
		storage_partition: partition@7c000 {
			label = "storage";
			reg = <0x0007c000 0x00001000>;
		};

		coredump_partition: partition@7d000 {
			label = "coredump-partition";
			reg = <0x0007d000 0x00003000>;
		};
	};
};
```

## src/main.c
```c
#include <zephyr/drivers/gpio.h>
#include <zephyr/kernel.h>
#include <zephyr/logging/log.h>
#include <zephyr/random/random.h>

#include "metrics/spotflow_metrics_backend.h"
#include "metrics/spotflow_metrics_registry.h"
#include "metrics/system/spotflow_metrics_system.h"

LOG_MODULE_REGISTER(spotflow_ble_minimal_sample, LOG_LEVEL_INF);

#define SW0_NODE DT_ALIAS(sw0)
#define TELEMETRY_INTERVAL_SECONDS 10

static const struct gpio_dt_spec button = GPIO_DT_SPEC_GET_OR(SW0_NODE, gpios, { 0 });
static struct gpio_callback button_callback_data;
static struct spotflow_metric_int* counter_metric;
static struct spotflow_metric_int* battery_metric;
static struct spotflow_metric_float* acceleration_metric;

static void button_pressed(const struct device* device, struct gpio_callback* callback,
			   uint32_t pins)
{
	ARG_UNUSED(device);
	ARG_UNUSED(callback);
	ARG_UNUSED(pins);
	k_oops();
}

static int initialize_button(void)
{
	if (!gpio_is_ready_dt(&button)) {
		return -ENODEV;
	}

	int rc = gpio_pin_configure_dt(&button, GPIO_INPUT);
	if (rc != 0) {
		return rc;
	}
	rc = gpio_pin_interrupt_configure_dt(&button, GPIO_INT_EDGE_TO_ACTIVE);
	if (rc != 0) {
		return rc;
	}

	gpio_init_callback(&button_callback_data, button_pressed, BIT(button.pin));
	return gpio_add_callback(button.port, &button_callback_data);
}

static void initialize_metrics(void)
{
	(void)spotflow_register_metric_int("sample_counter", SPOTFLOW_AGG_INTERVAL_NONE,
					   &counter_metric);
	(void)spotflow_register_metric_int("battery_level_percent", SPOTFLOW_AGG_INTERVAL_NONE,
					   &battery_metric);
	(void)spotflow_register_metric_float("accelerometer_magnitude_g",
					     SPOTFLOW_AGG_INTERVAL_NONE, &acceleration_metric);

	for (int attempt = 0; attempt < 20; ++attempt) {
		int rc = spotflow_metrics_system_enable_thread_stack_with_label(NULL, "main");
		if (rc == 0 || rc == -EEXIST) {
			break;
		}
		k_sleep(K_MSEC(100));
	}
}

int main(void)
{
	int rc = initialize_button();
	if (rc < 0) {
		LOG_ERR("Failed to initialize button: %d", rc);
		return rc;
	}

	initialize_metrics();
	LOG_INF("Starting Spotflow minimal BLE sample");

	uint32_t counter = 0;
	int battery = 100;
	while (true) {
		counter++;
		if (counter_metric != NULL) {
			(void)spotflow_report_metric_int(counter_metric, counter);
		}
		if ((counter % TELEMETRY_INTERVAL_SECONDS) == 0U) {
			if (battery_metric != NULL) {
				(void)spotflow_report_metric_int(battery_metric, battery);
			}
			if (acceleration_metric != NULL) {
				float magnitude = (float)(sys_rand32_get() % 201U) / 100.0f;
				(void)spotflow_report_metric_float(acceleration_metric, magnitude);
			}
			battery = battery == 0 ? 100 : battery - 1;
		}
		LOG_INF("Minimal Spotflow heartbeat: %u", counter);
		k_sleep(K_SECONDS(1));
	}

	return 0;
}
```
