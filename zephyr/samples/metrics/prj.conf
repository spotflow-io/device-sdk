## CMakeLists.txt
```
cmake_minimum_required(VERSION 3.20.0)

if (EXISTS "${CMAKE_CURRENT_SOURCE_DIR}/credentials.conf")
    list(APPEND EXTRA_CONF_FILE "${CMAKE_CURRENT_SOURCE_DIR}/credentials.conf")
endif()

find_package(Zephyr REQUIRED HINTS $ENV{ZEPHYR_BASE})
project(metrics)

add_subdirectory(../net-common ${CMAKE_CURRENT_BINARY_DIR}/net-common)

target_sources(app PRIVATE
        src/main.c
)
```

## Kconfig
```
rsource "../net-common/Kconfig"

source "Kconfig.zephyr"
```

## Kconfig.sysbuild
```
config WIFI_NRF70
	default y if \
		BOARD_NRF7002DK_NRF5340_CPUAPP || \
		BOARD_NRF7002DK_NRF5340_CPUAPP_NS || \
		BOARD_NRF7002DK_NRF5340_CPUAPP_NRF7001 || \
		BOARD_NRF7002DK_NRF5340_CPUAPP_NRF7001_NS

source "${ZEPHYR_BASE}/share/sysbuild/Kconfig"
```

## prj.conf
```kconfig
# NXP FRDM-RW612 board uses Wi-Fi by default. If you want to use Ethernet instead,
# please use following option:
#CONFIG_SPOTFLOW_USE_ETH=y

# Enable logging to Spotflow
CONFIG_SPOTFLOW=y

# Enable logging
CONFIG_LOG=y
CONFIG_REQUIRES_FLOAT_PRINTF=y

# Show function names in the logs
CONFIG_LOG_FUNC_NAME_PREFIX_INF=y
CONFIG_LOG_FUNC_NAME_PREFIX_WRN=y
CONFIG_LOG_FUNC_NAME_PREFIX_ERR=y

# Log Spotflow module information
CONFIG_SPOTFLOW_MODULE_DEFAULT_LOG_LEVEL=3

# Enable sending custom and system metrics to Spotflow
CONFIG_SPOTFLOW_METRICS=y
CONFIG_SPOTFLOW_METRICS_SYSTEM=y

# Satisfy networking dependencies of Spotflow
CONFIG_NETWORKING=y
CONFIG_NET_MGMT=y
CONFIG_NET_MGMT_EVENT=y
CONFIG_NET_MGMT_EVENT_INFO=y
CONFIG_NET_CONFIG_AUTO_INIT=n
CONFIG_NET_CONNECTION_MANAGER=y
CONFIG_NET_DHCPV4=y
CONFIG_NET_IPV4=y
CONFIG_NET_IPV6=n
CONFIG_NET_TCP=y
CONFIG_NET_UDP=y

# Increase main stack size for the sample
CONFIG_MAIN_STACK_SIZE=4096

# These configs are automatically selected from Kconfig if configuration persistence for the sample
# is enabled (on by default, disabled for some boards):
# FLASH
# FLASH_MAP
# NVS
# SETTINGS
# SETTINGS_NVS

# Ensures that connection is established even on boards without hardware random number generator.
# We recommend removing this option for production use.
CONFIG_MBEDTLS_PSA_CRYPTO_LEGACY_RNG=y
```

## credentials-sample.conf
```kconfig
# Copy this file to credentials.conf and fill in your Spotflow credentials
# credentials.conf is gitignored to prevent accidental credential leaks

CONFIG_SPOTFLOW_DEVICE_ID="your-device-id"
CONFIG_SPOTFLOW_INGEST_KEY="your-ingest-key"
```

## boards/cy8cproto_062_4343w.conf
```kconfig
# No hardware random number generator is available on this board by default, it might be necessary
# to enable it in the devicetree or add an external one
CONFIG_TEST_RANDOM_GENERATOR=y

# This board has no partitions configured, skipping configuration persistence
CONFIG_SPOTFLOW_SAMPLE_CONFIG_PERSISTENCE_FLASH=n
```

## boards/esp32s3_devkitc_esp32s3_procpu.conf
```kconfig
# Automatic Wi-Fi reconnection isn't enabled by default
CONFIG_ESP32_WIFI_STA_RECONNECT=y
```

## boards/frdm_rw612.conf
```kconfig
CONFIG_WIFI_NXP=y
CONFIG_NXP_RW610=y
CONFIG_ETH_DRIVER=n
#fix buffer size for RW612 on Zephyr 4.1.0
CONFIG_NET_BUF_DATA_SIZE=1744

CONFIG_NXP_WIFI_SOFTAP_SUPPORT=n
```

## boards/lp_em_cc35x1_cc3551e.conf
```kconfig
# Spotflow does not yet auto-detect TI's CC35x1 Wi-Fi devicetree compatible.
CONFIG_SPOTFLOW_USE_WIFI=y
CONFIG_WIFI_TI_CC35XX=y
CONFIG_NET_L2_ETHERNET=y
CONFIG_CRYPTO=y
CONFIG_CRYPTO_TI_CC35XX=y

# TI delivers RX bursts from a cooperative transport thread. Process them
# inline so the separate Zephyr RX thread cannot be starved behind that thread.
CONFIG_NET_TC_RX_COUNT=0

# The driver receives standard Ethernet frames, including a 1500-byte payload.
CONFIG_WIFI_TI_CC35XX_MTU=1500

# Legacy PSA RNG initialization requests CC35x entropy before the system workqueue starts,
# but the CC35x entropy driver needs that workqueue to refill its pool.
CONFIG_MBEDTLS_PSA_CRYPTO_EXTERNAL_RNG=y

# The TI downstream's Mbed TLS defaults take precedence over Spotflow's
# configdefault values and are too small to parse the server certificate chain.
CONFIG_MBEDTLS_SSL_MAX_CONTENT_LEN=4608
CONFIG_MBEDTLS_HEAP_SIZE=36864

# Provide headroom for packets retained by TCP and socket processing.
CONFIG_NET_PKT_RX_COUNT=32
CONFIG_NET_BUF_RX_COUNT=64

# Based on TI's CC35x1 Wi-Fi shell reference configuration:
# zephyr/samples/net/wifi/shell/boards/lp_em_cc35x1_cc3551e.conf
CONFIG_HEAP_MEM_POOL_SIZE=81920
CONFIG_MAIN_STACK_SIZE=61440
CONFIG_NET_TX_STACK_SIZE=2048
CONFIG_NET_RX_STACK_SIZE=2048
CONFIG_DYNAMIC_THREAD_POOL_SIZE=3
CONFIG_DYNAMIC_THREAD_STACK_SIZE=8192
```

## boards/nrf7002dk_nrf5340_cpuapp_ns.conf
```kconfig
# This value isn't propagated from Spotflow Kconfig on Nordic boards, so it must be set manually
# at least to 512 (minimal value necessary to validate the MQTT broker certificate)
CONFIG_MBEDTLS_MPI_MAX_SIZE=512
```

## src/main.c
```c
/*
 * Spotflow Metrics Sample Application
 *
 * This example demonstrates:
 * - System metrics auto-collection (memory, heap, network, CPU)
 * - Custom application metrics (label-less and labeled)
 * - Integration with logs
 */

#include <zephyr/kernel.h>
#include <zephyr/logging/log.h>
#include <zephyr/random/random.h>

#include "metrics/spotflow_metrics_backend.h"

#include "net.h"

LOG_MODULE_REGISTER(metrics_sample, LOG_LEVEL_INF);

/* Metric handles - using type-specific handles */
static struct spotflow_metric_int* g_app_counter_metric;
static struct spotflow_metric_float* g_temperature_metric;
static struct spotflow_metric_float* g_request_duration_metric;

static int init_application_metrics(void);
static void report_counter_metric(void);
static void report_temperature_metric(void);
static void report_request_duration_metric(void);
static void temperature_thread_entry();

#define TEMPERATURE_THREAD_STACK_SIZE 2048
#define TEMPERATURE_THREAD_PRIORITY 5

K_THREAD_DEFINE(temperature_thread, TEMPERATURE_THREAD_STACK_SIZE, temperature_thread_entry, NULL,
		NULL, NULL, TEMPERATURE_THREAD_PRIORITY, 0, 0);

int main(void)
{
	LOG_INF("Starting Spotflow metrics example");

	/* Wait for the initialization of network device */
	k_sleep(K_SECONDS(1));

	spotflow_sample_net_init();

	/* Initialize application metrics */
	int rc = init_application_metrics();
	if (rc < 0) {
		LOG_ERR("Failed to initialize application metrics");
		return -1;
	}

	LOG_INF("Starting metric reporting...");

	/* Main loop - report metrics periodically */
	for (int iteration = 0; iteration < 100; iteration++) {
		LOG_INF("=== Iteration %d ===", iteration);

		/* Report label-less counter every iteration */
		report_counter_metric();

		/* Temperature is reported by temperature_thread every 10 seconds */

		/* Report multiple HTTP requests to demonstrate labeled metrics */
		for (int req = 0; req < 3; req++) {
			report_request_duration_metric();
		}

		/* Add some application logs */
		if (iteration % 10 == 0) {
			LOG_WRN("Periodic health check at iteration %d", iteration);
		}

		k_sleep(K_SECONDS(2));
	}

	LOG_INF("Sample completed successfully");
	return 0;
}

/**
 * @brief Initialize application metrics
 */
static int init_application_metrics(void)
{
	int rc;

	/* Register label-less integer metric - aggregated over 1 minute */
	rc = spotflow_register_metric_int("app_counter", SPOTFLOW_AGG_INTERVAL_1MIN,
					  &g_app_counter_metric);
	if (rc < 0) {
		LOG_ERR("Failed to register app_counter metric: %d", rc);
		return rc;
	}
	LOG_INF("Registered metric: app_counter (int, 1MIN)");

	/* Register labeled float metric - aggregated over 1 minute */
	/* Supports up to 18 unique label combinations (3 endpoints x 2 methods x 3 statuses) */
	rc = spotflow_register_metric_float_with_labels(
		"http_request_duration_ms", SPOTFLOW_AGG_INTERVAL_1MIN,
		18, /* max_timeseries: 3 endpoints x 2 methods x 3 statuses = 18 */
		3, /* max_labels */
		&g_request_duration_metric);
	if (rc < 0) {
		LOG_ERR("Failed to register request_duration metric: %d", rc);
		return rc;
	}
	LOG_INF("Registered metric: http_request_duration_ms (float, labeled, 1MIN)");

	return 0;
}

/**
 * @brief Simulate application counter metric
 */
static void report_counter_metric(void)
{
	static int counter = 0;

	counter += 10;

	int rc = spotflow_report_metric_int(g_app_counter_metric, counter);
	if (rc < 0) {
		LOG_ERR("Failed to report counter metric: %d", rc);
	} else {
		LOG_DBG("Reported counter: %d", counter);
	}
}

/**
 * @brief Simulate temperature sensor reading (immediate metric)
 */
static void report_temperature_metric(void)
{
	/* Simulate temperature reading between 20.0 and 25.0 C */
	double temperature = 20.0 + ((double)(sys_rand32_get() % 500) / 100.0);

	int rc = spotflow_report_metric_float(g_temperature_metric, temperature);
	if (rc < 0) {
		LOG_ERR("Failed to report temperature: %d", rc);
	} else {
		LOG_INF("Reported temperature: %.2f C", temperature);
	}
}

/**
 * @brief Temperature monitoring thread entry point
 *
 * Reports temperature metric every 10 seconds in a dedicated thread.
 */
static void temperature_thread_entry()
{
	/* Register label-less float metric - immediate (no aggregation) */
	int rc = spotflow_register_metric_float("temperature_celsius", SPOTFLOW_AGG_INTERVAL_NONE,
						&g_temperature_metric);
	if (rc < 0) {
		LOG_ERR("Failed to register temperature metric: %d", rc);
		return;
	}
	LOG_INF("Registered metric: temperature_celsius (float, NONE)");

	while (true) {
		report_temperature_metric();
		k_sleep(K_SECONDS(10));
	}
}

/**
 * @brief Simulate HTTP request duration with labels
 */
static void report_request_duration_metric(void)
{
	/* Simulate different endpoints and methods */
	const char* endpoints[] = { "/api/users", "/api/products", "/health" };
	const char* methods[] = { "GET", "POST" };
	const char* status_codes[] = { "200", "404", "500" };

	const char* endpoint = endpoints[sys_rand32_get() % 3];
	const char* method = methods[sys_rand32_get() % 2];
	const char* status = status_codes[sys_rand32_get() % 3];

	/* Simulate duration between 10ms and 500ms */
	double duration_ms = 10.0 + ((double)(sys_rand32_get() % 4900) / 10.0);

	/* Define labels */
	struct spotflow_label labels[] = { { .key = "endpoint", .value = endpoint },
					   { .key = "method", .value = method },
					   { .key = "status", .value = status } };

	int rc = spotflow_report_metric_float_with_labels(g_request_duration_metric, duration_ms,
							  labels, 3);

	if (rc < 0) {
		LOG_ERR("Failed to report request duration: %d", rc);
	} else {
		LOG_DBG("Reported request: %s %s -> %s (%.2f ms)", method, endpoint, status,
			duration_ms);
	}
}
```

## src/metrics_collector.c
```c
#include <zephyr/kernel.h>
#include <zephyr/sys/sys_heap.h>
#include <zephyr/logging/log.h>

#include "metrics/spotflow_metrics.h"

LOG_MODULE_REGISTER(metrics, LOG_LEVEL_INF);

extern struct sys_heap _system_heap; /* provided by Zephyr */

static struct k_work_delayable metrics_work;
static t_metric *m_heap_free;
static t_metric *m_heap_used;
static t_metric *m_mem_peak;
static t_metric *m_cpu_util;

static int sample_cpu_util(int cpu_id)
{
	/* You can swap to cpu_load_metric_get(cpu_id) if preferred */
	static uint64_t prev_exec[CONFIG_MP_MAX_NUM_CPUS];
	static uint64_t prev_total[CONFIG_MP_MAX_NUM_CPUS];
	struct k_thread_runtime_stats stats;

	if (k_thread_runtime_stats_cpu_get(cpu_id, &stats) != 0) {
		return -EIO;
	}

	uint64_t d_exec = stats.execution_cycles - prev_exec[cpu_id];
	uint64_t d_total = stats.total_cycles - prev_total[cpu_id];
	prev_exec[cpu_id] = stats.execution_cycles;
	prev_total[cpu_id] = stats.total_cycles;

	if (d_total == 0) {
		return 0;
	}

	return (int)((100 * d_exec) / d_total); /* 0–100 % */
}

static void metrics_work_handler(struct k_work *work)
{
	ARG_UNUSED(work);

	struct sys_memory_stats heap_stats;
	if (sys_heap_runtime_stats_get(&_system_heap, &heap_stats) == 0) {
		report_metric_int(m_heap_free, NULL, 0, (int64_t)heap_stats.free_bytes);
		report_metric_int(m_heap_used, NULL, 0, (int64_t)heap_stats.allocated_bytes);
		report_metric_int(m_mem_peak, NULL, 0, (int64_t)heap_stats.max_allocated_bytes);
	}

	int cpu0 = sample_cpu_util(0);
	if (cpu0 >= 0) {
		report_metric_int(m_cpu_util, NULL, 0, cpu0);
	}

	k_work_reschedule(&metrics_work, K_SECONDS(5));
}

int spotflow_metrics_init(void)
{
	spotflow_metrics_pipeline_init();

	/* No dimensions, single timeseries each */
	m_heap_free = register_metric_int("heap_free_bytes", 1, 0, false);
	m_heap_used = register_metric_int("heap_used_bytes", 1, 0, false);
	m_mem_peak = register_metric_int("heap_peak_bytes", 1, 0, false);
	m_cpu_util = register_metric_int("cpu_util_percent", 1, 0, false);

	if (!m_heap_free || !m_heap_used || !m_mem_peak || !m_cpu_util) {
		return -ENOMEM;
	}

	k_work_init_delayable(&metrics_work, metrics_work_handler);
	k_work_schedule(&metrics_work, K_SECONDS(1)); /* warm-up: first delta */
	return 0;
}
```
