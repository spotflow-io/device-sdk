## CMakeLists.txt
```
cmake_minimum_required(VERSION 3.20.0)

if (EXISTS "${CMAKE_CURRENT_SOURCE_DIR}/credentials.conf")
    list(APPEND EXTRA_CONF_FILE "${CMAKE_CURRENT_SOURCE_DIR}/credentials.conf")
endif()


find_package(Zephyr REQUIRED HINTS $ENV{ZEPHYR_BASE})
project(logs)

add_subdirectory(../net-common ${CMAKE_CURRENT_BINARY_DIR}/net-common)

target_sources(app PRIVATE
        src/main.c
)
```

## Kconfig
```
config NET_WIFI_SSID
	string "SSID device should connect to"
	help
		SSID of the Wi-Fi network that the device should connect to.

config NET_WIFI_PASSWORD
	string "Wi-Fi Password device should connect to"
	help
		Wi-Fi password for the network that the device should connect to.

config SPOTFLOW_IS_WIFI_AVAILABLE
	bool
	help
		Indicates if Wi-Fi is available on the board (inferred from devicetree of supported boards).
	default y if \
		DT_HAS_ESPRESSIF_ESP32_WIFI_ENABLED || \
		DT_HAS_INFINEON_AIROC_WIFI_ENABLED || \
		DT_HAS_NORDIC_WLAN_ENABLED || \
		DT_HAS_NXP_WIFI_ENABLED || \
		DT_HAS_SILABS_SIWX91X_WIFI_ENABLED

choice SPOTFLOW_NETWORK_IFACE
	prompt "Spotflow network interface"
	default SPOTFLOW_USE_WIFI if SPOTFLOW_IS_WIFI_AVAILABLE
	default SPOTFLOW_USE_ETH

config SPOTFLOW_USE_WIFI
	bool "Enable Wi-Fi for Spotflow samples"
	imply WIFI
	imply WIFI_NM
	imply NET_L2_WIFI_MGMT
	# NXP specific configs
	imply WIFI_NXP if BOARD_FRDM_RW612
	# Enables IP fragmentation, which fixes the TLS handshake issue since Zephyr 4.2
	imply NXP_WIFI_TX_RX_ZERO_COPY if NXP_RW610

config SPOTFLOW_USE_ETH
	bool "Enable Ethernet for Spotflow samples"
	imply ETH_DRIVER
	imply NET_L2_ETHERNET
	imply NET_L2_ETHERNET_MGMT

endchoice

# If selected, fulfills SPOTFLOW_SETTINGS dependencies by storing Zephyr settings on flash
config SPOTFLOW_SAMPLE_CONFIG_PERSISTENCE_FLASH
	bool "Enable configuration persistence on flash"
	default y
	select CONFIG_FLASH
	select CONFIG_FLASH_MAP
	select CONFIG_NVS
	select CONFIG_SETTINGS
	select CONFIG_SETTINGS_NVS

config NET_IF_MAX_IPV4_COUNT
	int
	# By default eth driver on FRDM_RW612 is enabled;
	# therefore, we have to allow multiple IPv4 interfaces
	# so DHCP can work properly
	default 2 if SPOTFLOW_USE_WIFI && BOARD_FRDM_RW612

source "Kconfig.zephyr"
```

## Kconfig.sysbuild
```
config WIFI_NRF70
	default y if BOARD_NRF7002DK || BOARD_THINGY53

source "${ZEPHYR_BASE}/share/sysbuild/Kconfig"
```

## prj.conf
```kconfig
# Boards that support both Wi-Fi and Ethernet use Wi-Fi by default.
# If you want to use Ethernet instead, please use the following option:
# CONFIG_SPOTFLOW_USE_ETH=y

# Enable logging to Spotflow
CONFIG_SPOTFLOW=y

# Enable logging
CONFIG_LOG=y

# Show function names in the logs
CONFIG_LOG_FUNC_NAME_PREFIX_INF=y
CONFIG_LOG_FUNC_NAME_PREFIX_WRN=y
CONFIG_LOG_FUNC_NAME_PREFIX_ERR=y

# Log Spotflow module details for debugging
CONFIG_SPOTFLOW_MODULE_DEFAULT_LOG_LEVEL=4

# Satisfy networking dependencies of Spotflow
CONFIG_NETWORKING=y
CONFIG_NET_MGMT=y
CONFIG_NET_MGMT_EVENT=y
CONFIG_NET_MGMT_EVENT_INFO=y
CONFIG_NET_CONFIG_AUTO_INIT=n
CONFIG_NET_CONNECTION_MANAGER=y
CONFIG_NET_DHCPV4=y
CONFIG_NET_IPV4=y
CONFIG_NET_IPV6=n
CONFIG_NET_TCP=y
CONFIG_NET_UDP=y

# Increase main stack size for the sample
CONFIG_MAIN_STACK_SIZE=4096

# These configs are automatically selected from Kconfig if configuration persistence for the sample
# is enabled (on by default, disabled for some boards):
# FLASH
# FLASH_MAP
# NVS
# SETTINGS
# SETTINGS_NVS

# Ensures that connection is established even on boards without hardware random number generator.
# We recommend removing this option for production use.
CONFIG_MBEDTLS_PSA_CRYPTO_LEGACY_RNG=y
```

## credentials-sample.conf
```kconfig
# Copy this file to credentials.conf and fill in the values
CONFIG_NET_WIFI_SSID=""
CONFIG_NET_WIFI_PASSWORD=""
CONFIG_SPOTFLOW_DEVICE_ID=""
CONFIG_SPOTFLOW_INGEST_KEY=""
```

## boards/cy8cproto_062_4343w.conf
```kconfig
# I was unable to find the driver for trng so using test random generator
CONFIG_TEST_RANDOM_GENERATOR=y

# This board has no partitions configured, skipping configuration persistence
CONFIG_SPOTFLOW_SAMPLE_CONFIG_PERSISTENCE_FLASH=n
```

## boards/disco_l475_iot1.conf
```kconfig
## disco_l475_iot1
CONFIG_WIFI_ESWIFI=y
CONFIG_TLS_CREDENTIALS=y

#CONFIG_MAIN_STACK_SIZE=1024
#CONFIG_IDLE_STACK_SIZE=256
#CONFIG_ISR_STACK_SIZE=1024
#CONFIG_SYSTEM_WORKQUEUE_STACK_SIZE=1024

CONFIG_MBEDTLS_HEAP_SIZE=16384
CONFIG_WIFI_LOG_LEVEL_DBG=y
#CONFIG_NET_LOG_LEVEL_DBG=y
CONFIG_NET_PKT_LOG_LEVEL_DBG=y

#CONFIG_LOG
CONFIG_LOG_MODE_IMMEDIATE=y
```

## boards/esp32c6_devkitc.conf
```kconfig
# WiFi Config
CONFIG_WIFI_ESP32=y
CONFIG_ESP32_WIFI_STA_AUTO_DHCPV4=y
CONFIG_ESP32_WIFI_STA_RECONNECT=y
CONFIG_NET_L2_ETHERNET=y
```

## boards/esp32s2_saola.conf
```kconfig
# Use PSRAM for Wi-Fi buffers to save SRAM
CONFIG_ESP_SPIRAM=y
CONFIG_ESP_WIFI_HEAP_SPIRAM=y
CONFIG_ESP32_WIFI_NET_ALLOC_SPIRAM=y

# Automatic Wi-Fi reconnection isn't enabled by default
CONFIG_ESP32_WIFI_STA_RECONNECT=y
```

## boards/frdm_k64f.conf
```kconfig
CONFIG_SPOTFLOW_USE_ETH=y
```

## boards/esp32c6_devkitc_esp32c6_hpcore.overlay
```dts
&wifi {
	status = "okay";
};
```

## boards/esp32s3_devkitc_esp32s3.overlay
```dts
/ {
	wifi: wifi {
		status = "okay";
	};
};
```

## boards/lp_em_cc35x1_cc3551e.overlay
```dts
&wlan0 {
	status = "okay";
};
```

## src/main.c
```c
#include <zephyr/bindesc.h>
#include <zephyr/kernel.h>
#include <zephyr/logging/log.h>

#include <spotflow/ingest_key.h>
#include <spotflow/session_metadata.h>

#include "net.h"

LOG_MODULE_REGISTER(MAIN, LOG_LEVEL_INF);

/* Uncomment this function to provide your own device ID in runtime */
/*const char* spotflow_override_device_id()
{
	return "my_nrf7002dk_test";
}*/

/* Enable CONFIG_SPOTFLOW_INGEST_KEY_DYNAMIC, remove CONFIG_SPOTFLOW_INGEST_KEY from
 * your configuration, and uncomment this callback to provide the ingest key at runtime. */
/*const char* spotflow_on_ingest_key_requested(void)
{
	return "sf_ikv1_...";
}*/

/* Uncomment this callback to attach labels to all telemetry in a session. */
/*static const struct spotflow_session_label session_labels[] = {
	{
		.key = "hardwareRevision",
		.type = SPOTFLOW_SESSION_LABEL_STRING,
		.value.string = "rev-b",
	},
	{
		.key = "productionLine",
		.type = SPOTFLOW_SESSION_LABEL_INT,
		.value.integer = 4,
	},
};

struct spotflow_session_metadata_labels spotflow_override_session_metadata_labels(void)
{
	return (struct spotflow_session_metadata_labels){
		.items = session_labels,
		.count = ARRAY_SIZE(session_labels),
	};
}*/

int main(void)
{
	LOG_INF("Starting Spotflow logging example");

	// Wait for the initialization of network device
	k_sleep(K_SECONDS(1));

	spotflow_sample_net_init();

	for (int i = 0; i < 20; i++) {
		LOG_INF("Hello from Zephyr to Spotflow: %d", i);
		k_sleep(K_SECONDS(2));
	}

	return 0;
}
```
