/delete-node/ &storage_partition;

&flash0 {
        partitions {
		/* Replace unused storage partition (32 KiB) by core dump partition*/
                coredump_partition: partition@f8000 {
                        label = "coredump-partition";
                        reg = <0x000f8000 0x00008000>;
                };
	};
};
