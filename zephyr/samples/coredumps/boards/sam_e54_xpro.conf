## zephyr/src/net/Kconfig
```kconfig
choice SPOTFLOW_TRANSPORT
	prompt "Spotflow transport"
	default SPOTFLOW_TRANSPORT_MQTT

rsource "Kconfig.mqtt"
rsource "Kconfig.ble"

endchoice

config SPOTFLOW_INGEST_KEY_DYNAMIC
	bool "Provide the ingest key from application code"
	help
		Obtain the ingest key at runtime by implementing
		const char* spotflow_on_ingest_key_requested(void) in your application.
		A NULL result delays the MQTT connection or BLE advertising and is retried.
		The first non-NULL result is cached until reboot.
		BLE defaults to requiring link encryption. Enable BT_SMP to use it.

config SPOTFLOW_INGEST_KEY
	string "Spotflow ingest key"
	depends on !SPOTFLOW_INGEST_KEY_DYNAMIC
	help
		The ingest key authenticates the device with Spotflow. Manage ingest
		keys in the Spotflow portal.

		Direct MQTT requires a nonempty key. For BLE, leave this empty if the
		gateway provides the key. A nonempty BLE key is exposed over GATT.
		BLE defaults to requiring link encryption. Enable BT_SMP to use it.

		To provide the key at runtime, enable SPOTFLOW_INGEST_KEY_DYNAMIC
		and implement spotflow_on_ingest_key_requested().

config SPOTFLOW_BLE_HAS_INGEST_KEY
	def_bool SPOTFLOW_INGEST_KEY_DYNAMIC || SPOTFLOW_INGEST_KEY != ""
	depends on SPOTFLOW_TRANSPORT_BLE
```

## zephyr/src/net/Kconfig.ble
```kconfig
config SPOTFLOW_TRANSPORT_BLE
	bool "BLE gateway transport"
	select BT
	select BT_PERIPHERAL

if SPOTFLOW_TRANSPORT_BLE

config SPOTFLOW_BLE_RX_THREAD_STACK_SIZE
	int "BLE receive processing thread stack size"
	default 2048
	help
	  Stack size in bytes for BLE message reassembly and configuration/OTA
	  handlers. Reassembled message buffers are allocated separately.
	  Increase this if platform settings storage or logging requires more stack.

config SPOTFLOW_BLE_REQUIRE_ENCRYPTION
	bool "Require an encrypted connection to the Spotflow BLE service"
	default y if SPOTFLOW_OTA || SPOTFLOW_BLE_HAS_INGEST_KEY
	help
	  Require BLE link encryption for device context, the optional ingest key,
	  RX writes, and enabling TX notifications. This option is enabled by default
	  when the device either uses OTA updates or publishes the ingest key to the
	  gateway.

	  When link encryption is required, enable BT_SMP for pairing support.
	  Configure the application's pairing policy to allow only trusted gateways.
	  Gateways can read the ingest key and receive OTA artifact download credentials.

	  Disable this option only in safe testing environments.

configdefault BT_L2CAP_TX_MTU
	default 247
	help
		Use the common high-throughput BLE 4.2+ ATT MTU value. With the 3-byte
		ATT notification header this leaves 244 bytes for application payload,
		and together with the 4-byte L2CAP header it fits in a 251-byte ACL data
		packet.

configdefault BT_BUF_ACL_TX_SIZE
	default 251
	help
		Use a full data-length ACL TX buffer. This matches the common BLE Data
		Length Extension maximum and lets a 247-byte ATT MTU plus the 4-byte
		L2CAP header fit into one ACL data packet.

configdefault BT_BUF_ACL_RX_SIZE
	default 251
	help
		Keep the ACL RX buffer aligned with the TX side and with the common
		247-byte ATT MTU case so incoming Spotflow control/config traffic is not
		artificially constrained by smaller host receive buffers.

endif # SPOTFLOW_TRANSPORT_BLE
```

## zephyr/tests/ble_startup/testcase.yaml
```yaml
tests:
  spotflow.ble_startup:
    tags:
      - spotflow
      - ble
    integration_platforms:
      - qemu_cortex_m3
  spotflow.ble_startup.ingest_key:
    tags:
      - spotflow
      - ble
    integration_platforms:
      - qemu_cortex_m3
    extra_args: SPOTFLOW_TEST_BLE_INGEST_KEY=ON
  spotflow.ble_startup.ingest_key_unencrypted:
    tags:
      - spotflow
      - ble
    integration_platforms:
      - qemu_cortex_m3
    extra_args:
      - SPOTFLOW_TEST_BLE_INGEST_KEY=ON
      - SPOTFLOW_TEST_BLE_UNENCRYPTED=ON
```
