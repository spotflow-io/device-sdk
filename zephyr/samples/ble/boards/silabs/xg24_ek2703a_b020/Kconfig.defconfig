## zephyr/samples/ble/boards/silabs/xg24_ek2703a_b020/Kconfig.defconfig
```kconfig
if BOARD_XG24_EK2703A_B020

configdefault LOG_BACKEND_SWO_FREQ_HZ
	default 875000

config CMU_HFXO_FREQ
	default 39000000

config CMU_LFXO_FREQ
	default 32768

if SOC_GECKO_USE_RAIL

config FPU
	default y

endif # SOC_GECKO_USE_RAIL

if SPOTFLOW_COREDUMPS

choice DEBUG_COREDUMP_BACKEND
	default DEBUG_COREDUMP_BACKEND_IN_MEMORY
endchoice

config DEBUG_COREDUMP_BACKEND_IN_MEMORY_SIZE
	default 32768

endif # SPOTFLOW_COREDUMPS

endif # BOARD_XG24_EK2703A_B020
```

## zephyr/samples/ble/boards/silabs/xg24_ek2703a_b020/board.yml
```yaml
board:
  name: xg24_ek2703a_b020
  full_name: EFR32xG24 Explorer Kit (xG24-EK2703A, BRD2703A, B020)
  vendor: silabs
  socs:
    - name: efr32mg24b020f1536im48
```

## zephyr/samples/ble/boards/xg24_ek2703a.conf
```kconfig
CONFIG_BT_DEVICE_NAME="Spotflow EFR32MG24"
CONFIG_SPOTFLOW_DEVICE_ID="efr32mg24"
CONFIG_DEBUG_COREDUMP_BACKEND_IN_MEMORY=y
CONFIG_DEBUG_COREDUMP_BACKEND_IN_MEMORY_SIZE=32768

CONFIG_DEBUG_COREDUMP_THREADS_METADATA=y
CONFIG_DEBUG_COREDUMP_MEMORY_DUMP_THREADS=y
```

## zephyr/samples/ble/boards/xg24_ek2703a_b020.conf
```kconfig
CONFIG_BT_DEVICE_NAME="Spotflow EFR32MG24"
CONFIG_SPOTFLOW_DEVICE_ID="efr32mg24"
```

## zephyr/samples/logs/boards/pic32ck_gc01_cult.conf
```kconfig
CONFIG_SPOTFLOW_USE_ETH=y
CONFIG_SPOTFLOW_DEVICE_ID="pic32ck_gc01_cult"

CONFIG_MBEDTLS_CIPHERSUITE_TLS_ECDHE_RSA_WITH_AES_128_GCM_SHA256=y

CONFIG_MBEDTLS_PSA_CRYPTO_EXTERNAL_RNG=y
```

## zephyr/src/backend/Kconfig
```kconfig
choice SPOTFLOW_TELEMETRY_BACKEND
	prompt "Spotflow telemetry backend"
	default SPOTFLOW_TELEMETRY_BACKEND_QUEUED

config SPOTFLOW_TELEMETRY_BACKEND_QUEUED
	bool "Queued telemetry backend"
	help
		Use the general-purpose backend with independently allocated and queued
		telemetry messages. This remains the default for MQTT and larger devices.

config SPOTFLOW_TELEMETRY_BACKEND_MINIMAL
	bool "Minimal static telemetry backend"
	depends on SPOTFLOW_TRANSPORT_BLE
	help
		Use the BLE-only backend with fixed storage, coalesced metrics, pull-based
		coredumps, and no telemetry heap allocations. This backend is intended for
		RAM-constrained devices such as the CC2340R5.

endchoice

if SPOTFLOW_TELEMETRY_BACKEND_MINIMAL

config SPOTFLOW_TELEMETRY_CBOR_BUFFER_SIZE
	int "Shared telemetry CBOR workspace size"
	range 192 2048
	default 256
	help
		Size of the single CBOR workspace owned by the Spotflow processor. It must
		fit the largest enabled log, metric, heartbeat, or coredump chunk message.

config SPOTFLOW_METRICS_MAX_TIMESERIES
	int "Maximum total metric time series"
	depends on SPOTFLOW_METRICS
	range 1 128
	default 16
	help
		Total number of statically reserved metric series across all registered
		metrics. Stack metrics reserve one series per tracked thread and metric.

endif
```

## zephyr/src/coredumps/KConfig
```kconfig
config SPOTFLOW_COREDUMPS
	bool "Enable core dumps upload to Spotflow"
	default n
	select DEBUG_COREDUMP
	select FLASH
	select REBOOT
	help
		Enable sending core dumps to Spotflow observability platform.


if SPOTFLOW_COREDUMPS

# spotflow uses Zephyr's coredump subsystem to upload core dumps
choice DEBUG_COREDUMP_BACKEND
	default DEBUG_COREDUMP_BACKEND_FLASH_PARTITION if SPOTFLOW_COREDUMPS
endchoice

config SPOTFLOW_COREDUMPS_PROCESSING_LOG_LEVEL
	int "Spotflow SDK coredumps component log level"
	default SPOTFLOW_MODULE_DEFAULT_LOG_LEVEL
	range 0 4
	help
		Sets log level for Spotflow coredumps component.
		Defaults to SPOTFLOW_MODULE_DEFAULT_LOG_LEVEL.
		Levels are:
		- 0 OFF, do not write
		- 1 ERROR, only write LOG_ERR
		- 2 WARNING, write LOG_WRN in addition to previous level
		- 3 INFO, write LOG_INF in addition to previous level
		- 4 DEBUG, write LOG_DBG in addition to previous level

config SPOTFLOW_COREDUMPS_THREAD_STACK_SIZE
	int "Spotflow coredumps processing thread stack size"
	depends on SPOTFLOW_TELEMETRY_BACKEND_QUEUED
	default 1024
	help
		Size of the stack used by the thread preparing stored coredumps
		for transport. Reduce this on RAM-constrained boards only after
		validating coredump upload.

config HEAP_MEM_POOL_ADD_SIZE_SPOTFLOW_COREDUMPS
	int "Additional heap size required by Spotflow"
	default 0 if SPOTFLOW_TELEMETRY_BACKEND_MINIMAL
	default 18432
	range 0 1048576
	help
		Additional heap size required by Spotflow coredumps backend.
		Increase this value if you experience issues with allocation of
		memory for coredumps.
		Default SPOTFLOW_COREDUMPS_CHUNK_SIZE*SPOTFLOW_COREDUMPS_BACKEND_QUEUE_SIZE+2KiB.
config SPOTFLOW_COREDUMPS_CHUNK_SIZE
	int "Size of Spotflow coredump chunk"
	default 128 if SPOTFLOW_TELEMETRY_BACKEND_MINIMAL
	default 1024
	range 128 1984 if SPOTFLOW_TELEMETRY_BACKEND_MINIMAL
	range 128 921600 if SPOTFLOW_TELEMETRY_BACKEND_QUEUED
	help
		Size of the coredump chunk used by Spotflow Coredump backend.
		Should not be larger than 900 KiB because Spotflow cloud backend
		expects coredump chunks to be less than 1 MiB including metadata.

config SPOTFLOW_COREDUMPS_BACKEND_QUEUE_SIZE
	int "Size of Spotflow coredump backend queue"
	depends on SPOTFLOW_TELEMETRY_BACKEND_QUEUED
	default 16
	help
		Size of the queue used by Spotflow Coredump backend to store coredump
		chunks before sending them to the server.

config SPOTFLOW_USE_DEFAULT_REBOOT_HANDLER
    bool "Use default Spotflow reboot handler"
    default y
    help
        Use the default Zephyr reboot handler to reset the system after a fatal error.
        If disabled, you will need to implement your own reboot handler.
        Please, make sure you reboot the device and call LOG_PANIC() in your handler.

config SPOTFLOW_COREDUMPS_REBOOT_WARM
    bool "Use warm reboot after coredump"
    default n
    depends on SPOTFLOW_USE_DEFAULT_REBOOT_HANDLER
    help
        Use SYS_REBOOT_WARM instead of SYS_REBOOT_COLD after writing a coredump.
        Enable this on boards where cold reboot is not implemented by the SoC.
endif #SPOTFLOW_COREDUMPS
```

## zephyr/src/net/Kconfig.ble
```kconfig
config SPOTFLOW_TRANSPORT_BLE
	bool "BLE gateway transport"
	select BT
	select BT_PERIPHERAL

if SPOTFLOW_TRANSPORT_BLE

config SPOTFLOW_BLE_RX_THREAD_STACK_SIZE
	int "BLE receive processing thread stack size"
	default 2048
	help
	  Stack size in bytes for BLE message reassembly and configuration/OTA
	  handlers. Reassembled message buffers are allocated separately.
	  Increase this if platform settings storage or logging requires more stack.

config SPOTFLOW_BLE_REQUIRE_ENCRYPTION
	bool "Require an encrypted connection to the Spotflow BLE service"
	default y if SPOTFLOW_OTA
	select BT_SMP
	help
	  Require BLE link encryption for device context, RX writes, and enabling
	  TX notifications. Pair only with trusted gateways and configure the
	  application's pairing and bonding policy for its deployment. The gateway
	  can read artifact download credentials, so it is part of the trust boundary.

configdefault BT_L2CAP_TX_MTU
	default 247
	help
		Use the common high-throughput BLE 4.2+ ATT MTU value. With the 3-byte
		ATT notification header this leaves 244 bytes for application payload,
		and together with the 4-byte L2CAP header it fits in a 251-byte ACL data
		packet.

configdefault BT_BUF_ACL_TX_SIZE
	default 251
	help
		Use a full data-length ACL TX buffer. This matches the common BLE Data
		Length Extension maximum and lets a 247-byte ATT MTU plus the 4-byte
		L2CAP header fit into one ACL data packet.

configdefault BT_BUF_ACL_RX_SIZE
	default 251
	help
		Keep the ACL RX buffer aligned with the TX side and with the common
		247-byte ATT MTU case so incoming Spotflow control/config traffic is not
		artificially constrained by smaller host receive buffers.

endif # SPOTFLOW_TRANSPORT_BLE
```

## zephyr/src/ota/Kconfig
```kconfig
menuconfig SPOTFLOW_OTA
	bool "Enable Spotflow over-the-air (OTA) updates"
	depends on SPOTFLOW
	depends on SPOTFLOW_TRANSPORT_MQTT
	depends on SETTINGS
	depends on !SETTINGS_NONE
	select HTTP_CLIENT
	default n
	help
	  Enable Spotflow OTA protocol handling, persistence, worker thread,
	  artifact downloader, and delegated firmware callbacks. The selected
	  main-firmware backend supplies image management when automatic handling
	  is enabled.

	  OTA requires the MQTT transport and a persistent Zephyr settings storage
	  backend (SETTINGS_NONE is not supported). BLE transport does not support
	  OTA updates.

if SPOTFLOW_OTA

config SPOTFLOW_OTA_LOG_LEVEL
	int "OTA subsystem log level"
	default SPOTFLOW_MODULE_DEFAULT_LOG_LEVEL
	range 0 4
	help
	  Log level for the Spotflow OTA subsystem.
	  Defaults to SPOTFLOW_MODULE_DEFAULT_LOG_LEVEL.
	  0 = OFF
	  1 = ERROR
	  2 = WARNING
	  3 = INFO
	  4 = DEBUG

config SPOTFLOW_OTA_MAX_ARTIFACTS
	int "Maximum number of artifacts in an OTA update manifest"
	default 4
	range 1 32
	help
	  Maximum number of firmware artifacts accepted in one OTA update manifest.

config SPOTFLOW_OTA_THREAD_STACK_SIZE
	int "Stack size for the OTA worker thread"
	default 6144
	help
	  Stack size in bytes for the OTA worker thread. Artifact downloads run
	  synchronously on this thread, so increase this value if you observe stack
	  overflows during TLS or HTTP operations.

config SPOTFLOW_OTA_HTTP_TIMEOUT_MS
	int "Artifact download request timeout in milliseconds"
	default 120000
	help
	  Time budget for each download attempt. The budget starts before DNS and
	  connection setup, and the remaining time is passed to the HTTP client.
	  Blocking DNS, TCP, and TLS operations use their own timeouts and can cause
	  an attempt to exceed this value.

config SPOTFLOW_OTA_DOWNLOAD_BUFFER_SIZE
	int "Receive buffer size for artifact downloads in bytes"
	default IMG_BLOCK_BUF_SIZE if IMG_MANAGER
	default 512
	help
	  Size of the HTTP response receive buffer used while streaming artifacts.
	  When main-firmware image management is enabled, defaults to the image
	  writer buffer size so download and flash paths can share the same block size.

config SPOTFLOW_OTA_DOWNLOAD_RETRY_INITIAL_DELAY_MS
	int "Initial artifact download retry delay ceiling in milliseconds"
	default 5000
	range 1 3600000
	help
	  Upper bound of the randomized delay before the first retry after a
	  transient artifact download failure. The retry delay ceiling doubles
	  after each subsequent transient failure. Transient failures are retried
	  indefinitely until the download succeeds, is canceled, or encounters a
	  non-retryable error.

config SPOTFLOW_OTA_DOWNLOAD_RETRY_MAX_DELAY_MS
	int "Maximum artifact download retry delay in milliseconds"
	default 300000
	range SPOTFLOW_OTA_DOWNLOAD_RETRY_INITIAL_DELAY_MS 3600000
	help
	  Maximum delay ceiling for artifact download retries. Once this ceiling is
	  reached, transient failures continue to be retried indefinitely at
	  randomized delays between half this value and this value, until the
	  download succeeds, is canceled, or encounters a non-retryable error.

config SPOTFLOW_OTA_MCUBOOT_AVAILABLE
	bool
	default y
	depends on BOOTLOADER_MCUBOOT
	depends on MCUBOOT_BOOTLOADER_MODE_SWAP_USING_OFFSET || \
		MCUBOOT_BOOTLOADER_MODE_SWAP_USING_MOVE || \
		MCUBOOT_BOOTLOADER_MODE_SWAP_SCRATCH || \
		MCUBOOT_BOOTLOADER_MODE_DIRECT_XIP_WITH_REVERT || \
		MCUBOOT_BOOTLOADER_MODE_RAM_LOAD_WITH_REVERT
	depends on ARCH_SUPPORTS_ROM_START || ARCH_POSIX
	depends on FLASH && FLASH_MAP && STREAM_FLASH

config SPOTFLOW_OTA_PSA_FWU_AVAILABLE
	bool
	default y if CC35XXE_FWU
	help
	  A PSA FWU implementation supported by Spotflow is available on this target.
	  Extend this condition when adding another provider implementation.

config SPOTFLOW_OTA_AUTO_HANDLE_MAIN_FIRMWARE
	bool "Automatically handle main firmware OTA updates"
	depends on SPOTFLOW_GENERATE_BUILD_ID
	depends on SPOTFLOW_OTA_MCUBOOT_AVAILABLE || SPOTFLOW_OTA_PSA_FWU_AVAILABLE
	default y
	help
	  Download main firmware artifacts, install them for unconfirmed execution, and
	  reconcile the persisted probation record after reboot. The application
	  confirms the new image after its health checks. Requires an available
	  firmware update provider and embedded build IDs in both images.

if SPOTFLOW_OTA_AUTO_HANDLE_MAIN_FIRMWARE

choice SPOTFLOW_OTA_MAIN_FIRMWARE_BACKEND
	prompt "Main firmware update backend"
	default SPOTFLOW_OTA_MAIN_FIRMWARE_PSA_FWU if SPOTFLOW_OTA_PSA_FWU_AVAILABLE && !BOOTLOADER_MCUBOOT
	default SPOTFLOW_OTA_MAIN_FIRMWARE_MCUBOOT

config SPOTFLOW_OTA_MAIN_FIRMWARE_MCUBOOT
	bool "MCUboot"
	depends on SPOTFLOW_OTA_MCUBOOT_AVAILABLE
	select IMG_MANAGER
	select IMG_ERASE_PROGRESSIVELY
	select REBOOT
	help
	  Use a rollback-capable MCUboot mode and a secondary flash slot.

config SPOTFLOW_OTA_MAIN_FIRMWARE_PSA_FWU
	bool "PSA Firmware Update"
	depends on SPOTFLOW_OTA_PSA_FWU_AVAILABLE
	help
	  Use the PSA Firmware Update lifecycle. The TI CC35xx implementation
	  currently supplies component selection and signed-image preparation.
	  Confirmation does not reboot. If the platform requires a reboot to make
	  confirmation durable, the application must request it through PSA FWU.

endchoice

config SPOTFLOW_OTA_PSA_FWU_TI_CC35XX
	bool
	default y
	depends on SPOTFLOW_OTA_MAIN_FIRMWARE_PSA_FWU && CC35XXE_FWU

endif # SPOTFLOW_OTA_AUTO_HANDLE_MAIN_FIRMWARE

endif # SPOTFLOW_OTA
```

## zephyr/src/persistent_buffer/Kconfig
```kconfig
config SPOTFLOW_PERSISTENT_BUFFER
	bool "Store logs and metrics in flash until they are sent"
	default n
	select FLASH
	select FLASH_MAP
	select FCB
	help
		Store all logs and metrics in a flash circular buffer before they are sent, so they
		survive reboots and battery loss while no connection is available. Buffered data
		is sent after the next connection, attributed to the boot that produced it.

		Requires a flash partition labelled spotflow_buffer_partition in devicetree, or a
		spotflow_buffer partition when the Partition Manager is used. The partition size
		sets the buffer capacity; use at least four flash sectors.

		The flash write block must be at most 8 bytes. On nRF54L RRAM, set
		CONFIG_NRF_RRAM_WRITE_BUFFER_SIZE=0 and write-block-size = <4> on the RRAM node
		(see the nrf54l15dk_nrf54l15_cpuapp files of the BLE sample).

if SPOTFLOW_PERSISTENT_BUFFER

config SPOTFLOW_PERSISTENT_BUFFER_FLUSH_INTERVAL_MS
	int "Interval of writing queued messages to flash (ms)"
	default 5000
	range 100 3600000
	help
		How often queued RAM messages are written to flash. Messages are also written when
		a RAM queue is half full and when spotflow_persistent_buffer_flush() is called.
		A sudden power loss loses at most the messages produced during the last interval.

config HEAP_MEM_POOL_ADD_SIZE_SPOTFLOW_PERSISTENT_BUFFER
	int
	default 2048
	help
		Heap for the message that is read from flash and being sent.

endif # SPOTFLOW_PERSISTENT_BUFFER
```

## zephyr/tests/ble_advertising/testcase.yaml
```yaml
common:
  integration_platforms:
    - native_sim
  platform_allow:
    - native_sim
  tags:
    - spotflow
    - bluetooth
    - unit
tests:
  spotflow.ble_advertising.backoff: {}
  spotflow.ble_advertising.no_backoff:
    extra_args:
      - SPOTFLOW_TEST_NO_ADV_BACKOFF=1
```

## zephyr/tests/ble_config/testcase.yaml
```yaml
tests:
  spotflow.ble_config:
    tags:
      - spotflow
      - ble
    integration_platforms:
      - qemu_cortex_m3
```

## zephyr/tests/ble_framing/testcase.yaml
```yaml
tests:
  spotflow.ble_framing.tx:
    integration_platforms:
      - native_sim
      - qemu_cortex_m3
    platform_allow:
      - native_sim
      - qemu_cortex_m3
    tags:
      - spotflow
      - bluetooth
      - unit
```

## zephyr/tests/ble_startup/testcase.yaml
```yaml
tests:
  spotflow.ble_startup:
    tags:
      - spotflow
      - ble
    integration_platforms:
      - qemu_cortex_m3
```
