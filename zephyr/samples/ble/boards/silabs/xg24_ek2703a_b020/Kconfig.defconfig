## zephyr/tests/ingest_key/testcase.yaml
```yaml
common:
  tags:
    - spotflow
  platform_allow:
    - native_sim
    - qemu_cortex_m3
  integration_platforms:
    - native_sim
tests:
  spotflow.ingest_key.dynamic:
    extra_args:
      - SPOTFLOW_TEST_SCENARIO=dynamic
  spotflow.ingest_key.dynamic_retry:
    extra_args:
      - SPOTFLOW_TEST_SCENARIO=dynamic_retry
  spotflow.ingest_key.dynamic_empty:
    extra_args:
      - SPOTFLOW_TEST_SCENARIO=dynamic_empty
  spotflow.ingest_key.static:
    extra_args:
      - SPOTFLOW_TEST_SCENARIO=static
      - SPOTFLOW_TEST_CONFIG_KEY=config-key
```

## zephyr/tests/logging/cbor/testcase.yaml
```yaml
common:
  tags:
    - spotflow
    - logging
  integration_platforms:
    - native_sim/native/64
    - qemu_cortex_m3
  platform_allow:
    - native_sim/native/64
    - qemu_cortex_m3
tests:
  spotflow.logging.cbor.compact: {}
  spotflow.logging.cbor.compact_timestamp_64bit:
    extra_configs:
      - CONFIG_LOG_TIMESTAMP_64BIT=y
  spotflow.logging.cbor.compact_with_output:
    extra_configs:
      - CONFIG_LOG_OUTPUT=y
  spotflow.logging.cbor.compact_stripped:
    platform_exclude:
      - native_sim/native/64
    extra_configs:
      - CONFIG_TEST_STRIPPED_LOGS=y
  spotflow.logging.cbor.compact_canonical:
    extra_configs:
      - CONFIG_ZCBOR_CANONICAL=y
  spotflow.logging.cbor.text:
    extra_configs:
      - CONFIG_TEST_COMPACT_LOGS=n
  spotflow.logging.cbor.text_canonical:
    extra_configs:
      - CONFIG_TEST_COMPACT_LOGS=n
      - CONFIG_ZCBOR_CANONICAL=y
```

## zephyr/tests/ota/attempt_model/testcase.yaml
```yaml
common:
  tags:
    - spotflow
    - ota
tests:
  spotflow.ota.attempt_model:
    platform_allow:
      - native_sim
    integration_platforms:
      - native_sim
```

## zephyr/tests/ota/ble_downloader/testcase.yaml
```yaml
common:
  tags:
    - spotflow
    - ota
    - bluetooth
tests:
  spotflow.ota.ble_downloader:
    platform_allow:
      - native_sim
      - qemu_cortex_m3
    integration_platforms:
      - native_sim
```

## zephyr/tests/ota/main_model/testcase.yaml
```yaml
common:
  tags:
    - spotflow
    - ota
tests:
  spotflow.ota.main_model:
    platform_allow:
      - native_sim
    integration_platforms:
      - native_sim
```
