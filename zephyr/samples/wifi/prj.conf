## CMakeLists.txt
```
# SPDX-License-Identifier: Apache-2.0

cmake_minimum_required(VERSION 3.20.0)

# TODO document in readme
if (EXISTS "${CMAKE_CURRENT_SOURCE_DIR}/credentials.conf")
    list(APPEND EXTRA_CONF_FILE "${CMAKE_CURRENT_SOURCE_DIR}/credentials.conf")
endif()


find_package(Zephyr REQUIRED HINTS $ENV{ZEPHYR_BASE})
project(wifi)

target_sources(app PRIVATE
        src/main.c
        src/wifi.c
)
```

## Kconfig
```
config NET_WIFI_SSID
	string "SSID device should connect to"
	help
		SSID of the wifi network that the device should connect to.

config NET_WIFI_PASSWORD
	string "Wifi Password device should connect to"
	help
		Wifi password for the network that the device should connect to.

source "Kconfig.zephyr"
```

## prj.conf
```kconfig
CONFIG_SPOTFLOW=y

#logging
CONFIG_PRINTK=y
CONFIG_LOG=y

# net
CONFIG_NETWORKING=y
CONFIG_NET_MGMT=y
CONFIG_NET_MGMT_EVENT=y
CONFIG_NET_MGMT_EVENT_INFO=y
CONFIG_NET_CONFIG_AUTO_INIT=n
CONFIG_NET_CONNECTION_MANAGER=y
CONFIG_NET_DHCPV4=y
CONFIG_NET_IPV4=y
CONFIG_NET_IPV6=n
CONFIG_NET_TCP=y
CONFIG_NET_UDP=y

# WIFI
CONFIG_WIFI=y
CONFIG_WIFI_NM=y
CONFIG_NET_L2_WIFI_MGMT=y

CONFIG_SPOTFLOW_PROCESSING_BACKEND_LOG_LEVEL=4
```

## boards/esp32c3_devkitc.conf
```kconfig
# WiFi Config
CONFIG_WIFI_ESP32=y
CONFIG_ESP32_WIFI_STA_AUTO_DHCPV4=y
CONFIG_ESP32_WIFI_STA_RECONNECT=y
```

## boards/frdm_rw612.conf
```kconfig
CONFIG_WIFI_NXP=y
CONFIG_NXP_RW610=y
CONFIG_ETH_DRIVER=n

# some nxp demo that is on by default and is messing up wifi
CONFIG_NXP_WIFI_SOFTAP_SUPPORT=n
```

## src/main.c
```c
#include <zephyr/bindesc.h>
#include <zephyr/kernel.h>
#include <zephyr/logging/log.h>

#include "wifi.h"

LOG_MODULE_REGISTER(MAIN, LOG_LEVEL_INF);

/* Uncomment this function to provide your own device ID in runtime */
/*const char* spotflow_override_device_id()
{
	return "my_nrf7002dk_test";
}*/

int main(void)
{
	LOG_INF("Starting Spotflow logging example");

	// Wait for the initialization of Wi-Fi device
	k_sleep(K_SECONDS(1));

	init_wifi();
	connect_to_wifi();

	for (int i = 0; i < 20; i++) {
		LOG_INF("Hello from Zephyr to Spotflow: %d", i);
		k_sleep(K_SECONDS(2));
	}

	return 0;
}
```

## src/wifi.c
```c
#include <zephyr/kernel.h>
#include <zephyr/logging/log.h>
#include <zephyr/net/wifi_mgmt.h>
#include <zephyr/net/dhcpv4_server.h>
#include "version_helper.h"
#include <zephyr/kernel_version.h>
#include <version.h>


LOG_MODULE_REGISTER(spotflow_sample_wifi, LOG_LEVEL_INF);

#define MACSTR "%02X:%02X:%02X:%02X:%02X:%02X"

#define NET_EVENT_WIFI_MASK                                                   \
	(NET_EVENT_WIFI_CONNECT_RESULT | NET_EVENT_WIFI_DISCONNECT_RESULT |   \
	 NET_EVENT_WIFI_AP_ENABLE_RESULT | NET_EVENT_WIFI_AP_DISABLE_RESULT | \
	 NET_EVENT_WIFI_AP_STA_CONNECTED | NET_EVENT_WIFI_AP_STA_DISCONNECTED)

#define WIFI_SSID CONFIG_NET_WIFI_SSID
#define WIFI_PSK CONFIG_NET_WIFI_PASSWORD

/* to provide backward compatibility for zephyr < 4.2.0 */

static struct net_if* sta_iface;

static struct wifi_connect_req_params sta_config;

static struct net_mgmt_event_callback cb;

static void wifi_event_handler(struct net_mgmt_event_callback* cb,
#if  SPOTFLOW_ZEPHYR_VERSION_GE(4,2)
			       uint64_t mgmt_event,
#else
			       uint32_t mgmt_event,
#endif
			       struct net_if* iface)
{
	switch (mgmt_event) {
	case NET_EVENT_WIFI_CONNECT_RESULT: {
		struct wifi_status* result = (struct wifi_status*)cb->info;

		if (result->status == 0) {
			LOG_INF("Connected to %s", WIFI_SSID);
		} else {
			LOG_ERR("Failed to connect to %s (status %d)", WIFI_SSID, result->status);
		}
		break;
	}
	case NET_EVENT_WIFI_DISCONNECT_RESULT: {
		struct wifi_status* result = (struct wifi_status*)cb->info;

		if (result->status == 0) {
			LOG_INF("Disconnected from %s", WIFI_SSID);
		} else {
			LOG_ERR("Unexpected disconnect from %s (reason %d)", WIFI_SSID,
				result->status);
		}
		break;
	}
	case NET_EVENT_WIFI_AP_ENABLE_RESULT: {
		LOG_INF("AP Mode is enabled. Waiting for station to connect");
		break;
	}
	case NET_EVENT_WIFI_AP_DISABLE_RESULT: {
		LOG_INF("AP Mode is disabled.");
		break;
	}
	case NET_EVENT_WIFI_AP_STA_CONNECTED: {
		struct wifi_ap_sta_info* sta_info = (struct wifi_ap_sta_info*)cb->info;

		LOG_INF("station: " MACSTR " joined ", sta_info->mac[0], sta_info->mac[1],
			sta_info->mac[2], sta_info->mac[3], sta_info->mac[4], sta_info->mac[5]);
		break;
	}
	case NET_EVENT_WIFI_AP_STA_DISCONNECTED: {
		struct wifi_ap_sta_info* sta_info = (struct wifi_ap_sta_info*)cb->info;

		LOG_INF("station: " MACSTR " leave ", sta_info->mac[0], sta_info->mac[1],
			sta_info->mac[2], sta_info->mac[3], sta_info->mac[4], sta_info->mac[5]);
		break;
	}
	default:
		break;
	}
}

int connect_to_wifi(void)
{
	if (!sta_iface) {
		LOG_ERR("STA: interface not initialized");
		return -EIO;
	}

	sta_config.ssid = (const uint8_t*)WIFI_SSID;
	sta_config.ssid_length = strlen(WIFI_SSID);
	sta_config.psk = (const uint8_t*)WIFI_PSK;
	sta_config.psk_length = strlen(WIFI_PSK);
	sta_config.security = WIFI_SECURITY_TYPE_PSK;
	sta_config.channel = WIFI_CHANNEL_ANY;
	sta_config.band = WIFI_FREQ_BAND_2_4_GHZ;

	LOG_INF("Connecting to SSID: %s\n", sta_config.ssid);

	int ret = net_mgmt(NET_REQUEST_WIFI_CONNECT, sta_iface, &sta_config,
			   sizeof(struct wifi_connect_req_params));
	if (ret) {
		LOG_ERR("Unable to Connect to (%s)", WIFI_SSID);
	}

	return ret;
}

int init_wifi(void)
{
	net_mgmt_init_event_callback(&cb, wifi_event_handler, NET_EVENT_WIFI_MASK);
	net_mgmt_add_event_callback(&cb);

	/* Get STA interface in AP-STA mode. */
	sta_iface = net_if_get_wifi_sta();

	return 0;
}
```
