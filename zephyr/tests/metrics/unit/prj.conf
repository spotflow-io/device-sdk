## CMakeLists.txt
```
# SPDX-License-Identifier: Apache-2.0

cmake_minimum_required(VERSION 3.20.0)
find_package(Zephyr REQUIRED HINTS $ENV{ZEPHYR_BASE})
project(spotflow_metrics_unit_test)

set(SPOTFLOW_MODULE_DIR ${CMAKE_CURRENT_SOURCE_DIR}/../../..)

# Test sources
target_sources(app PRIVATE
    src/main.c
    src/test_aggregator.c
    src/test_timeseries.c
    src/mocks.c
)

# Compile metrics module sources directly (bypassing full SDK dependencies)
target_sources(app PRIVATE
    ${SPOTFLOW_MODULE_DIR}/src/metrics/spotflow_metrics_aggregator.c
    ${SPOTFLOW_MODULE_DIR}/src/metrics/spotflow_metrics_backend.c
)

# Include paths
target_include_directories(app PRIVATE
    ${SPOTFLOW_MODULE_DIR}/src
    ${SPOTFLOW_MODULE_DIR}/src/metrics
)

# Define Kconfig symbols that the metrics module expects
target_compile_definitions(app PRIVATE
    CONFIG_SPOTFLOW_METRICS=1
    CONFIG_SPOTFLOW_METRICS_MAX_LABELS_PER_METRIC=4
    CONFIG_SPOTFLOW_METRICS_MAX_REGISTERED=32
    CONFIG_SPOTFLOW_METRICS_QUEUE_SIZE=16
    CONFIG_SPOTFLOW_METRICS_CBOR_BUFFER_SIZE=512
    CONFIG_SPOTFLOW_METRICS_PROCESSING_LOG_LEVEL=3
    CONFIG_SPOTFLOW_METRICS_HEARTBEAT=0
)
```

## prj.conf
```kconfig
# Ztest framework
CONFIG_ZTEST=y
CONFIG_ZTEST_NEW_API=y

# Memory
CONFIG_HEAP_MEM_POOL_SIZE=32768
CONFIG_MAIN_STACK_SIZE=4096

# Logging for debugging tests
CONFIG_LOG=y
CONFIG_LOG_DEFAULT_LEVEL=3

# Note: We don't enable CONFIG_SPOTFLOW because it requires networking/MQTT/TLS.
# Instead, we compile the metrics sources directly and mock dependencies.
# The Kconfig symbols below are defined locally for the test build.
```

## src/main.c
```c
/*
 * Copyright (c) 2024 Spotflow
 *
 * SPDX-License-Identifier: Apache-2.0
 *
 * Spotflow Metrics Unit Tests - Main Entry Point
 *
 * Test suites are registered in their respective files via ZTEST_SUITE macros.
 * Ztest framework auto-discovers and runs them.
 */

#include <zephyr/ztest.h>
```

## src/mocks.c
```c
/*
 * Copyright (c) 2024 Spotflow
 *
 * SPDX-License-Identifier: Apache-2.0
 *
 * Mock implementations for unit testing metrics module in isolation.
 * These stubs replace the real network/CBOR dependencies.
 */

#include <zephyr/kernel.h>
#include <stdint.h>
#include <stddef.h>
#include <errno.h>

/* Forward declare types from metrics module */
struct spotflow_metric_base;
struct metric_timeseries_state;
struct spotflow_label;

/*
 * Mock CBOR encoding - returns success and provides dummy encoded data
 *
 * In a real implementation, this would encode metrics to CBOR format.
 * For unit tests, we just allocate a small buffer to simulate success.
 */
int spotflow_metrics_cbor_encode(struct spotflow_metric_base *metric,
				 struct metric_timeseries_state *ts,
				 int64_t timestamp_ms, uint64_t seq_num,
				 uint8_t **cbor_data, size_t *cbor_len)
{
	/* Allocate minimal buffer to simulate encoding */
	*cbor_data = k_malloc(64);
	if (*cbor_data == NULL) {
		return -ENOMEM;
	}
	*cbor_len = 64;
	return 0;
}

int spotflow_metrics_cbor_encode_no_aggregation(struct spotflow_metric_base *metric,
						const struct spotflow_label *labels,
						uint8_t label_count, int64_t value_int,
						float value_float, int64_t timestamp_ms,
						uint64_t seq_num, uint8_t **cbor_data,
						size_t *cbor_len)
{
	*cbor_data = k_malloc(64);
	if (*cbor_data == NULL) {
		return -ENOMEM;
	}
	*cbor_len = 64;
	return 0;
}

/*
 * Mock message queue for metrics
 *
 * In the real implementation, this queue is defined in spotflow_metrics_net.c
 * For unit tests, we define it here with the same structure.
 */
struct spotflow_mqtt_metrics_msg {
	uint8_t *payload;
	size_t len;
};

K_MSGQ_DEFINE(g_spotflow_metrics_msgq, sizeof(struct spotflow_mqtt_metrics_msg *),
	      CONFIG_SPOTFLOW_METRICS_QUEUE_SIZE, sizeof(void *));

/*
 * Mock network initialization
 */
void spotflow_metrics_net_init(void)
{
	/* No-op for unit tests */
}
```

## src/test_aggregator.c
```c
/*
 * Copyright (c) 2024 Spotflow
 *
 * SPDX-License-Identifier: Apache-2.0
 *
 * Unit tests for metrics aggregator
 */

#include <zephyr/ztest.h>
#include <zephyr/kernel.h>
#include "metrics/spotflow_metrics_backend.h"
#include "metrics/spotflow_metrics_types.h"

/* Test fixture */
static struct spotflow_metric_int *g_test_metric;
static struct spotflow_metric_int *g_labeled_metric;

static void *aggregator_suite_setup(void)
{
	/* Initialize metrics subsystem */
	int rc = spotflow_metrics_init();
	zassert_equal(rc, 0, "Failed to initialize metrics subsystem");
	return NULL;
}

static void aggregator_before(void *fixture)
{
	ARG_UNUSED(fixture);
	g_test_metric = NULL;
	g_labeled_metric = NULL;
}

static void aggregator_after(void *fixture)
{
	ARG_UNUSED(fixture);
	/* Metrics are not unregistered in current implementation */
}

ZTEST_SUITE(aggregator, NULL, aggregator_suite_setup, aggregator_before, aggregator_after, NULL);

/*
 * Test: Register a simple label-less metric
 */
ZTEST(aggregator, test_register_labelless_metric)
{
	g_test_metric = spotflow_register_metric_int("test_counter", SPOTFLOW_AGG_INTERVAL_1MIN);

	zassert_not_null(g_test_metric, "Failed to register metric");
}

/*
 * Test: Register a labeled metric
 */
ZTEST(aggregator, test_register_labeled_metric)
{
	g_labeled_metric = spotflow_register_metric_int_with_labels(
		"test_labeled", SPOTFLOW_AGG_INTERVAL_1MIN, 4, 2);

	zassert_not_null(g_labeled_metric, "Failed to register labeled metric");
}

/*
 * Test: Report value to label-less metric
 */
ZTEST(aggregator, test_report_labelless_value)
{
	g_test_metric = spotflow_register_metric_int("report_test", SPOTFLOW_AGG_INTERVAL_1MIN);
	zassert_not_null(g_test_metric, "Failed to register metric");

	int rc = spotflow_report_metric_int(g_test_metric, 42);
	zassert_equal(rc, 0, "Failed to report value: %d", rc);

	rc = spotflow_report_metric_int(g_test_metric, 58);
	zassert_equal(rc, 0, "Failed to report second value: %d", rc);
}

/*
 * Test: Report value with labels
 */
ZTEST(aggregator, test_report_labeled_value)
{
	g_labeled_metric = spotflow_register_metric_int_with_labels(
		"labeled_report_test", SPOTFLOW_AGG_INTERVAL_1MIN, 4, 2);
	zassert_not_null(g_labeled_metric, "Failed to register labeled metric");

	struct spotflow_label labels[] = {
		{.key = "endpoint", .value = "/api/test"},
		{.key = "method", .value = "GET"}
	};

	int rc = spotflow_report_metric_int_with_labels(g_labeled_metric, 100, labels, 2);
	zassert_equal(rc, 0, "Failed to report labeled value: %d", rc);
}

/*
 * Test: Multiple label combinations create separate timeseries
 */
ZTEST(aggregator, test_multiple_label_combinations)
{
	g_labeled_metric = spotflow_register_metric_int_with_labels(
		"multi_label_test", SPOTFLOW_AGG_INTERVAL_1MIN, 4, 1);
	zassert_not_null(g_labeled_metric, "Failed to register metric");

	struct spotflow_label label_a = {.key = "status", .value = "200"};
	struct spotflow_label label_b = {.key = "status", .value = "404"};
	struct spotflow_label label_c = {.key = "status", .value = "500"};

	int rc = spotflow_report_metric_int_with_labels(g_labeled_metric, 10, &label_a, 1);
	zassert_equal(rc, 0, "Failed to report label_a");

	rc = spotflow_report_metric_int_with_labels(g_labeled_metric, 20, &label_b, 1);
	zassert_equal(rc, 0, "Failed to report label_b");

	rc = spotflow_report_metric_int_with_labels(g_labeled_metric, 30, &label_c, 1);
	zassert_equal(rc, 0, "Failed to report label_c");

	/* Report again to same label - should use existing timeseries */
	rc = spotflow_report_metric_int_with_labels(g_labeled_metric, 15, &label_a, 1);
	zassert_equal(rc, 0, "Failed to report to existing timeseries");
}

/*
 * Test: Timeseries pool exhaustion returns error
 */
ZTEST(aggregator, test_timeseries_pool_exhaustion)
{
	/* Create metric with only 2 timeseries slots */
	g_labeled_metric = spotflow_register_metric_int_with_labels(
		"pool_exhaust_test", SPOTFLOW_AGG_INTERVAL_1MIN, 2, 1);
	zassert_not_null(g_labeled_metric, "Failed to register metric");

	struct spotflow_label label1 = {.key = "id", .value = "1"};
	struct spotflow_label label2 = {.key = "id", .value = "2"};
	struct spotflow_label label3 = {.key = "id", .value = "3"};

	int rc = spotflow_report_metric_int_with_labels(g_labeled_metric, 1, &label1, 1);
	zassert_equal(rc, 0, "Failed to report label1");

	rc = spotflow_report_metric_int_with_labels(g_labeled_metric, 2, &label2, 1);
	zassert_equal(rc, 0, "Failed to report label2");

	/* Third unique label should fail - pool full, and existing ones have count > 0 */
	rc = spotflow_report_metric_int_with_labels(g_labeled_metric, 3, &label3, 1);
	zassert_equal(rc, -ENOSPC, "Expected -ENOSPC when pool is full, got %d", rc);
}

/*
 * Test: Duplicate metric name rejected
 */
ZTEST(aggregator, test_duplicate_name_rejected)
{
	struct spotflow_metric_int *metric1 = spotflow_register_metric_int(
		"duplicate_test", SPOTFLOW_AGG_INTERVAL_1MIN);
	zassert_not_null(metric1, "Failed to register first metric");

	struct spotflow_metric_int *metric2 = spotflow_register_metric_int(
		"duplicate_test", SPOTFLOW_AGG_INTERVAL_1MIN);
	zassert_is_null(metric2, "Should reject duplicate metric name");
}

/*
 * Test: Metric name normalization
 */
ZTEST(aggregator, test_name_normalization)
{
	/* Names with special chars should be normalized */
	struct spotflow_metric_int *metric = spotflow_register_metric_int(
		"My-Metric.Name With Spaces", SPOTFLOW_AGG_INTERVAL_1MIN);
	zassert_not_null(metric, "Failed to register metric with special chars");

	/* Registering the normalized version should fail (duplicate) */
	struct spotflow_metric_int *metric2 = spotflow_register_metric_int(
		"my_metric_name_with_spaces", SPOTFLOW_AGG_INTERVAL_1MIN);
	zassert_is_null(metric2, "Should reject as duplicate after normalization");
}

/*
 * Test: NULL metric handle rejected
 */
ZTEST(aggregator, test_null_metric_rejected)
{
	int rc = spotflow_report_metric_int(NULL, 42);
	zassert_equal(rc, -EINVAL, "Expected -EINVAL for NULL metric");
}

/*
 * Test: Invalid label count rejected
 */
ZTEST(aggregator, test_invalid_label_count)
{
	g_labeled_metric = spotflow_register_metric_int_with_labels(
		"label_count_test", SPOTFLOW_AGG_INTERVAL_1MIN, 4, 2);
	zassert_not_null(g_labeled_metric, "Failed to register metric");

	struct spotflow_label labels[] = {
		{.key = "a", .value = "1"},
		{.key = "b", .value = "2"},
		{.key = "c", .value = "3"}  /* One too many */
	};

	/* Reporting with 3 labels when max is 2 should fail */
	int rc = spotflow_report_metric_int_with_labels(g_labeled_metric, 100, labels, 3);
	zassert_equal(rc, -EINVAL, "Expected -EINVAL for too many labels, got %d", rc);
}
```

## src/test_timeseries.c
```c
/*
 * Copyright (c) 2024 Spotflow
 *
 * SPDX-License-Identifier: Apache-2.0
 *
 * Unit tests for timeseries management and eviction
 */

#include <zephyr/ztest.h>
#include <zephyr/kernel.h>
#include "metrics/spotflow_metrics_backend.h"
#include "metrics/spotflow_metrics_types.h"

/*
 * Note: Testing timeseries eviction is tricky because:
 * 1. Timeseries count is reset after aggregation timer fires
 * 2. We need to simulate the aggregation cycle
 *
 * For now, we test the basic behavior. Full eviction tests would
 * require either:
 * - Exposing internal APIs for testing
 * - Using longer test timeouts to let aggregation timers fire
 * - Mocking the timer system
 */

static struct spotflow_metric_int *g_evict_metric;

static void *timeseries_suite_setup(void)
{
	spotflow_metrics_init();
	return NULL;
}

static void timeseries_before(void *fixture)
{
	ARG_UNUSED(fixture);
	g_evict_metric = NULL;
}

ZTEST_SUITE(timeseries, NULL, timeseries_suite_setup, timeseries_before, NULL, NULL);

/*
 * Test: Timeseries reuse for same labels
 */
ZTEST(timeseries, test_timeseries_reuse)
{
	g_evict_metric = spotflow_register_metric_int_with_labels(
		"reuse_test", SPOTFLOW_AGG_INTERVAL_1MIN, 2, 1);
	zassert_not_null(g_evict_metric, "Failed to register metric");

	struct spotflow_label label = {.key = "id", .value = "same"};

	/* Report multiple values with same label - should reuse same timeseries */
	for (int i = 0; i < 10; i++) {
		int rc = spotflow_report_metric_int_with_labels(g_evict_metric, i * 10, &label, 1);
		zassert_equal(rc, 0, "Failed to report value %d: %d", i, rc);
	}
}

/*
 * Test: Float metric with labels
 */
ZTEST(timeseries, test_float_metric_with_labels)
{
	struct spotflow_metric_float *float_metric = spotflow_register_metric_float_with_labels(
		"float_labeled_test", SPOTFLOW_AGG_INTERVAL_1MIN, 4, 2);
	zassert_not_null(float_metric, "Failed to register float metric");

	struct spotflow_label labels[] = {
		{.key = "sensor", .value = "temp1"},
		{.key = "unit", .value = "celsius"}
	};

	int rc = spotflow_report_metric_float_with_labels(float_metric, 23.5f, labels, 2);
	zassert_equal(rc, 0, "Failed to report float value: %d", rc);

	rc = spotflow_report_metric_float_with_labels(float_metric, 24.1f, labels, 2);
	zassert_equal(rc, 0, "Failed to report second float value: %d", rc);
}

/*
 * Test: Immediate metric (PT0S / no aggregation)
 */
ZTEST(timeseries, test_immediate_metric)
{
	struct spotflow_metric_int *immediate = spotflow_register_metric_int(
		"immediate_test", SPOTFLOW_AGG_INTERVAL_NONE);
	zassert_not_null(immediate, "Failed to register immediate metric");

	/* Immediate metrics should work without aggregation timer */
	for (int i = 0; i < 5; i++) {
		int rc = spotflow_report_metric_int(immediate, i * 100);
		zassert_equal(rc, 0, "Failed to report immediate value %d: %d", i, rc);
	}
}

/*
 * Test: Event reporting
 */
ZTEST(timeseries, test_event_reporting)
{
	struct spotflow_metric_int *event_metric = spotflow_register_metric_int(
		"event_test", SPOTFLOW_AGG_INTERVAL_NONE);
	zassert_not_null(event_metric, "Failed to register event metric");

	int rc = spotflow_report_event(event_metric);
	zassert_equal(rc, 0, "Failed to report event: %d", rc);
}

/*
 * Test: Event with labels
 */
ZTEST(timeseries, test_event_with_labels)
{
	struct spotflow_metric_int *event_metric = spotflow_register_metric_int_with_labels(
		"labeled_event_test", SPOTFLOW_AGG_INTERVAL_NONE, 4, 2);
	zassert_not_null(event_metric, "Failed to register labeled event metric");

	struct spotflow_label labels[] = {
		{.key = "type", .value = "button_press"},
		{.key = "button", .value = "power"}
	};

	int rc = spotflow_report_event_with_labels(event_metric, labels, 2);
	zassert_equal(rc, 0, "Failed to report labeled event: %d", rc);
}

/*
 * Test: Label key too long
 */
ZTEST(timeseries, test_label_key_too_long)
{
	g_evict_metric = spotflow_register_metric_int_with_labels(
		"long_key_test", SPOTFLOW_AGG_INTERVAL_1MIN, 4, 1);
	zassert_not_null(g_evict_metric, "Failed to register metric");

	/* Key longer than SPOTFLOW_MAX_LABEL_KEY_LEN (16) */
	struct spotflow_label label = {
		.key = "this_key_is_way_too_long_for_the_limit",
		.value = "ok"
	};

	int rc = spotflow_report_metric_int_with_labels(g_evict_metric, 1, &label, 1);
	zassert_not_equal(rc, 0, "Should reject overly long label key");
}

/*
 * Test: Label value too long
 */
ZTEST(timeseries, test_label_value_too_long)
{
	g_evict_metric = spotflow_register_metric_int_with_labels(
		"long_value_test", SPOTFLOW_AGG_INTERVAL_1MIN, 4, 1);
	zassert_not_null(g_evict_metric, "Failed to register metric");

	/* Value longer than SPOTFLOW_MAX_LABEL_VALUE_LEN (32) */
	struct spotflow_label label = {
		.key = "status",
		.value = "this_value_is_definitely_way_too_long_for_the_configured_limit"
	};

	int rc = spotflow_report_metric_int_with_labels(g_evict_metric, 1, &label, 1);
	zassert_not_equal(rc, 0, "Should reject overly long label value");
}

/*
 * Test: NULL label key rejected
 */
ZTEST(timeseries, test_null_label_key)
{
	g_evict_metric = spotflow_register_metric_int_with_labels(
		"null_key_test", SPOTFLOW_AGG_INTERVAL_1MIN, 4, 1);
	zassert_not_null(g_evict_metric, "Failed to register metric");

	struct spotflow_label label = {.key = NULL, .value = "test"};

	int rc = spotflow_report_metric_int_with_labels(g_evict_metric, 1, &label, 1);
	zassert_not_equal(rc, 0, "Should reject NULL label key");
}

/*
 * Test: NULL label value rejected
 */
ZTEST(timeseries, test_null_label_value)
{
	g_evict_metric = spotflow_register_metric_int_with_labels(
		"null_value_test", SPOTFLOW_AGG_INTERVAL_1MIN, 4, 1);
	zassert_not_null(g_evict_metric, "Failed to register metric");

	struct spotflow_label label = {.key = "test", .value = NULL};

	int rc = spotflow_report_metric_int_with_labels(g_evict_metric, 1, &label, 1);
	zassert_not_equal(rc, 0, "Should reject NULL label value");
}

/*
 * Test: Using labeled API on label-less metric fails
 */
ZTEST(timeseries, test_labeled_api_on_labelless_metric)
{
	struct spotflow_metric_int *labelless = spotflow_register_metric_int(
		"labelless_api_test", SPOTFLOW_AGG_INTERVAL_1MIN);
	zassert_not_null(labelless, "Failed to register metric");

	struct spotflow_label label = {.key = "test", .value = "value"};

	int rc = spotflow_report_metric_int_with_labels(labelless, 1, &label, 1);
	zassert_equal(rc, -EINVAL, "Should reject labeled API on label-less metric");
}

/*
 * Test: Using label-less API on labeled metric fails
 */
ZTEST(timeseries, test_labelless_api_on_labeled_metric)
{
	struct spotflow_metric_int *labeled = spotflow_register_metric_int_with_labels(
		"labeled_api_test", SPOTFLOW_AGG_INTERVAL_1MIN, 4, 1);
	zassert_not_null(labeled, "Failed to register metric");

	int rc = spotflow_report_metric_int(labeled, 1);
	zassert_equal(rc, -EINVAL, "Should reject label-less API on labeled metric");
}
```
