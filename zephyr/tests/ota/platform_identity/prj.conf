## CMakeLists.txt
```
cmake_minimum_required(VERSION 3.20.0)

find_package(Zephyr REQUIRED HINTS $ENV{ZEPHYR_BASE})
project(spotflow_ota_platform_identity)

target_include_directories(app PRIVATE
        ${CMAKE_CURRENT_LIST_DIR}/../../../include
        ${CMAKE_CURRENT_LIST_DIR}/../../../src
        ${CMAKE_CURRENT_LIST_DIR}/../common
)

target_compile_definitions(app PRIVATE
        CONFIG_SPOTFLOW_MODULE_DEFAULT_LOG_LEVEL=3
        CONFIG_SPOTFLOW_OTA_LOG_LEVEL=3
        CONFIG_SPOTFLOW_OTA=1
        CONFIG_SPOTFLOW_OTA_DOWNLOAD_BUFFER_SIZE=1024
)

target_sources(app PRIVATE
        src/main.c
        src/identity_stream.c
        src/mcuboot_stream.c
        ../../../src/ota/platform/mcuboot/spotflow_ota_mcuboot_stream.c
        ../common/spotflow_ota_bindesc_test_util.c
        ../common/spotflow_ota_build_id_fake.c
        ../common/spotflow_ota_platform_fake.c
        ../../../src/ota/platform/spotflow_ota_identity_stream.c
        ../../../src/ota/platform/spotflow_ota_identity.c
)
```

## prj.conf
```kconfig
CONFIG_ZTEST=y
CONFIG_BINDESC=y
CONFIG_BINDESC_DEFINE=y
```

## src/main.c
```c
#include <errno.h>
#include <string.h>

#include <zephyr/logging/log.h>
#include <zephyr/ztest.h>

#include "spotflow_build_id.h"
#include "ota/platform/spotflow_ota_identity.h"
#include "ota/platform/spotflow_ota_platform.h"
#include "spotflow_ota_bindesc_test_util.h"
#include "spotflow_ota_build_id_fake.h"
#include "spotflow_ota_platform_fake.h"

LOG_MODULE_REGISTER(spotflow_ota);

static struct spotflow_ota_platform_fake* fake;

static void before_each(void* fixture)
{
	ARG_UNUSED(fixture);

	spotflow_ota_build_id_fake_reset(spotflow_ota_build_id_fake_get());
	spotflow_ota_platform_fake_reset(spotflow_ota_platform_fake_get());
	fake = spotflow_ota_platform_fake_get();
}

static void write_bindesc_build_id(size_t offset, const uint8_t build_id[SPOTFLOW_BUILD_ID_LENGTH])
{
	size_t end = spotflow_ota_test_bindesc_write_build_id(
		fake->upload_slot, sizeof(fake->upload_slot), offset, build_id);

	zassert_true(end > 0);
	fake->upload_image_start = 0;
	fake->upload_image_size = end;
}

ZTEST(spotflow_ota_platform_identity, test_platform_fake_records_upgrade_confirm_reboot)
{
	bool reboot_required;
	enum spotflow_ota_running_image_state state;
	zassert_ok(spotflow_ota_platform_request_upgrade());
	zassert_ok(spotflow_ota_platform_confirm_image(&reboot_required));
	spotflow_ota_platform_reboot();

	zassert_equal(fake->upgrade_request_count, 1);
	zassert_equal(fake->confirm_count, 1);
	zassert_equal(fake->reboot_count, 1);
	zassert_ok(spotflow_ota_platform_get_running_image_state(&state));
	zassert_equal(state, SPOTFLOW_OTA_RUNNING_IMAGE_CONFIRMED);
	zassert_false(reboot_required);
}

ZTEST(spotflow_ota_platform_identity, test_platform_fake_propagates_errors)
{
	bool reboot_required;
	enum spotflow_ota_running_image_state state;
	fake->upgrade_request_result = -EIO;
	fake->confirm_result = -EIO;

	zassert_equal(spotflow_ota_platform_request_upgrade(), -EIO);
	zassert_equal(spotflow_ota_platform_confirm_image(&reboot_required), -EIO);
	zassert_ok(spotflow_ota_platform_get_running_image_state(&state));
	zassert_equal(state, SPOTFLOW_OTA_RUNNING_IMAGE_UNCONFIRMED);
}

ZTEST(spotflow_ota_platform_identity, test_identity_compare_unavailable_when_running_missing)
{
	uint8_t expected[SPOTFLOW_BUILD_ID_LENGTH] = { 0x01 };

	zassert_equal(spotflow_ota_identity_compare_probation(expected),
		      SPOTFLOW_OTA_IDENTITY_UNAVAILABLE);
}

ZTEST(spotflow_ota_platform_identity, test_identity_compare_match_and_mismatch)
{
	uint8_t running[SPOTFLOW_BUILD_ID_LENGTH];
	uint8_t expected[SPOTFLOW_BUILD_ID_LENGTH];

	for (size_t i = 0; i < SPOTFLOW_BUILD_ID_LENGTH; i++) {
		expected[i] = (uint8_t)(0xC0 + i);
	}

	spotflow_ota_build_id_fake_set_running_build_id(expected);
	zassert_ok(spotflow_ota_identity_get_running_build_id(running));
	zassert_mem_equal(expected, running, SPOTFLOW_BUILD_ID_LENGTH);

	zassert_equal(spotflow_ota_identity_compare_probation(expected),
		      SPOTFLOW_OTA_IDENTITY_MATCH);

	expected[0] ^= 0xff;
	zassert_equal(spotflow_ota_identity_compare_probation(expected),
		      SPOTFLOW_OTA_IDENTITY_MISMATCH);
}

ZTEST(spotflow_ota_platform_identity, test_identity_reads_downloaded_build_id)
{
	uint8_t expected[SPOTFLOW_BUILD_ID_LENGTH];
	uint8_t downloaded[SPOTFLOW_BUILD_ID_LENGTH];

	for (size_t i = 0; i < SPOTFLOW_BUILD_ID_LENGTH; i++) {
		expected[i] = (uint8_t)(0xA0 + i);
	}

	write_bindesc_build_id(32, expected);

	zassert_ok(spotflow_ota_platform_get_downloaded_build_id(downloaded));
	zassert_mem_equal(expected, downloaded, SPOTFLOW_BUILD_ID_LENGTH);
}

ZTEST(spotflow_ota_platform_identity, test_identity_reads_downloaded_build_id_across_chunk_boundary)
{
	uint8_t expected[SPOTFLOW_BUILD_ID_LENGTH];
	uint8_t downloaded[SPOTFLOW_BUILD_ID_LENGTH];

	for (size_t i = 0; i < SPOTFLOW_BUILD_ID_LENGTH; i++) {
		expected[i] = (uint8_t)(0xB0 + i);
	}

	write_bindesc_build_id(252, expected);

	zassert_ok(spotflow_ota_platform_get_downloaded_build_id(downloaded));
	zassert_mem_equal(expected, downloaded, SPOTFLOW_BUILD_ID_LENGTH);
}

ZTEST(spotflow_ota_platform_identity, test_downloaded_build_id_read_failure)
{
	fake->image_info_result = -EIO;

	uint8_t downloaded[SPOTFLOW_BUILD_ID_LENGTH];

	zassert_equal(spotflow_ota_platform_get_downloaded_build_id(downloaded), -EIO);
}

ZTEST(spotflow_ota_platform_identity, test_downloaded_build_id_missing_bindesc)
{
	fake->upload_image_start = 0;
	fake->upload_image_size = 64;

	uint8_t downloaded[SPOTFLOW_BUILD_ID_LENGTH];

	zassert_equal(spotflow_ota_platform_get_downloaded_build_id(downloaded), -ENOENT);
}

ZTEST_SUITE(spotflow_ota_platform_identity, NULL, NULL, before_each, NULL, NULL);
```

## src/mcuboot_stream.c
```c
#include "ota/platform/mcuboot/spotflow_ota_mcuboot_stream.h"
#include "spotflow_ota_bindesc_test_util.h"

#include <errno.h>
#include <string.h>

#include <zephyr/sys/byteorder.h>
#include <zephyr/ztest.h>

#define PAYLOAD_START 96
#define PAYLOAD_SIZE 64

static uint8_t image[224];
static uint8_t build_id[SPOTFLOW_BUILD_ID_LENGTH];

static void before_each(void* fixture);
static int feed_image(struct spotflow_ota_mcuboot_stream* stream, size_t split, size_t length);

ZTEST(spotflow_ota_mcuboot_stream, test_every_split_skips_header_padding_and_trailer)
{
	uint8_t actual[SPOTFLOW_BUILD_ID_LENGTH];

	for (size_t split = 0; split <= sizeof(image); split++) {
		struct spotflow_ota_mcuboot_stream stream = { 0 };

		zassert_ok(feed_image(&stream, split, sizeof(image)));
		zassert_ok(spotflow_ota_mcuboot_stream_get_build_id(&stream, actual));
		zassert_mem_equal(actual, build_id, sizeof(actual));
	}
}

ZTEST(spotflow_ota_mcuboot_stream, test_single_byte_blocks)
{
	struct spotflow_ota_mcuboot_stream stream = { 0 };
	uint8_t actual[SPOTFLOW_BUILD_ID_LENGTH];

	for (size_t i = 0; i < sizeof(image); i++) {
		struct spotflow_artifact_block block = {
			.data = image + i,
			.data_len = 1,
			.offset = i,
			.is_last = i == sizeof(image) - 1,
		};

		zassert_ok(spotflow_ota_mcuboot_stream_feed(&stream, &block, sizeof(image)));
	}
	zassert_ok(spotflow_ota_mcuboot_stream_get_build_id(&stream, actual));
	zassert_mem_equal(actual, build_id, sizeof(actual));
}

ZTEST(spotflow_ota_mcuboot_stream, test_descriptors_outside_payload_cannot_supply_identity)
{
	struct spotflow_ota_mcuboot_stream stream = { 0 };
	uint8_t actual[SPOTFLOW_BUILD_ID_LENGTH];

	memset(image + PAYLOAD_START, 0xff, PAYLOAD_SIZE);
	zassert_ok(feed_image(&stream, 1, sizeof(image)));
	zassert_equal(spotflow_ota_mcuboot_stream_get_build_id(&stream, actual), -ENOENT);
}

ZTEST(spotflow_ota_mcuboot_stream, test_rejects_bad_magic_size_and_encoding)
{
	struct spotflow_ota_mcuboot_stream stream = { 0 };

	image[0] = 0;
	zassert_equal(feed_image(&stream, 1, sizeof(image)), -EBADMSG);
	memset(&stream, 0, sizeof(stream));
	sys_put_le32(0x96f3b83d, image);
	sys_put_le32(UINT32_MAX, image + 12);
	zassert_equal(feed_image(&stream, 1, sizeof(image)), -EBADMSG);
	memset(&stream, 0, sizeof(stream));
	sys_put_le32(PAYLOAD_SIZE, image + 12);
	sys_put_le32(BIT(2), image + 16);
	zassert_equal(feed_image(&stream, 1, sizeof(image)), -ENOTSUP);
}

ZTEST(spotflow_ota_mcuboot_stream, test_truncated_payload_cannot_supply_identity)
{
	struct spotflow_ota_mcuboot_stream stream = { 0 };
	uint8_t actual[SPOTFLOW_BUILD_ID_LENGTH];

	zassert_equal(feed_image(&stream, 1, PAYLOAD_START + PAYLOAD_SIZE - 1), -EBADMSG);
	zassert_equal(spotflow_ota_mcuboot_stream_get_build_id(&stream, actual), -EBADMSG);
}

ZTEST(spotflow_ota_mcuboot_stream, test_rejects_wrong_offset_and_storage_overflow)
{
	struct spotflow_ota_mcuboot_stream stream = { 0 };
	struct spotflow_artifact_block block = {
		.data = image,
		.data_len = sizeof(image),
		.offset = 1,
	};

	zassert_equal(spotflow_ota_mcuboot_stream_feed(&stream, &block, sizeof(image)), -EINVAL);
	block.offset = 0;
	zassert_equal(spotflow_ota_mcuboot_stream_feed(&stream, &block, sizeof(image) - 1), -EFBIG);
}

static int feed_image(struct spotflow_ota_mcuboot_stream* stream, size_t split, size_t length)
{
	struct spotflow_artifact_block block = {
		.data = image,
		.data_len = split,
	};
	int rc = spotflow_ota_mcuboot_stream_feed(stream, &block, sizeof(image));

	if (rc < 0) {
		return rc;
	}
	block.data += split;
	block.offset = split;
	block.data_len = length - split;
	block.is_last = true;
	return spotflow_ota_mcuboot_stream_feed(stream, &block, sizeof(image));
}

static void before_each(void* fixture)
{
	ARG_UNUSED(fixture);
	memset(image, 0, sizeof(image));
	memset(build_id, 0x55, sizeof(build_id));
	sys_put_le32(0x96f3b83d, image);
	sys_put_le16(PAYLOAD_START, image + 8);
	sys_put_le32(PAYLOAD_SIZE, image + 12);
	uint8_t other_id[SPOTFLOW_BUILD_ID_LENGTH] = { 0x99 };

	zassert_true(spotflow_ota_test_bindesc_write_build_id(image, sizeof(image), 40, other_id));
	zassert_true(spotflow_ota_test_bindesc_write_build_id(image, sizeof(image), PAYLOAD_START,
							      build_id));
	zassert_true(spotflow_ota_test_bindesc_write_build_id(
		image, sizeof(image), PAYLOAD_START + PAYLOAD_SIZE, other_id));
}

ZTEST_SUITE(spotflow_ota_mcuboot_stream, NULL, NULL, before_each, NULL, NULL);
```
