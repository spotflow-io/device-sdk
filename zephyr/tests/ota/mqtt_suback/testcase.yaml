## zephyr/tests/ota/mqtt_suback/testcase.yaml
```yaml
common:
  tags:
    - spotflow
    - ota
tests:
  spotflow.ota.mqtt_suback:
    platform_allow:
      - native_sim
    integration_platforms:
      - native_sim
```

## zephyr/tests/persistent_buffer/testcase.yaml
```yaml
common:
  tags:
    - spotflow
    - persistent_buffer
    - unit

tests:
  spotflow.persistent_buffer:
    integration_platforms:
      - qemu_cortex_m3
    platform_allow:
      - qemu_cortex_m3
      - native_sim
      - native_sim/native/64
  spotflow.persistent_buffer.write_block_1:
    extra_args: EXTRA_DTC_OVERLAY_FILE=write_block_1.overlay
    integration_platforms:
      - qemu_cortex_m3
    platform_allow:
      - qemu_cortex_m3
```

## zephyr/tests/session_metadata/testcase.yaml
```yaml
tests:
  spotflow.session_metadata:
    integration_platforms:
      - native_sim
    platform_allow:
      - native_sim
    tags:
      - spotflow
      - session_metadata
      - unit
```
