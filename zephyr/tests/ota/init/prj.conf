## CMakeLists.txt
```
cmake_minimum_required(VERSION 3.20.0)

find_package(Zephyr REQUIRED HINTS $ENV{ZEPHYR_BASE})
project(spotflow_ota_init)

zephyr_linker_sources(
        DATA_SECTIONS
        ../../../src/ota/downloader/spotflow_ota_downloader.ld
)
zephyr_iterable_section(
        NAME spotflow_downloader
        GROUP DATA_REGION
        ${XIP_ALIGN_WITH_INPUT}
)

target_include_directories(app PRIVATE
        ${CMAKE_CURRENT_LIST_DIR}/../../../include
        ${CMAKE_CURRENT_LIST_DIR}/../../../src
        ${CMAKE_CURRENT_LIST_DIR}/../common
        ${CMAKE_CURRENT_LIST_DIR}/../downloader
)

target_compile_definitions(app PRIVATE
        CONFIG_SPOTFLOW=1
        CONFIG_SPOTFLOW_GENERATE_BUILD_ID=1
        CONFIG_SPOTFLOW_MODULE_DEFAULT_LOG_LEVEL=3
        CONFIG_SPOTFLOW_OTA_LOG_LEVEL=3
        CONFIG_SPOTFLOW_OTA=1
        CONFIG_SPOTFLOW_OTA_MAX_ARTIFACTS=4
        CONFIG_SPOTFLOW_OTA_AUTO_HANDLE_MAIN_FIRMWARE=1
        CONFIG_SPOTFLOW_OTA_DOWNLOAD_RETRY_INITIAL_DELAY_MS=1
        CONFIG_SPOTFLOW_OTA_DOWNLOAD_RETRY_MAX_DELAY_MS=1
        CONFIG_SPOTFLOW_OTA_HTTP_TIMEOUT_MS=1000
        CONFIG_SPOTFLOW_OTA_DOWNLOAD_BUFFER_SIZE=1024
)

target_sources(app PRIVATE
        src/main.c
        ../common/spotflow_ota_build_id_fake.c
        ../common/spotflow_ota_platform_fake.c
        ../../../src/ota/platform/spotflow_ota_identity_stream.c
        ../common/spotflow_ota_test_fakes.c
        ../common/spotflow_ota_test_transport_stubs.c
        ../common/spotflow_ota_test_settings.c
        ../downloader/spotflow_ota_downloader_transport_fake.c
        ../../../src/ota/spotflow_ota.c
        ../../../src/ota/protocol/spotflow_ota_cbor.c
        ../../../src/ota/downloader/spotflow_ota_downloader.c
        ../../../src/ota/downloader/spotflow_ota_downloader_http.c
        ../../../src/ota/downloader/spotflow_ota_downloader_transport_errors.c
        ../../../src/ota/downloader/spotflow_ota_downloader_transport_range.c
        ../../../src/ota/firmware/spotflow_ota_fw_custom.c
        ../../../src/ota/firmware/spotflow_ota_fw_main.c
        ../../../src/ota/core/spotflow_ota_log.c
        ../../../src/ota/core/spotflow_ota_results.c
        ../../../src/ota/core/spotflow_ota_attempt_model.c
        ../../../src/ota/core/spotflow_ota_main_model.c
        ../../../src/ota/core/spotflow_ota_worker.c
        ../../../src/ota/platform/spotflow_ota_identity.c
        ../../../src/ota/protocol/spotflow_ota_net.c
        ../../../src/ota/persistence/spotflow_ota_persistence.c
        ../../../src/ota/persistence/spotflow_ota_records_cbor.c
        ../../../src/ota/core/spotflow_ota_state.c
        ../../../src/ota/downloader/spotflow_ota_url.c
        ${ZEPHYR_BASE}/subsys/net/lib/http/http_parser_url.c
)
```

## prj.conf
```kconfig
CONFIG_ZTEST=y
CONFIG_TEST_RANDOM_GENERATOR=y
CONFIG_ZCBOR=y
CONFIG_BINDESC=y
CONFIG_BINDESC_DEFINE=y
CONFIG_SPOTFLOW_OTA_AUTO_HANDLE_MAIN_FIRMWARE=y
CONFIG_SPOTFLOW_OTA_DOWNLOAD_RETRY_INITIAL_DELAY_MS=1
CONFIG_SPOTFLOW_OTA_DOWNLOAD_RETRY_MAX_DELAY_MS=1
CONFIG_SPOTFLOW_OTA_HTTP_TIMEOUT_MS=1000
CONFIG_SPOTFLOW_OTA_DOWNLOAD_BUFFER_SIZE=1024
```

## src/main.c
```c
#include <errno.h>
#include <string.h>

#include <zephyr/ztest.h>

#include <spotflow/ota.h>

#include "ota/spotflow_ota.h"
#include "ota/firmware/spotflow_ota_fw_main.h"
#include "ota/persistence/spotflow_ota_persistence.h"
#include "spotflow_build_id.h"
#include "spotflow_ota_build_id_fake.h"
#include "spotflow_ota_platform_fake.h"
#include "spotflow_ota_test_fakes.h"
#include "spotflow_ota_test_settings.h"

static size_t progress_call_count;
static int callback_get_state_result;
static int callback_get_info_result;
static uint64_t callback_last_attempt_id;
static struct spotflow_ota_main_firmware_state callback_state;

static void fill_state_sentinel(struct spotflow_ota_main_firmware_state* state)
{
	memset(state, 0xa5, sizeof(*state));
}

static void assert_state_unchanged(const struct spotflow_ota_main_firmware_state* state,
				   const struct spotflow_ota_main_firmware_state* expected)
{
	zassert_mem_equal(state, expected, sizeof(*state));
}

void spotflow_on_main_firmware_update_progressed(
	const struct spotflow_ota_main_firmware_state* state)
{
	struct spotflow_download_request request;
	struct spotflow_firmware_info info;

	progress_call_count++;
	callback_get_state_result = spotflow_get_main_firmware_update_state(&callback_state);
	callback_get_info_result = spotflow_get_main_firmware_update_info(&info, &request);
	callback_last_attempt_id = spotflow_ota_get_last_received_attempt_id();

	zassert_not_null(state);
	zassert_equal(state->phase, callback_state.phase);
	zassert_equal(state->result, callback_state.result);
}

static void fill_build_id(uint8_t build_id[SPOTFLOW_BUILD_ID_LENGTH])
{
	for (size_t i = 0; i < SPOTFLOW_BUILD_ID_LENGTH; i++) {
		build_id[i] = (uint8_t)(0x20 + i);
	}
}

static void persist_unconfirmed_update(const uint8_t build_id[SPOTFLOW_BUILD_ID_LENGTH])
{
	struct spotflow_ota_persisted_attempt attempt = {
		.attempt_id = 42,
		.artifact_count = 1,
		.artifact_results = { SPOTFLOW_OTA_RESULT_PENDING },
	};
	struct spotflow_ota_probation probation = {
		.attempt_id = 42,
		.artifact_index = 0,
	};

	strncpy(probation.slug, "main", sizeof(probation.slug) - 1);
	strncpy(probation.version, "1.0.0", sizeof(probation.version) - 1);
	memcpy(probation.expected_build_id, build_id, SPOTFLOW_BUILD_ID_LENGTH);

	zassert_ok(spotflow_ota_persistence_save_attempt(&attempt));
	zassert_ok(spotflow_ota_persistence_save_probation(&probation));
}

static void before_each(void* fixture)
{
	uint8_t build_id[SPOTFLOW_BUILD_ID_LENGTH];

	ARG_UNUSED(fixture);
	spotflow_ota_test_settings_reset();
	spotflow_ota_test_fakes_reset();
	spotflow_ota_reset();
	spotflow_ota_build_id_fake_reset(spotflow_ota_build_id_fake_get());
	spotflow_ota_platform_fake_reset(spotflow_ota_platform_fake_get());
	zassert_ok(spotflow_ota_persistence_init());

	fill_build_id(build_id);
	spotflow_ota_build_id_fake_set_running_build_id(build_id);
	spotflow_ota_platform_fake_get()->image_confirmed = false;
	persist_unconfirmed_update(build_id);

	progress_call_count = 0;
	callback_get_state_result = -1;
	callback_get_info_result = 0;
	callback_last_attempt_id = 0;
	memset(&callback_state, 0, sizeof(callback_state));
}

ZTEST(spotflow_ota_init, test_startup_callback_can_reenter_public_apis)
{
	zassert_ok(spotflow_ota_init());

	zassert_equal(progress_call_count, 1);
	zassert_ok(callback_get_state_result);
	zassert_ok(callback_get_info_result);
	zassert_equal(callback_last_attempt_id, 42);
	zassert_equal(callback_state.phase, SPOTFLOW_OTA_PHASE_UNCONFIRMED);
	zassert_equal(callback_state.result, SPOTFLOW_OTA_RESULT_PENDING);
}

ZTEST(spotflow_ota_init, test_control_apis_leave_state_unchanged_on_initialization_error)
{
	struct spotflow_ota_main_firmware_state state;
	struct spotflow_ota_main_firmware_state sentinel;

	fill_state_sentinel(&sentinel);
	spotflow_ota_test_settings_set_init_result(-EIO);

	state = sentinel;
	zassert_equal(spotflow_pause_main_firmware_update(&state), -EIO);
	assert_state_unchanged(&state, &sentinel);

	state = sentinel;
	zassert_equal(spotflow_resume_main_firmware_update(&state), -EIO);
	assert_state_unchanged(&state, &sentinel);

	state = sentinel;
	zassert_equal(spotflow_abort_main_firmware_update(&state), -EIO);
	assert_state_unchanged(&state, &sentinel);

	state = sentinel;
	zassert_equal(spotflow_confirm_main_firmware_image(&state), -EIO);
	assert_state_unchanged(&state, &sentinel);
}

ZTEST(spotflow_ota_init, test_control_apis_leave_state_unchanged_on_operation_error)
{
	struct spotflow_ota_main_firmware_state state;
	struct spotflow_ota_main_firmware_state sentinel;

	zassert_ok(spotflow_ota_init());
	fill_state_sentinel(&sentinel);

	state = sentinel;
	zassert_equal(spotflow_pause_main_firmware_update(&state), -EINVAL);
	assert_state_unchanged(&state, &sentinel);

	state = sentinel;
	zassert_equal(spotflow_resume_main_firmware_update(&state), -EINVAL);
	assert_state_unchanged(&state, &sentinel);

	state = sentinel;
	zassert_equal(spotflow_abort_main_firmware_update(&state), -EINVAL);
	assert_state_unchanged(&state, &sentinel);

	state = sentinel;
	spotflow_ota_platform_fake_get()->confirm_result = -EIO;
	zassert_equal(spotflow_confirm_main_firmware_image(&state), -EIO);
	assert_state_unchanged(&state, &sentinel);
}

ZTEST_SUITE(spotflow_ota_init, NULL, NULL, before_each, NULL, NULL);
```
