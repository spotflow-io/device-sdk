## CMakeLists.txt
```
cmake_minimum_required(VERSION 3.20.0)

find_package(Zephyr REQUIRED HINTS $ENV{ZEPHYR_BASE})
project(spotflow_ota_cbor)

set(SPOTFLOW_TEST_MAX_ARTIFACTS 4 CACHE STRING "Maximum manifest artifacts for this test build")

target_include_directories(app PRIVATE
        ${CMAKE_CURRENT_LIST_DIR}/../../../include
        ${CMAKE_CURRENT_LIST_DIR}/../../../src
)

target_compile_definitions(app PRIVATE
        CONFIG_SPOTFLOW_MODULE_DEFAULT_LOG_LEVEL=3
        CONFIG_SPOTFLOW_OTA_DOWNLOAD_BUFFER_SIZE=512
        CONFIG_SPOTFLOW_OTA_LOG_LEVEL=3
        CONFIG_SPOTFLOW_OTA_MAX_ARTIFACTS=${SPOTFLOW_TEST_MAX_ARTIFACTS}
)

target_sources(app PRIVATE
        src/main.c
        ../../../src/ota/protocol/spotflow_ota_cbor.c
)
```

## prj.conf
```kconfig
CONFIG_ZTEST=y
CONFIG_ZCBOR=y
CONFIG_ZTEST_STACK_SIZE=4096
```

## src/main.c
```c
#include <errno.h>
#include <string.h>

#include <zcbor_encode.h>

#include <zephyr/logging/log.h>
#include <zephyr/ztest.h>

#include "ota/protocol/spotflow_ota_cbor.h"

LOG_MODULE_REGISTER(spotflow_ota);

static const uint8_t update_artifacts_payload[] = {
	/* map(3) */
	0xa3,
	/* messageType: UPDATE_ARTIFACTS */
	0x00,
	0x06,
	/* updateAttemptId: 1 */
	0x18,
	0x20,
	0x01,
	/* manifest: array(1) */
	0x18,
	0x22,
	0x81,
	/* artifact: map(6) */
	0xa6,
	/* artifactType: FIRMWARE */
	0x18,
	0x23,
	0x00,
	/* slug: "main" */
	0x18,
	0x24,
	0x64,
	'm',
	'a',
	'i',
	'n',
	/* isMain: true */
	0x18,
	0x25,
	0xf5,
	/* url: "https://a" */
	0x18,
	0x26,
	0x69,
	'h',
	't',
	't',
	'p',
	's',
	':',
	'/',
	'/',
	'a',
	/* secret: "secret" */
	0x18,
	0x27,
	0x66,
	's',
	'e',
	'c',
	'r',
	'e',
	't',
	/* version: "1.0.0" */
	0x18,
	0x28,
	0x65,
	'1',
	'.',
	'0',
	'.',
	'0',
};

static const uint8_t cancel_update_payload[] = {
	/* map(2) */
	0xa2,
	/* messageType: CANCEL_UPDATE */
	0x00,
	0x07,
	/* updateAttemptId: 2 */
	0x18,
	0x20,
	0x02,
};

static const uint8_t report_update_results_payload[] = {
	/* map(2) */
	0xa2,
	/* messageType: REPORT_UPDATE_RESULTS */
	0x00,
	0x08,
	/* updateAttemptId: 3 */
	0x18,
	0x20,
	0x03,
};

static const uint8_t update_results_payload[] = {
	/* indefinite map */
	0xbf,
	/* messageType: UPDATE_RESULTS */
	0x00,
	0x09,
	/* updateAttemptId: 7 */
	0x18,
	0x20,
	0x07,
	/* succeeded: indefinite array [0] */
	0x18,
	0x2a,
	0x9f,
	0x00,
	0xff,
	/* failed: indefinite array [1] */
	0x18,
	0x2b,
	0x9f,
	0x01,
	0xff,
	/* canceled: indefinite array [2] */
	0x18,
	0x2c,
	0x9f,
	0x02,
	0xff,
	/* end map */
	0xff,
};

static const uint8_t update_results_error_payload[] = {
	/* indefinite map */
	0xbf,
	/* messageType: UPDATE_RESULTS */
	0x00,
	0x09,
	/* updateAttemptId: 9 */
	0x18,
	0x20,
	0x09,
	/* updateAttemptError: CANNOT_PARSE_MESSAGE */
	0x18,
	0x2d,
	0x03,
	/* end map */
	0xff,
};

ZTEST(spotflow_ota_cbor, test_decode_update_artifacts)
{
	struct spotflow_ota_cbor_c2d_msg msg;
	struct spotflow_ota_cbor_decode_status status;

	int rc = spotflow_ota_cbor_decode_c2d(update_artifacts_payload,
					      sizeof(update_artifacts_payload), &msg, &status);

	zassert_ok(rc);
	zassert_true(status.has_trustworthy_attempt_id);
	zassert_false(status.has_attempt_error);
	zassert_equal(status.attempt_id, 1);
	zassert_equal(msg.type, SPOTFLOW_OTA_CBOR_MSG_UPDATE_ARTIFACTS);
	zassert_equal(msg.attempt_id, 1);
	zassert_false(msg.payload.update.is_canceled);
	zassert_equal(msg.payload.update.artifact_count, 1);

	const struct spotflow_ota_artifact* artifact = &msg.payload.update.artifacts[0];

	zassert_true(artifact->is_main);
	zassert_str_equal(artifact->slug, "main");
	zassert_str_equal(artifact->url, "https://a");
	zassert_str_equal(artifact->secret, "secret");
	zassert_str_equal(artifact->version, "1.0.0");
}

ZTEST(spotflow_ota_cbor, test_decode_rejects_slug_that_cannot_be_persisted)
{
	uint8_t payload[sizeof(update_artifacts_payload)];
	struct spotflow_ota_cbor_c2d_msg msg;
	struct spotflow_ota_cbor_decode_status status;

	memcpy(payload, update_artifacts_payload, sizeof(payload));
	payload[18] = '/'; /* Change "main" to "ma/n". */

	zassert_equal(spotflow_ota_cbor_decode_c2d(payload, sizeof(payload), &msg, &status),
		      -EINVAL);
	zassert_true(status.has_trustworthy_attempt_id);
	zassert_true(status.has_attempt_error);
	zassert_equal(status.attempt_error, SPOTFLOW_OTA_ATTEMPT_ERROR_CANNOT_PARSE_MESSAGE);
}

ZTEST(spotflow_ota_cbor, test_decode_cancel_update)
{
	struct spotflow_ota_cbor_c2d_msg msg;
	struct spotflow_ota_cbor_decode_status status;

	int rc = spotflow_ota_cbor_decode_c2d(cancel_update_payload, sizeof(cancel_update_payload),
					      &msg, &status);

	zassert_ok(rc);
	zassert_true(status.has_trustworthy_attempt_id);
	zassert_false(status.has_attempt_error);
	zassert_equal(msg.type, SPOTFLOW_OTA_CBOR_MSG_CANCEL_UPDATE);
	zassert_equal(msg.attempt_id, 2);
}

ZTEST(spotflow_ota_cbor, test_decode_report_update_results)
{
	struct spotflow_ota_cbor_c2d_msg msg;
	struct spotflow_ota_cbor_decode_status status;

	int rc = spotflow_ota_cbor_decode_c2d(report_update_results_payload,
					      sizeof(report_update_results_payload), &msg, &status);

	zassert_ok(rc);
	zassert_true(status.has_trustworthy_attempt_id);
	zassert_false(status.has_attempt_error);
	zassert_equal(msg.type, SPOTFLOW_OTA_CBOR_MSG_REPORT_UPDATE_RESULTS);
	zassert_equal(msg.attempt_id, 3);
}

ZTEST(spotflow_ota_cbor, test_encode_update_results)
{
	uint8_t buffer[32];
	size_t encoded_len;
	struct spotflow_ota_cbor_update_results msg = {
		.attempt_id = 7,
		.succeeded_count = 1,
		.succeeded = { 0 },
		.failed_count = 1,
		.failed = { 1 },
		.canceled_count = 1,
		.canceled = { 2 },
	};

	int rc =
		spotflow_ota_cbor_encode_update_results(&msg, buffer, sizeof(buffer), &encoded_len);

	zassert_ok(rc);
	zassert_equal(encoded_len, sizeof(update_results_payload));
	zassert_mem_equal(buffer, update_results_payload, sizeof(update_results_payload));
}

ZTEST(spotflow_ota_cbor, test_encode_update_results_with_attempt_error)
{
	uint8_t buffer[16];
	size_t encoded_len;
	struct spotflow_ota_cbor_update_results msg = {
		.attempt_id = 9,
		.has_attempt_error = true,
		.attempt_error = SPOTFLOW_OTA_ATTEMPT_ERROR_CANNOT_PARSE_MESSAGE,
		.succeeded_count = 1,
		.succeeded = { 0 },
	};

	int rc =
		spotflow_ota_cbor_encode_update_results(&msg, buffer, sizeof(buffer), &encoded_len);

	zassert_ok(rc);
	zassert_equal(encoded_len, sizeof(update_results_error_payload));
	zassert_mem_equal(buffer, update_results_error_payload,
			  sizeof(update_results_error_payload));
}

ZTEST(spotflow_ota_cbor, test_reject_unknown_artifact_type_with_attempt_error)
{
	uint8_t payload[sizeof(update_artifacts_payload)];
	struct spotflow_ota_cbor_c2d_msg msg;
	struct spotflow_ota_cbor_decode_status status;

	memcpy(payload, update_artifacts_payload, sizeof(payload));
	payload[12] = 0x01; /* Replace artifactType FIRMWARE (0) with unknown type 1. */

	int rc = spotflow_ota_cbor_decode_c2d(payload, sizeof(payload), &msg, &status);

	zassert_equal(rc, -EINVAL);
	zassert_true(status.has_trustworthy_attempt_id);
	zassert_true(status.has_attempt_error);
	zassert_equal(status.attempt_id, 1);
	zassert_equal(status.attempt_error, SPOTFLOW_OTA_ATTEMPT_ERROR_UNKNOWN_ARTIFACT_TYPE);
}

ZTEST(spotflow_ota_cbor, test_reject_zero_attempt_id_without_trustworthy_attempt_id)
{
	uint8_t payload[sizeof(cancel_update_payload)];
	struct spotflow_ota_cbor_c2d_msg msg;
	struct spotflow_ota_cbor_decode_status status;

	memcpy(payload, cancel_update_payload, sizeof(payload));
	payload[5] = 0x00; /* Replace updateAttemptId 1 with invalid attempt ID 0. */

	int rc = spotflow_ota_cbor_decode_c2d(payload, sizeof(payload), &msg, &status);

	zassert_equal(rc, -EINVAL);
	zassert_false(status.has_trustworthy_attempt_id);
	zassert_false(status.has_attempt_error);
}

ZTEST_SUITE(spotflow_ota_cbor, NULL, NULL, NULL, NULL, NULL);

ZTEST(spotflow_ota_cbor, test_maximum_manifest_fits_command_buffer)
{
	static uint8_t payload[SPOTFLOW_OTA_CBOR_MAX_C2D_MESSAGE_SIZE];
	static struct spotflow_ota_cbor_c2d_msg decoded;
	static char field[SPOTFLOW_OTA_ARTIFACT_URL_MAX_LENGTH];
	struct spotflow_ota_cbor_decode_status status;
	ZCBOR_STATE_E(state, 5, payload, sizeof(payload), 1);

	memset(field, 'x', sizeof(field));
	zassert_true(zcbor_map_start_encode(state, 3));
	zassert_true(zcbor_uint32_put(state, 0) && zcbor_uint32_put(state, 6));
	zassert_true(zcbor_uint32_put(state, 32) && zcbor_uint64_put(state, UINT64_MAX));
	zassert_true(zcbor_uint32_put(state, 34));
	zassert_true(zcbor_list_start_encode(state, CONFIG_SPOTFLOW_OTA_MAX_ARTIFACTS));
	for (size_t i = 0; i < CONFIG_SPOTFLOW_OTA_MAX_ARTIFACTS; i++) {
		zassert_true(zcbor_map_start_encode(state, 6));
		zassert_true(zcbor_uint32_put(state, 35) && zcbor_uint32_put(state, 0));
		zassert_true(
			zcbor_uint32_put(state, 36) &&
			zcbor_tstr_encode_ptr(state, field, SPOTFLOW_OTA_ARTIFACT_SLUG_MAX_LENGTH));
		zassert_true(zcbor_uint32_put(state, 37) && zcbor_bool_put(state, i == 0));
		zassert_true(
			zcbor_uint32_put(state, 38) &&
			zcbor_tstr_encode_ptr(state, field, SPOTFLOW_OTA_ARTIFACT_URL_MAX_LENGTH));
		zassert_true(zcbor_uint32_put(state, 39) &&
			     zcbor_tstr_encode_ptr(state, field,
						   SPOTFLOW_OTA_ARTIFACT_SECRET_MAX_LENGTH));
		zassert_true(zcbor_uint32_put(state, 40) &&
			     zcbor_tstr_encode_ptr(state, field,
						   SPOTFLOW_OTA_ARTIFACT_VERSION_MAX_LENGTH));
		zassert_true(zcbor_map_end_encode(state, 6));
	}
	zassert_true(zcbor_list_end_encode(state, CONFIG_SPOTFLOW_OTA_MAX_ARTIFACTS));
	zassert_true(zcbor_map_end_encode(state, 3));

	size_t payload_len = state->payload - payload;

	zassert_ok(spotflow_ota_cbor_decode_c2d(payload, payload_len, &decoded, &status));
	zassert_equal(decoded.payload.update.artifact_count, CONFIG_SPOTFLOW_OTA_MAX_ARTIFACTS);
}
```
