## CMakeLists.txt
```
cmake_minimum_required(VERSION 3.20.0)

find_package(Zephyr REQUIRED HINTS $ENV{ZEPHYR_BASE})
project(spotflow_ota_psa_fwu)

zephyr_linker_sources(
        DATA_SECTIONS
        ../../../src/ota/downloader/spotflow_ota_downloader.ld
)
zephyr_iterable_section(
        NAME spotflow_downloader
        GROUP DATA_REGION
        ${XIP_ALIGN_WITH_INPUT}
)

target_include_directories(app PRIVATE
        ${CMAKE_CURRENT_LIST_DIR}/include
        ${CMAKE_CURRENT_LIST_DIR}/../../../include
        ${CMAKE_CURRENT_LIST_DIR}/../../../src
        ${CMAKE_CURRENT_LIST_DIR}/../common
        ${CMAKE_CURRENT_LIST_DIR}/../downloader
)

target_compile_definitions(app PRIVATE
        CONFIG_SPOTFLOW_OTA_PSA_FWU_TI_CC35XX=1
        CONFIG_SPOTFLOW=1
        CONFIG_SPOTFLOW_GENERATE_BUILD_ID=1
        CONFIG_SPOTFLOW_MODULE_DEFAULT_LOG_LEVEL=3
        CONFIG_SPOTFLOW_OTA_LOG_LEVEL=3
        CONFIG_SPOTFLOW_OTA=1
        CONFIG_SPOTFLOW_OTA_MAX_ARTIFACTS=4
        CONFIG_SPOTFLOW_OTA_AUTO_HANDLE_MAIN_FIRMWARE=1
        CONFIG_SPOTFLOW_OTA_DOWNLOAD_RETRY_INITIAL_DELAY_MS=1
        CONFIG_SPOTFLOW_OTA_DOWNLOAD_RETRY_MAX_DELAY_MS=1
        CONFIG_SPOTFLOW_OTA_HTTP_TIMEOUT_MS=1000
        CONFIG_SPOTFLOW_OTA_DOWNLOAD_BUFFER_SIZE=1024
)

target_sources(app PRIVATE
        src/main.c
        src/spotflow_ota_psa_fake.c
        ../common/spotflow_ota_bindesc_test_util.c
        ../common/spotflow_ota_build_id_fake.c
        ../common/spotflow_ota_test_fakes.c
        ../common/spotflow_ota_test_transport_stubs.c
        ../common/spotflow_ota_test_settings.c
        ../downloader/spotflow_ota_downloader_transport_fake.c
        ../../../src/ota/protocol/spotflow_ota_cbor.c
        ../../../src/ota/downloader/spotflow_ota_downloader.c
        ../../../src/ota/downloader/spotflow_ota_downloader_http.c
        ../../../src/ota/downloader/spotflow_ota_downloader_transport_errors.c
        ../../../src/ota/downloader/spotflow_ota_downloader_transport_range.c
        ../../../src/ota/firmware/spotflow_ota_fw_custom.c
        ../../../src/ota/firmware/spotflow_ota_fw_main.c
        ../../../src/ota/platform/spotflow_ota_identity.c
        ../../../src/ota/platform/spotflow_ota_platform_psa.c
        ../../../src/ota/core/spotflow_ota_log.c
        ../../../src/ota/core/spotflow_ota_results.c
        ../../../src/ota/core/spotflow_ota_attempt_model.c
        ../../../src/ota/core/spotflow_ota_main_model.c
        ../../../src/ota/platform/spotflow_ota_identity_stream.c
        ../../../src/ota/platform/psa/spotflow_ota_psa_ti_cc35xx.c
        ../../../src/ota/platform/psa/spotflow_ota_psa_ti_container.c
        ../../../src/ota/protocol/spotflow_ota_net.c
        ../../../src/ota/persistence/spotflow_ota_persistence.c
        ../../../src/ota/persistence/spotflow_ota_records_cbor.c
        ../../../src/ota/core/spotflow_ota_state.c
        ../../../src/ota/core/spotflow_ota_worker.c
        ../../../src/ota/downloader/spotflow_ota_url.c
        ${ZEPHYR_BASE}/subsys/net/lib/http/http_parser_url.c
)
```

## prj.conf
```kconfig
CONFIG_ZTEST=y
CONFIG_TEST_RANDOM_GENERATOR=y
CONFIG_ZCBOR=y
CONFIG_BINDESC=y
CONFIG_BINDESC_DEFINE=y
CONFIG_MAIN_STACK_SIZE=4096

# Coordinator fixtures keep a complete update and worker job on the test stack.
# Cortex-M3's 1 KiB ztest default is smaller than those frames alone.
CONFIG_ZTEST_STACK_SIZE=8192
CONFIG_STACK_SENTINEL=y
```

## src/main.c
```c
#include "ota/firmware/spotflow_ota_fw_main.h"
#include "ota/core/spotflow_ota_worker.h"
#include "ota/platform/psa/spotflow_ota_psa_provider.h"
#include "ota/platform/spotflow_ota_identity_stream.h"
#include "ota/persistence/spotflow_ota_persistence.h"
#include "ota/protocol/spotflow_ota_net.h"
#include "spotflow_ota_bindesc_test_util.h"
#include "spotflow_ota_build_id_fake.h"
#include "spotflow_ota_downloader_transport_fake.h"
#include "spotflow_ota_test_fakes.h"
#include "spotflow_ota_test_settings.h"
#include "spotflow_ota_psa_fake.h"

#include <errno.h>
#include <string.h>
#include <zephyr/logging/log.h>
#include <zephyr/sys/byteorder.h>
#include <zephyr/ztest.h>

LOG_MODULE_REGISTER(spotflow_ota, CONFIG_LOG_DEFAULT_LEVEL);

static bool abort_after_download;
static bool capture_probation_after_result;
static struct spotflow_ota_probation probation_after_result;
static uint8_t image[188];
static uint8_t build_id[SPOTFLOW_BUILD_ID_LENGTH];
static struct spotflow_ota_downloader_transport_fake* transport;

static void before_each(void* fixture);
static void accept_update(void);
static enum spotflow_ota_result process(void);
static struct spotflow_ota_probation load_probation(void);
static int restore_and_reconcile(struct spotflow_ota_fw_main_startup_result* startup);
static void expect_completion(enum spotflow_ota_result result);
static void enter_trial(void);
static void prepare_large_artifact(uint8_t artifact[1024]);

void spotflow_on_main_firmware_update_progressed(
	const struct spotflow_ota_main_firmware_state* state)
{
	if (abort_after_download && state->phase == SPOTFLOW_OTA_PHASE_PENDING_UPGRADE) {
		zassert_ok(spotflow_ota_fw_main_fail_update(NULL));
	}
}

bool spotflow_is_update_canceled(void)
{
	return spotflow_ota_state_is_update_canceled();
}

void spotflow_ota_worker_test_after_artifact_result_persisted(void)
{
	if (capture_probation_after_result) {
		bool present;

		zassert_ok(
			spotflow_ota_persistence_load_probation(&probation_after_result, &present));
		zassert_true(present);
		capture_probation_after_result = false;
	}
}

ZTEST(spotflow_ota_psa, test_split_stream_installs_inactive_vendor_slot)
{
	zassert_equal(process(), SPOTFLOW_OTA_RESULT_PENDING);
	zassert_equal(fake.target, 5);
	zassert_equal(fake.start_count, 1);
	zassert_equal(fake.finish_count, 1);
	zassert_equal(fake.install_count, 1);
	zassert_equal(fake.reboot_count, 1);
	zassert_equal(fake.write_count, 1);
	zassert_mem_equal(fake.image, image, sizeof(image));
	struct spotflow_ota_probation probation = load_probation();

	zassert_mem_equal(probation.expected_build_id, build_id, sizeof(build_id));
	zassert_str_equal(probation.version, "cloud-version");
}

ZTEST(spotflow_ota_psa, test_second_update_uses_slot_one)
{
	spotflow_ota_psa_fake_set_confirmed(5);
	zassert_equal(process(), SPOTFLOW_OTA_RESULT_PENDING);
	zassert_equal(fake.target, 4);
	zassert_equal(fake.clean_count, 1);
	zassert_equal(fake.reboot_count, 1);
}

ZTEST(spotflow_ota_psa, test_acceptance_keeps_probation_and_does_not_reboot)
{
	enter_trial();
	struct spotflow_ota_main_firmware_state state;
	spotflow_ota_state_effects effects;
	unsigned int reboots = fake.reboot_count;

	zassert_ok(spotflow_ota_fw_main_confirm_image(&state, &effects));
	zassert_equal(state.phase, SPOTFLOW_OTA_PHASE_UNCONFIRMED);
	zassert_equal(state.result, SPOTFLOW_OTA_RESULT_PENDING);
	zassert_equal(effects, 0);
	zassert_equal(fake.reboot_count, reboots);
	zassert_equal(fake.accept_count, 1);
	zassert_ok(spotflow_ota_fw_main_confirm_image(&state, &effects));
	zassert_equal(fake.accept_count, 1);
	struct spotflow_ota_worker_job job;

	zassert_false(spotflow_ota_state_get_worker_job(&job));
	(void)load_probation();

	/* Application requests commitment, then startup verifies the result. */
	zassert_equal(psa_fwu_request_reboot(), PSA_SUCCESS);
	spotflow_ota_psa_fake_set_confirmed(5);
	struct spotflow_ota_fw_main_startup_result startup;

	zassert_ok(restore_and_reconcile(&startup));
	zassert_equal(startup.progress_state.result, SPOTFLOW_OTA_RESULT_SUCCEEDED);
	expect_completion(SPOTFLOW_OTA_RESULT_SUCCEEDED);
}

ZTEST(spotflow_ota_psa, test_immediate_acceptance_queues_success)
{
	enter_trial();
	fake.accept_result = PSA_SUCCESS;
	struct spotflow_ota_main_firmware_state state;
	spotflow_ota_state_effects effects;

	zassert_ok(spotflow_ota_fw_main_confirm_image(&state, &effects));
	zassert_equal(state.result, SPOTFLOW_OTA_RESULT_SUCCEEDED);
	zassert_equal(fake.reboot_count, 1);
	expect_completion(SPOTFLOW_OTA_RESULT_SUCCEEDED);
}

ZTEST(spotflow_ota_psa, test_rollback_is_not_confused_with_committed_old_image)
{
	enter_trial();
	uint8_t old_id[SPOTFLOW_BUILD_ID_LENGTH] = { 99 };

	spotflow_ota_psa_fake_set_confirmed(4);
	spotflow_ota_build_id_fake_set_running_build_id(old_id);
	struct spotflow_ota_fw_main_startup_result startup;

	zassert_ok(restore_and_reconcile(&startup));
	expect_completion(SPOTFLOW_OTA_RESULT_FAILED);
}

ZTEST(spotflow_ota_psa, test_query_error_retains_probation)
{
	enter_trial();
	fake.query_error = PSA_ERROR_STORAGE_FAILURE;
	struct spotflow_ota_fw_main_startup_result startup;

	zassert_equal(restore_and_reconcile(&startup), -EIO);
	(void)load_probation();
	struct spotflow_ota_worker_job job;

	zassert_false(spotflow_ota_state_get_worker_job(&job));
}

ZTEST(spotflow_ota_psa, test_acceptance_error_does_not_complete_or_reboot)
{
	enter_trial();
	fake.accept_result = PSA_ERROR_NOT_PERMITTED;
	struct spotflow_ota_main_firmware_state state;
	spotflow_ota_state_effects effects;

	zassert_equal(spotflow_ota_fw_main_confirm_image(&state, &effects), -EPERM);
	zassert_equal(state.phase, SPOTFLOW_OTA_PHASE_UNCONFIRMED);
	zassert_equal(fake.reboot_count, 1);
	zassert_equal(effects, 0);
	(void)load_probation();
}

ZTEST(spotflow_ota_psa, test_foreign_candidate_blocks_global_operation)
{
	fake.slots[3].state = PSA_FWU_CANDIDATE;
	zassert_equal(process(), SPOTFLOW_OTA_RESULT_FAILED);
	zassert_equal(fake.start_count, 0);
	zassert_equal(fake.install_count, 0);
	zassert_equal(fake.clean_count, 0);
}

ZTEST(spotflow_ota_psa, test_trial_protects_rollback_storage_without_probation)
{
	spotflow_ota_psa_fake_set_trial(5);
	zassert_equal(process(), SPOTFLOW_OTA_RESULT_FAILED);
	zassert_equal(fake.start_count, 0);
	zassert_equal(fake.clean_count, 0);
}

ZTEST(spotflow_ota_psa, test_truncated_trailer_is_canceled_and_cleaned)
{
	transport->payload_len -= 1;
	zassert_equal(process(), SPOTFLOW_OTA_RESULT_FAILED);
	zassert_equal(fake.finish_count, 0);
	zassert_equal(fake.install_count, 0);
	zassert_equal(fake.cancel_count, 1);
	zassert_equal(fake.clean_count, 1);
}

ZTEST(spotflow_ota_psa, test_invalid_or_oversized_manifest_is_not_started)
{
	sys_put_le32(UINT32_MAX, image + 28);
	zassert_equal(process(), SPOTFLOW_OTA_RESULT_FAILED);
	zassert_equal(fake.start_count, 0);
}

ZTEST(spotflow_ota_psa, test_bad_identity_does_not_install)
{
	memset(image + 76, 0, sizeof(build_id));
	zassert_equal(process(), SPOTFLOW_OTA_RESULT_FAILED);
	zassert_equal(fake.finish_count, 0);
	zassert_equal(fake.install_count, 0);
	zassert_equal(fake.cancel_count, 1);
}

ZTEST(spotflow_ota_psa, test_write_error_cleans_incomplete_candidate)
{
	fake.write_error = PSA_ERROR_STORAGE_FAILURE;
	zassert_equal(process(), SPOTFLOW_OTA_RESULT_FAILED);
	zassert_equal(fake.cancel_count, 1);
	zassert_equal(fake.clean_count, 1);
	zassert_equal(fake.reboot_count, 0);
}

ZTEST(spotflow_ota_psa, test_finish_invalid_signature_cleans_candidate)
{
	fake.finish_error = PSA_ERROR_INVALID_SIGNATURE;
	zassert_equal(process(), SPOTFLOW_OTA_RESULT_FAILED);
	zassert_equal(fake.finish_count, 1);
	zassert_equal(fake.cancel_count, 1);
	zassert_equal(fake.clean_count, 1);
	zassert_equal(fake.install_count, 0);
}

ZTEST(spotflow_ota_psa, test_finish_storage_failure_cleans_candidate)
{
	fake.finish_error = PSA_ERROR_STORAGE_FAILURE;
	zassert_equal(process(), SPOTFLOW_OTA_RESULT_FAILED);
	zassert_equal(fake.finish_count, 1);
	zassert_equal(fake.cancel_count, 1);
	zassert_equal(fake.clean_count, 1);
	zassert_equal(fake.install_count, 0);
}

ZTEST(spotflow_ota_psa, test_download_retry_preserves_prefix_and_offsets)
{
	transport->partial_transient_fail_after_bytes = 37;
	zassert_equal(process(), SPOTFLOW_OTA_RESULT_PENDING);
	zassert_true(transport->call_count > 1);
	zassert_equal(fake.start_count, 1);
	zassert_mem_equal(fake.image, image, sizeof(image));
}

ZTEST(spotflow_ota_psa, test_download_retry_preserves_buffered_bytes)
{
	transport->partial_transient_fail_after_bytes = 100;
	zassert_equal(process(), SPOTFLOW_OTA_RESULT_PENDING);
	zassert_true(transport->call_count > 1);
	zassert_equal(fake.start_count, 1);
	zassert_equal(fake.write_count, 1);
	zassert_mem_equal(fake.image, image, sizeof(image));
}

ZTEST(spotflow_ota_psa, test_failed_installation_reboot_is_persisted_by_worker)
{
	struct spotflow_ota_persisted_attempt attempt;
	struct spotflow_ota_probation probation;
	struct spotflow_ota_state_diagnostic snapshot;
	bool present = false;

	fake.reboot_result = PSA_ERROR_STORAGE_FAILURE;
	capture_probation_after_result = true;
	accept_update();
	zassert_ok(spotflow_ota_worker_init());
	spotflow_ota_worker_wake();
	struct spotflow_ota_test_fake_transport* reporting = spotflow_ota_test_fake_transport_get();

	for (size_t i = 0; i < 1000; i++) {
		zassert_ok(spotflow_ota_net_send_pending_message());
		if (reporting->publish_count > 0) {
			break;
		}
		k_sleep(K_MSEC(1));
	}
	/* Wait until the worker also finishes its report operation before reset. */
	spotflow_ota_worker_reset();
	zassert_equal(reporting->publish_count, 1);
	spotflow_ota_state_get_diagnostic(&snapshot);
	zassert_equal(snapshot.artifact_results[0], SPOTFLOW_OTA_RESULT_FAILED);
	zassert_equal(snapshot.main_firmware_state.result, SPOTFLOW_OTA_RESULT_FAILED);
	zassert_equal(snapshot.main_firmware_state.phase, SPOTFLOW_OTA_PHASE_NOT_RUNNING);
	zassert_ok(spotflow_ota_persistence_load_attempt(&attempt, &present));
	zassert_true(present);
	zassert_equal(attempt.artifact_results[0], SPOTFLOW_OTA_RESULT_FAILED);
	zassert_equal(fake.reboot_count, 1);
	zassert_equal(fake.accept_count, 0);
	zassert_false(capture_probation_after_result);
	zassert_ok(spotflow_ota_persistence_load_probation(&probation, &present));
	zassert_false(present);

	/* Recreate a reset after saving failure but before clearing probation.
	 * Even if that reset boots the candidate, the durable failure wins.
	 */
	probation = probation_after_result;
	struct spotflow_ota_fw_main_startup_result startup;

	zassert_ok(spotflow_ota_persistence_save_probation(&probation));
	spotflow_ota_psa_fake_set_trial(5);
	spotflow_ota_build_id_fake_set_running_build_id(build_id);
	zassert_ok(spotflow_ota_state_init_from_persistence(&attempt, true, &probation, true));
	zassert_ok(spotflow_ota_fw_main_reconcile_startup(&probation, true, &startup));
	zassert_false(startup.has_progress_notification);
	zassert_equal(fake.accept_count, 0);
	zassert_ok(spotflow_ota_persistence_load_probation(&probation, &present));
	zassert_false(present);
}

ZTEST(spotflow_ota_psa, test_provider_rejects_nonsequential_offsets)
{
	zassert_ok(spotflow_ota_psa_begin());
	struct spotflow_artifact_block block = {
		.offset = 1,
		.data = image,
		.data_len = 10,
	};

	zassert_equal(spotflow_ota_psa_write(&block), -EINVAL);
	zassert_equal(fake.start_count, 0);
}

ZTEST(spotflow_ota_psa, test_abort_after_download_cleans_writer)
{
	abort_after_download = true;
	zassert_equal(process(), SPOTFLOW_OTA_RESULT_FAILED);
	zassert_equal(fake.cancel_count, 1);
	zassert_equal(fake.clean_count, 1);
	zassert_equal(fake.finish_count, 0);
	zassert_equal(fake.install_count, 0);
}

ZTEST(spotflow_ota_psa, test_probation_save_failure_does_not_install)
{
	spotflow_ota_test_settings_set_save_failure("spotflow/ota/probation");
	zassert_equal(process(), SPOTFLOW_OTA_RESULT_FAILED);
	zassert_equal(fake.finish_count, 1);
	zassert_equal(fake.install_count, 0);
	zassert_equal(fake.cancel_count, 1);
}

ZTEST(spotflow_ota_psa, test_manifest_version_refusal_is_not_installed)
{
	fake.start_error = PSA_ERROR_NOT_PERMITTED;
	zassert_equal(process(), SPOTFLOW_OTA_RESULT_FAILED);
	zassert_equal(fake.write_count, 0);
	zassert_equal(fake.install_count, 0);
}

ZTEST(spotflow_ota_psa, test_foreign_trial_is_not_accepted)
{
	enter_trial();
	fake.slots[3].state = PSA_FWU_TRIAL;
	struct spotflow_ota_main_firmware_state state;
	spotflow_ota_state_effects effects;

	zassert_equal(spotflow_ota_fw_main_confirm_image(&state, &effects), -EBUSY);
	zassert_equal(fake.accept_count, 0);
	zassert_equal(fake.reboot_count, 1);
}

ZTEST(spotflow_ota_psa, test_wrong_running_build_cannot_be_accepted)
{
	enter_trial();
	uint8_t wrong_id[SPOTFLOW_BUILD_ID_LENGTH] = { 1 };
	struct spotflow_ota_main_firmware_state state;
	spotflow_ota_state_effects effects;

	spotflow_ota_build_id_fake_set_running_build_id(wrong_id);
	zassert_equal(spotflow_ota_fw_main_confirm_image(&state, &effects), -EINVAL);
	zassert_equal(fake.accept_count, 0);
}

ZTEST(spotflow_ota_psa, test_bad_trailer_length_is_not_finished)
{
	sys_put_le16(12, image + 178);
	zassert_equal(process(), SPOTFLOW_OTA_RESULT_FAILED);
	zassert_equal(fake.finish_count, 0);
	zassert_equal(fake.cancel_count, 1);
}

ZTEST(spotflow_ota_psa, test_same_executable_identity_is_rejected_before_probation)
{
	spotflow_ota_build_id_fake_set_running_build_id(build_id);
	zassert_equal(process(), SPOTFLOW_OTA_RESULT_FAILED);
	zassert_equal(fake.finish_count, 0);
	zassert_equal(fake.install_count, 0);
	zassert_equal(fake.cancel_count, 1);
}

ZTEST(spotflow_ota_psa, test_orphan_staged_image_is_rejected_before_reuse)
{
	fake.slots[5].state = PSA_FWU_STAGED;
	zassert_equal(process(), SPOTFLOW_OTA_RESULT_PENDING);
	zassert_equal(fake.reject_count, 1);
	zassert_equal(fake.clean_count, 1);
	zassert_equal(fake.target, 5);
}

ZTEST_SUITE(spotflow_ota_psa, NULL, NULL, before_each, NULL, NULL);

ZTEST(spotflow_ota_psa, test_large_blocks_preserve_prefix_and_bound_psa_writes)
{
	uint8_t artifact[1024];

	prepare_large_artifact(artifact);
	transport->payload = artifact;
	transport->payload_len = sizeof(artifact);
	transport->chunk_size = sizeof(artifact);
	zassert_equal(process(), SPOTFLOW_OTA_RESULT_PENDING);
	zassert_equal(fake.start_count, 1);
	zassert_equal(fake.max_block_size, 256);
	zassert_equal(fake.write_count, 4);
	zassert_mem_equal(fake.image, artifact, sizeof(artifact));
}

ZTEST(spotflow_ota_psa, test_one_byte_blocks_are_combined_into_bounded_writes)
{
	uint8_t artifact[1024];

	prepare_large_artifact(artifact);
	transport->payload = artifact;
	transport->payload_len = sizeof(artifact);
	zassert_equal(process(), SPOTFLOW_OTA_RESULT_PENDING);
	zassert_equal(fake.write_count, 4);
	zassert_equal(fake.max_block_size, 256);
	zassert_mem_equal(fake.image, artifact, sizeof(artifact));
}

ZTEST(spotflow_ota_psa, test_irregular_blocks_flush_remainder_on_empty_final_block)
{
	uint8_t artifact[1024];
	const size_t fragment_sizes[] = { 7, 1, 255, 3, 511, 19 };
	size_t offset = 0;
	size_t fragment = 0;

	prepare_large_artifact(artifact);
	zassert_ok(spotflow_ota_psa_begin());
	while (offset < sizeof(artifact)) {
		size_t length = MIN(fragment_sizes[fragment % ARRAY_SIZE(fragment_sizes)],
				    sizeof(artifact) - offset);
		struct spotflow_artifact_block block = {
			.offset = offset,
			.data = artifact + offset,
			.data_len = length,
		};

		zassert_ok(spotflow_ota_psa_write(&block));
		offset += length;
		fragment++;
	}
	zassert_equal(fake.write_count, 3);
	struct spotflow_artifact_block final_block = {
		.offset = offset,
		.is_last = true,
	};

	zassert_ok(spotflow_ota_psa_write(&final_block));
	zassert_equal(fake.write_count, 4);
	zassert_equal(fake.max_block_size, 256);
	zassert_mem_equal(fake.image, artifact, sizeof(artifact));
}

ZTEST(spotflow_ota_psa, test_abort_discards_buffered_bytes_before_next_download)
{
	struct spotflow_artifact_block block = {
		.data = image,
		.data_len = 100,
	};

	zassert_ok(spotflow_ota_psa_begin());
	zassert_ok(spotflow_ota_psa_write(&block));
	zassert_equal(fake.write_count, 0);
	zassert_ok(spotflow_ota_psa_abort());
	zassert_equal(fake.write_count, 0);
	zassert_equal(fake.cancel_count, 1);
	zassert_equal(process(), SPOTFLOW_OTA_RESULT_PENDING);
	zassert_equal(fake.write_count, 1);
	zassert_mem_equal(fake.image, image, sizeof(image));
}

ZTEST(spotflow_ota_psa, test_signature_trailer_cannot_supply_executable_identity)
{
	uint8_t artifact[224];

	memset(artifact, 0xff, sizeof(artifact));
	memcpy(artifact, image, sizeof(image));
	memset(artifact + 48, 0xff, 128);
	sys_put_le16(44, artifact + 182);
	zassert_true(spotflow_ota_test_bindesc_write_build_id(artifact, sizeof(artifact), 188,
							      build_id));
	transport->payload = artifact;
	transport->payload_len = sizeof(artifact);
	transport->chunk_size = sizeof(artifact);
	zassert_equal(process(), SPOTFLOW_OTA_RESULT_FAILED);
	zassert_equal(fake.finish_count, 0);
	zassert_equal(fake.install_count, 0);
}

ZTEST(spotflow_ota_psa, test_unexpected_running_state_fails_startup_without_probation)
{
	struct spotflow_ota_fw_main_startup_result startup;

	fake.slots[4].state = PSA_FWU_READY;
	zassert_equal(spotflow_ota_fw_main_reconcile_startup(NULL, false, &startup), -EIO);
	zassert_equal(fake.accept_count, 0);
	zassert_equal(fake.reboot_count, 0);
}

static void before_each(void* fixture)
{
	ARG_UNUSED(fixture);
	spotflow_ota_worker_reset();
	abort_after_download = false;
	capture_probation_after_result = false;
	spotflow_ota_test_settings_reset();
	spotflow_ota_test_fakes_reset();
	spotflow_ota_build_id_fake_reset(spotflow_ota_build_id_fake_get());
	spotflow_ota_net_reset();
	spotflow_ota_state_reset();
	spotflow_ota_fw_main_reset();
	zassert_ok(spotflow_ota_persistence_init());
	spotflow_ota_psa_fake_reset();
	(void)spotflow_ota_psa_abort();
	struct spotflow_ota_fw_main_startup_result startup;

	zassert_ok(spotflow_ota_fw_main_reconcile_startup(NULL, false, &startup));
	fake.init_count = 0;
	fake.clean_count = 0;
	fake.cancel_count = 0;
	for (size_t i = 0; i < sizeof(build_id); i++) {
		build_id[i] = 0x10 + i;
	}
	PSA_FWU_GPESlot_t manifest = {
		.Manifest_Integrity.Manifest_Integrity = { 1, 2, 3, 4 },
		.Manifest = {
			.GPE_Header = {
				.ih_magic.Magic_Number = 0x690c47c2,
				.ih_hdr_size = 32,
				.ih_img_size = 128,
				.ih_protect_tlv_size = 4,
			},
			.GPE_Version.iv_major = 1,
			.GPE_Magic.Magic_Number = 0x690c47c2,
		},
	};

	memset(image, 0xff, sizeof(image));
	memcpy(image, &manifest, sizeof(manifest));
	zassert_true(spotflow_ota_test_bindesc_write_build_id(image, sizeof(image), 64, build_id) >
		     0);
	sys_put_le16(0x6908, image + 176);
	sys_put_le16(4, image + 178);
	sys_put_le16(0x6907, image + 180);
	sys_put_le16(8, image + 182);
	transport = spotflow_ota_downloader_transport_fake_get();
	spotflow_ota_downloader_transport_fake_reset(transport);
	transport->payload = image;
	transport->payload_len = sizeof(image);
	transport->chunk_size = 1;
}

static void accept_update(void)
{
	struct spotflow_ota_update_msg update = {
		.attempt_id = 42,
		.artifact_count = 1,
		.artifacts = { {
			.is_main = true,
			.slug = "main",
			.version = "cloud-version",
			.url = "https://example.com/vendor_image.sign.bin",
			.secret = "secret",
		} },
	};
	struct spotflow_ota_update_result accepted;

	zassert_ok(spotflow_ota_state_accept_update(&update, &accepted));
}

static enum spotflow_ota_result process(void)
{
	struct spotflow_ota_worker_job job;

	accept_update();
	zassert_true(spotflow_ota_state_get_worker_job(&job));
	return spotflow_ota_fw_main_process_artifact(&job);
}

static struct spotflow_ota_probation load_probation(void)
{
	struct spotflow_ota_probation probation;
	bool present;

	zassert_ok(spotflow_ota_persistence_load_probation(&probation, &present));
	zassert_true(present);
	return probation;
}

static int restore_and_reconcile(struct spotflow_ota_fw_main_startup_result* startup)
{
	struct spotflow_ota_probation probation = load_probation();
	struct spotflow_ota_persisted_attempt attempt = {
		.attempt_id = 42,
		.artifact_count = 1,
		.artifact_results = { SPOTFLOW_OTA_RESULT_PENDING },
	};

	zassert_ok(spotflow_ota_persistence_save_attempt(&attempt));
	zassert_ok(spotflow_ota_state_init_from_persistence(&attempt, true, &probation, true));
	return spotflow_ota_fw_main_reconcile_startup(&probation, true, startup);
}

static void expect_completion(enum spotflow_ota_result result)
{
	struct spotflow_ota_worker_job job;

	zassert_true(spotflow_ota_state_get_worker_job(&job));
	zassert_equal(job.type, SPOTFLOW_OTA_WORKER_JOB_COMPLETE_MAIN_FIRMWARE);
	zassert_equal(job.token.attempt_id, 42);
	zassert_equal(job.data.complete_main_firmware.result, result);
	zassert_str_equal(job.data.complete_main_firmware.artifact.version, "cloud-version");
}

static void enter_trial(void)
{
	struct spotflow_ota_fw_main_startup_result startup;

	zassert_equal(process(), SPOTFLOW_OTA_RESULT_PENDING);
	spotflow_ota_psa_fake_set_trial(5);
	spotflow_ota_build_id_fake_set_running_build_id(build_id);
	zassert_ok(restore_and_reconcile(&startup));
	zassert_equal(startup.progress_state.phase, SPOTFLOW_OTA_PHASE_UNCONFIRMED);
}

static void prepare_large_artifact(uint8_t artifact[1024])
{
	memset(artifact, 0xff, 1024);
	memcpy(artifact, image, 176);
	PSA_FWU_GPESlot_t prefix;

	memcpy(&prefix, artifact, sizeof(prefix));
	prefix.Manifest.GPE_Header.ih_img_size = 964;
	prefix.Manifest.GPE_Header.ih_protect_tlv_size = 4;
	memcpy(artifact, &prefix, sizeof(prefix));
	sys_put_le16(0x6908, artifact + 1012);
	sys_put_le16(4, artifact + 1014);
	sys_put_le16(0x6907, artifact + 1016);
	sys_put_le16(8, artifact + 1018);
}
```

## include/psa_fwu.h
```c
/*
 * Copyright (c) 2025, Texas Instruments Incorporated - http://www.ti.com
 * All rights reserved.
 *
 * Redistribution and use in source and binary forms, with or without
 * modification, are permitted provided that the following conditions
 * are met:
 *
 * *  Redistributions of source code must retain the above copyright
 *    notice, this list of conditions and the following disclaimer.
 *
 * *  Redistributions in binary form must reproduce the above copyright
 *    notice, this list of conditions and the following disclaimer in the
 *    documentation and/or other materials provided with the distribution.
 *
 * *  Neither the name of Texas Instruments Incorporated nor the names of
 *    its contributors may be used to endorse or promote products derived
 *    from this software without specific prior written permission.
 *
 * THIS SOFTWARE IS PROVIDED BY THE COPYRIGHT HOLDERS AND CONTRIBUTORS "AS IS"
 * AND ANY EXPRESS OR IMPLIED WARRANTIES, INCLUDING, BUT NOT LIMITED TO,
 * THE IMPLIED WARRANTIES OF MERCHANTABILITY AND FITNESS FOR A PARTICULAR
 * PURPOSE ARE DISCLAIMED. IN NO EVENT SHALL THE COPYRIGHT OWNER OR
 * CONTRIBUTORS BE LIABLE FOR ANY DIRECT, INDIRECT, INCIDENTAL, SPECIAL,
 * EXEMPLARY, OR CONSEQUENTIAL DAMAGES (INCLUDING, BUT NOT LIMITED TO,
 * PROCUREMENT OF SUBSTITUTE GOODS OR SERVICES; LOSS OF USE, DATA, OR PROFITS;
 * OR BUSINESS INTERRUPTION) HOWEVER CAUSED AND ON ANY THEORY OF LIABILITY,
 * WHETHER IN CONTRACT, STRICT LIABILITY, OR TORT (INCLUDING NEGLIGENCE OR
 * OTHERWISE) ARISING IN ANY WAY OUT OF THE USE OF THIS SOFTWARE,
 * EVEN IF ADVISED OF THE POSSIBILITY OF SUCH DAMAGE.
 */

#ifndef SPOTFLOW_TEST_TI_PSA_FWU_H
#define SPOTFLOW_TEST_TI_PSA_FWU_H

#include <fwu/1.0/psa/update.h>

#ifdef __cplusplus
extern "C" {
#endif

/* Test-only TI component IDs and signed-container layout. */
typedef enum {
	BL2_Slot_1, /* ID 0 */
	BL2_Slot_2, /* ID 1 */
	WSOC_OR_RFTool_Slot_1, /* ID 2 */
	WSOC_OR_RFTool_Slot_2, /* ID 3 */
	Vendor_Image_Slot_1, /* ID 4 */
	Vendor_Image_Slot_2, /* ID 5 */
	MAX_COMPONENT_ID
} PSA_FWU_Component_ID_e;

#define MANIFEST_INTEGRITY_SIZE_IN_WORDS 4

/* This struct holds the MAGIC Number format entity  */
typedef struct {
	uint32_t Magic_Number;
} PSA_FWU_Magic_t;

/* This struct holds the GPE Header format entities */
typedef struct {
	PSA_FWU_Magic_t ih_magic;
	uint32_t ih_load_addr;
	uint16_t ih_hdr_size;
	uint16_t ih_protect_tlv_size;
	uint32_t ih_img_size;
	uint32_t ih_flags;
} PSA_FWU_GPEHeader_t;

/* This struct holds the GPE Version format entities */
typedef struct {
	uint8_t iv_major;
	uint8_t iv_minor;
	uint16_t iv_revision;
	uint32_t iv_build_num;
} PSA_FWU_GPEVersion_t;

/* This struct holds the GPE Manifest format entities */
typedef struct {
	PSA_FWU_GPEHeader_t GPE_Header;
	PSA_FWU_GPEVersion_t GPE_Version;
	PSA_FWU_Magic_t GPE_Magic;
} PSA_FWU_GPEManifest_t;

typedef struct {
	uint32_t Manifest_Integrity[MANIFEST_INTEGRITY_SIZE_IN_WORDS];
} PSA_FWU_Manifest_Integrity_t;

/* This struct holds the GPE Manifest entities */
typedef struct {
	PSA_FWU_Manifest_Integrity_t Manifest_Integrity;
	PSA_FWU_GPEManifest_t Manifest;
} PSA_FWU_GPESlot_t;

void psa_fwu_init(void);

#ifdef __cplusplus
}
#endif

#endif /* SPOTFLOW_TEST_TI_PSA_FWU_H */
```

## src/identity_stream.c
```c
#include "ota/platform/spotflow_ota_identity_stream.h"

#include <errno.h>
#include <string.h>

#include <zephyr/bindesc.h>
#include <zephyr/ztest.h>

#define DESCRIPTOR_OFFSET 12
#define ID_OFFSET (DESCRIPTOR_OFFSET + sizeof(uint64_t) + 16)

static size_t make_descriptors(uint8_t* image, uint16_t id_size);

ZTEST(spotflow_ota_identity_stream, test_every_block_boundary)
{
	uint8_t image[80] = { 0 };
	size_t length = make_descriptors(image, SPOTFLOW_BUILD_ID_LENGTH);

	for (size_t split = 0; split <= length; split++) {
		struct spotflow_ota_identity_stream stream = { 0 };
		uint8_t build_id[SPOTFLOW_BUILD_ID_LENGTH];

		spotflow_ota_identity_stream_feed(&stream, image, split);
		spotflow_ota_identity_stream_feed(&stream, image + split, length - split);
		zassert_ok(spotflow_ota_identity_stream_get(&stream, build_id));
		zassert_mem_equal(build_id, image + ID_OFFSET, sizeof(build_id));
	}
}

ZTEST(spotflow_ota_identity_stream, test_single_bytes_and_zero_length_blocks)
{
	struct spotflow_ota_identity_stream stream = { 0 };
	uint8_t image[80] = { 0 };
	uint8_t build_id[SPOTFLOW_BUILD_ID_LENGTH];
	size_t length = make_descriptors(image, SPOTFLOW_BUILD_ID_LENGTH);

	for (size_t i = 0; i < length; i++) {
		spotflow_ota_identity_stream_feed(&stream, NULL, 0);
		spotflow_ota_identity_stream_feed(&stream, image + i, 1);
	}
	zassert_ok(spotflow_ota_identity_stream_get(&stream, build_id));
	zassert_mem_equal(build_id, image + ID_OFFSET, sizeof(build_id));
}

ZTEST(spotflow_ota_identity_stream, test_truncation_at_every_byte)
{
	uint8_t image[80] = { 0 };
	uint8_t build_id[SPOTFLOW_BUILD_ID_LENGTH];

	make_descriptors(image, SPOTFLOW_BUILD_ID_LENGTH);
	for (size_t length = 0; length < ID_OFFSET + SPOTFLOW_BUILD_ID_LENGTH; length++) {
		struct spotflow_ota_identity_stream stream = { 0 };

		spotflow_ota_identity_stream_feed(&stream, image, length);
		zassert_equal(spotflow_ota_identity_stream_get(&stream, build_id), -ENOENT);
	}
}

ZTEST(spotflow_ota_identity_stream, test_invalid_size_and_unpatched_id)
{
	struct spotflow_ota_identity_stream stream = { 0 };
	uint8_t image[80] = { 0 };
	uint8_t build_id[SPOTFLOW_BUILD_ID_LENGTH];
	size_t length = make_descriptors(image, SPOTFLOW_BUILD_ID_LENGTH - 1);

	spotflow_ota_identity_stream_feed(&stream, image, length);
	zassert_equal(spotflow_ota_identity_stream_get(&stream, build_id), -EINVAL);

	memset(&stream, 0, sizeof(stream));
	length = make_descriptors(image, SPOTFLOW_BUILD_ID_LENGTH);
	memset(image + ID_OFFSET, 0, SPOTFLOW_BUILD_ID_LENGTH);
	spotflow_ota_identity_stream_feed(&stream, image, length);
	zassert_equal(spotflow_ota_identity_stream_get(&stream, build_id), -ENOSYS);
}

ZTEST(spotflow_ota_identity_stream, test_end_marker_and_unaligned_magic)
{
	struct spotflow_ota_identity_stream stream = { 0 };
	uint8_t image[80] = { 0 };
	uint8_t build_id[SPOTFLOW_BUILD_ID_LENGTH];
	size_t length = make_descriptors(image, SPOTFLOW_BUILD_ID_LENGTH);
	uint16_t end_tag = BINDESC_TAG_DESCRIPTORS_END;

	memcpy(image + ID_OFFSET - 4, &end_tag, sizeof(end_tag));
	spotflow_ota_identity_stream_feed(&stream, image, length);
	zassert_equal(spotflow_ota_identity_stream_get(&stream, build_id), -ENOENT);

	memset(&stream, 0, sizeof(stream));
	make_descriptors(image, SPOTFLOW_BUILD_ID_LENGTH);
	memmove(image + 1, image, length);
	spotflow_ota_identity_stream_feed(&stream, image, length + 1);
	zassert_equal(spotflow_ota_identity_stream_get(&stream, build_id), -ENOENT);
}

ZTEST(spotflow_ota_identity_stream, test_null_arguments)
{
	struct spotflow_ota_identity_stream stream = { 0 };
	uint8_t build_id[SPOTFLOW_BUILD_ID_LENGTH];

	zassert_equal(spotflow_ota_identity_stream_get(NULL, build_id), -EINVAL);
	zassert_equal(spotflow_ota_identity_stream_get(&stream, NULL), -EINVAL);
	spotflow_ota_identity_stream_feed(&stream, NULL, 1);
	zassert_equal(spotflow_ota_identity_stream_get(&stream, build_id), -EINVAL);
}

static size_t make_descriptors(uint8_t* image, uint16_t id_size)
{
	uint64_t magic = BINDESC_MAGIC;
	/* Empty and padded unknown descriptors must both be skipped. */
	uint16_t entries[] = {
		BINDESC_TAG(BYTES, 1),	   0,	   BINDESC_TAG(BYTES, 2), 3, 0x1234, 0,
		BINDESC_TAG(BYTES, 0x5f0), id_size
	};

	memcpy(image + DESCRIPTOR_OFFSET, &magic, sizeof(magic));
	memcpy(image + DESCRIPTOR_OFFSET + sizeof(magic), entries, sizeof(entries));
	for (size_t i = 0; i < SPOTFLOW_BUILD_ID_LENGTH; i++) {
		image[ID_OFFSET + i] = i + 1;
	}
	return ID_OFFSET + SPOTFLOW_BUILD_ID_LENGTH;
}

ZTEST_SUITE(spotflow_ota_identity_stream, NULL, NULL, NULL, NULL, NULL);
```

## src/psa_fake.c
```c
#include "psa_fake.h"
#include <string.h>

struct psa_fake fake;
uint32_t vendor_image_slot_1_region_size = 16384;
uint32_t vendor_image_slot_2_region_size = 16384;

void psa_fake_reset(void)
{
	memset(&fake, 0, sizeof(fake));
	for (size_t i = 0; i < MAX_COMPONENT_ID; i += 2) {
		fake.slots[i].state = PSA_FWU_UPDATED;
		fake.slots[i].impl.Primary = 1;
		fake.slots[i].impl.running_status = 1;
	}
	fake.install_result = PSA_SUCCESS_REBOOT;
	fake.accept_result = PSA_SUCCESS_REBOOT;
	vendor_image_slot_1_region_size = 16384;
	vendor_image_slot_2_region_size = 16384;
}

void psa_fake_trial(psa_fwu_component_t running)
{
	fake.slots[running].state = PSA_FWU_TRIAL;
	fake.slots[running].impl.running_status = 1;
	fake.slots[running].impl.Primary = 0;
	fake.slots[running ^ 1].state = PSA_FWU_UPDATED;
	fake.slots[running ^ 1].impl.running_status = 0;
	fake.slots[running ^ 1].impl.Primary = 1;
}

void psa_fake_committed(psa_fwu_component_t running)
{
	fake.slots[running].state = PSA_FWU_UPDATED;
	fake.slots[running].impl.running_status = 1;
	fake.slots[running].impl.Primary = 1;
	fake.slots[running ^ 1].state = PSA_FWU_FAILED;
	fake.slots[running ^ 1].impl.running_status = 0;
	fake.slots[running ^ 1].impl.Primary = 0;
}

void psa_fwu_init(void)
{
	fake.init_count++;
}

psa_status_t psa_fwu_query(psa_fwu_component_t component, psa_fwu_component_info_t* info)
{
	if (fake.query_error != PSA_SUCCESS) {
		return fake.query_error;
	}
	*info = fake.slots[component];
	return PSA_SUCCESS;
}

psa_status_t psa_fwu_start(psa_fwu_component_t component, const void* manifest, size_t len)
{
	fake.start_count++;
	fake.target = component;
	if (fake.start_error != PSA_SUCCESS) {
		return fake.start_error;
	}
	if (len != sizeof(PSA_FWU_GPESlot_t) || fake.slots[component].state != PSA_FWU_READY) {
		return PSA_ERROR_INVALID_ARGUMENT;
	}
	memcpy(fake.image, manifest, len);
	fake.next_write_offset = len;
	fake.slots[component].state = PSA_FWU_WRITING;
	return PSA_SUCCESS;
}

psa_status_t psa_fwu_write(psa_fwu_component_t component, size_t offset, const void* data,
			   size_t len)
{
	fake.write_count++;
	if (fake.write_error != PSA_SUCCESS) {
		return fake.write_error;
	}
	if (component != fake.target || offset != fake.next_write_offset || len == 0 ||
	    len > sizeof(fake.image) - offset) {
		return PSA_ERROR_INVALID_ARGUMENT;
	}
	memcpy(fake.image + offset, data, len);
	fake.next_write_offset += len;
	if (len > fake.max_block_size) {
		fake.max_block_size = len;
	}
	return PSA_SUCCESS;
}

psa_status_t psa_fwu_finish(psa_fwu_component_t component)
{
	fake.finish_count++;
	if (fake.finish_error != PSA_SUCCESS) {
		return fake.finish_error;
	}
	fake.slots[component].state = PSA_FWU_CANDIDATE;
	return PSA_SUCCESS;
}

psa_status_t psa_fwu_install(void)
{
	fake.install_count++;
	if (fake.install_result == PSA_SUCCESS_REBOOT) {
		fake.slots[fake.target].state = PSA_FWU_STAGED;
	}
	return fake.install_result;
}

psa_status_t psa_fwu_accept(void)
{
	fake.accept_count++;
	if (fake.accept_result == PSA_SUCCESS) {
		psa_fake_committed(fake.slots[4].impl.running_status ? 4 : 5);
	}
	return fake.accept_result;
}

psa_status_t psa_fwu_request_reboot(void)
{
	fake.reboot_count++;
	return fake.reboot_result;
}

psa_status_t psa_fwu_cancel(psa_fwu_component_t component)
{
	fake.cancel_count++;
	fake.slots[component].state = PSA_FWU_FAILED;
	return PSA_SUCCESS;
}

psa_status_t psa_fwu_clean(psa_fwu_component_t component)
{
	fake.clean_count++;
	fake.slots[component].state = PSA_FWU_READY;
	return PSA_SUCCESS;
}

psa_status_t psa_fwu_reject(psa_status_t error)
{
	fake.reject_count++;
	for (size_t i = 0; i < MAX_COMPONENT_ID; i++) {
		if (fake.slots[i].state == PSA_FWU_STAGED) {
			fake.slots[i].state = PSA_FWU_FAILED;
			fake.slots[i].error = error;
		}
	}
	return PSA_SUCCESS;
}
```

## src/psa_fake.h
```c
#ifndef SPOTFLOW_OTA_PSA_FAKE_H
#define SPOTFLOW_OTA_PSA_FAKE_H

#include <psa_fwu.h>
#include <stdbool.h>

struct psa_fake {
	psa_fwu_component_info_t slots[MAX_COMPONENT_ID];
	psa_status_t query_error;
	psa_status_t start_error;
	psa_status_t write_error;
	psa_status_t finish_error;
	psa_status_t install_result;
	psa_status_t accept_result;
	psa_status_t reboot_result;
	unsigned int init_count;
	unsigned int start_count;
	unsigned int write_count;
	unsigned int finish_count;
	unsigned int install_count;
	unsigned int accept_count;
	unsigned int reboot_count;
	unsigned int reject_count;
	unsigned int cancel_count;
	unsigned int clean_count;
	psa_fwu_component_t target;
	size_t next_write_offset;
	size_t max_block_size;
	uint8_t image[16384];
};

extern struct psa_fake fake;
void psa_fake_reset(void);
void psa_fake_trial(psa_fwu_component_t running);
void psa_fake_committed(psa_fwu_component_t running);

#endif
```

## src/spotflow_ota_psa_fake.c
```c
#include "spotflow_ota_psa_fake.h"

#include <string.h>

struct spotflow_ota_psa_fake fake;
uint32_t vendor_image_slot_1_region_size = 16384;
uint32_t vendor_image_slot_2_region_size = 16384;

void spotflow_ota_psa_fake_reset(void)
{
	memset(&fake, 0, sizeof(fake));
	for (size_t i = 0; i < MAX_COMPONENT_ID; i += 2) {
		fake.slots[i].state = PSA_FWU_UPDATED;
		fake.slots[i].impl.Primary = 1;
		fake.slots[i].impl.running_status = 1;
	}
	fake.install_result = PSA_SUCCESS_REBOOT;
	fake.accept_result = PSA_SUCCESS_REBOOT;
	vendor_image_slot_1_region_size = 16384;
	vendor_image_slot_2_region_size = 16384;
}

void spotflow_ota_psa_fake_set_trial(psa_fwu_component_t running)
{
	fake.slots[running].state = PSA_FWU_TRIAL;
	fake.slots[running].impl.running_status = 1;
	fake.slots[running].impl.Primary = 0;
	fake.slots[running ^ 1].state = PSA_FWU_UPDATED;
	fake.slots[running ^ 1].impl.running_status = 0;
	fake.slots[running ^ 1].impl.Primary = 1;
}

void spotflow_ota_psa_fake_set_confirmed(psa_fwu_component_t running)
{
	fake.slots[running].state = PSA_FWU_UPDATED;
	fake.slots[running].impl.running_status = 1;
	fake.slots[running].impl.Primary = 1;
	fake.slots[running ^ 1].state = PSA_FWU_FAILED;
	fake.slots[running ^ 1].impl.running_status = 0;
	fake.slots[running ^ 1].impl.Primary = 0;
}

void psa_fwu_init(void)
{
	fake.init_count++;
}

psa_status_t psa_fwu_query(psa_fwu_component_t component, psa_fwu_component_info_t* info)
{
	if (fake.query_error != PSA_SUCCESS) {
		return fake.query_error;
	}
	*info = fake.slots[component];
	return PSA_SUCCESS;
}

psa_status_t psa_fwu_start(psa_fwu_component_t component, const void* manifest, size_t len)
{
	fake.start_count++;
	fake.target = component;
	if (fake.start_error != PSA_SUCCESS) {
		return fake.start_error;
	}
	if (len != sizeof(PSA_FWU_GPESlot_t) || fake.slots[component].state != PSA_FWU_READY) {
		return PSA_ERROR_INVALID_ARGUMENT;
	}
	memcpy(fake.image, manifest, len);
	fake.next_write_offset = len;
	fake.slots[component].state = PSA_FWU_WRITING;
	return PSA_SUCCESS;
}

psa_status_t psa_fwu_write(psa_fwu_component_t component, size_t offset, const void* data,
			   size_t len)
{
	fake.write_count++;
	if (fake.write_error != PSA_SUCCESS) {
		return fake.write_error;
	}
	if (component != fake.target || offset != fake.next_write_offset || len == 0 ||
	    len > sizeof(fake.image) - offset) {
		return PSA_ERROR_INVALID_ARGUMENT;
	}
	memcpy(fake.image + offset, data, len);
	fake.next_write_offset += len;
	if (len > fake.max_block_size) {
		fake.max_block_size = len;
	}
	return PSA_SUCCESS;
}

psa_status_t psa_fwu_finish(psa_fwu_component_t component)
{
	fake.finish_count++;
	if (fake.finish_error != PSA_SUCCESS) {
		return fake.finish_error;
	}
	fake.slots[component].state = PSA_FWU_CANDIDATE;
	return PSA_SUCCESS;
}

psa_status_t psa_fwu_install(void)
{
	fake.install_count++;
	if (fake.install_result == PSA_SUCCESS_REBOOT) {
		fake.slots[fake.target].state = PSA_FWU_STAGED;
	}
	return fake.install_result;
}

psa_status_t psa_fwu_accept(void)
{
	fake.accept_count++;
	if (fake.accept_result == PSA_SUCCESS) {
		spotflow_ota_psa_fake_set_confirmed(fake.slots[4].impl.running_status ? 4 : 5);
	}
	return fake.accept_result;
}

psa_status_t psa_fwu_request_reboot(void)
{
	fake.reboot_count++;
	return fake.reboot_result;
}

psa_status_t psa_fwu_cancel(psa_fwu_component_t component)
{
	fake.cancel_count++;
	fake.slots[component].state = PSA_FWU_FAILED;
	return PSA_SUCCESS;
}

psa_status_t psa_fwu_clean(psa_fwu_component_t component)
{
	fake.clean_count++;
	fake.slots[component].state = PSA_FWU_READY;
	return PSA_SUCCESS;
}

psa_status_t psa_fwu_reject(psa_status_t error)
{
	fake.reject_count++;
	for (size_t i = 0; i < MAX_COMPONENT_ID; i++) {
		if (fake.slots[i].state == PSA_FWU_STAGED) {
			fake.slots[i].state = PSA_FWU_FAILED;
			fake.slots[i].error = error;
		}
	}
	return PSA_SUCCESS;
}
```

## src/spotflow_ota_psa_fake.h
```c
#ifndef SPOTFLOW_OTA_PSA_FAKE_H
#define SPOTFLOW_OTA_PSA_FAKE_H

#include <psa_fwu.h>
#include <stdbool.h>

/** @brief State and injected results of the fake TI FWU service. */
struct spotflow_ota_psa_fake {
	psa_fwu_component_info_t slots[MAX_COMPONENT_ID];
	psa_status_t query_error;
	psa_status_t start_error;
	psa_status_t write_error;
	psa_status_t finish_error;
	psa_status_t install_result;
	psa_status_t accept_result;
	psa_status_t reboot_result;
	unsigned int init_count;
	unsigned int start_count;
	unsigned int write_count;
	unsigned int finish_count;
	unsigned int install_count;
	unsigned int accept_count;
	unsigned int reboot_count;
	unsigned int reject_count;
	unsigned int cancel_count;
	unsigned int clean_count;
	psa_fwu_component_t target;
	size_t next_write_offset;
	size_t max_block_size;
	uint8_t image[16384];
};

#ifdef __cplusplus
extern "C" {
#endif

extern struct spotflow_ota_psa_fake fake;
/** @brief Reset slots and all injected results to their initial state. */
void spotflow_ota_psa_fake_reset(void);
/** @brief Simulate a trial boot.
 * @param running Physical component now executing.
 */
void spotflow_ota_psa_fake_set_trial(psa_fwu_component_t running);
/** @brief Simulate durable confirmation.
 * @param running Physical component now executing.
 */
void spotflow_ota_psa_fake_set_confirmed(psa_fwu_component_t running);

#ifdef __cplusplus
}
#endif

#endif /* SPOTFLOW_OTA_PSA_FAKE_H */
```
