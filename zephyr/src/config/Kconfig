## zephyr/src/metrics/system/Kconfig
```kconfig
menuconfig SPOTFLOW_METRICS_SYSTEM
	bool "Enable Spotflow system metrics auto-collection"
	depends on SPOTFLOW_METRICS
	default n
	help
	  Enable automatic collection of system-level metrics (memory, network, CPU, etc.).
	  These metrics are collected periodically and reported to the cloud without
	  requiring any application code.

if SPOTFLOW_METRICS_SYSTEM

config SPOTFLOW_METRICS_SYSTEM_MEMORY
	bool "Enable memory metrics"
	default y
	help
	  Collect system memory statistics (free/total bytes).
	  Uses Zephyr sys_mem_stats_get() API.

config SPOTFLOW_METRICS_SYSTEM_HEAP
	bool "Enable heap metrics"
	imply SYS_HEAP_RUNTIME_STATS
	default y
	help
	  Collect heap memory statistics (free/allocated bytes).
	  Requires a system heap (via HEAP_MEM_POOL_SIZE or HEAP_MEM_POOL_ADD_*).

config SPOTFLOW_METRICS_SYSTEM_NETWORK
	bool "Enable network metrics"
	depends on NETWORKING
	select NET_STATISTICS
	default y
	help
	  Collect network traffic statistics (TX/RX bytes).
	  Requires networking and network statistics to be enabled.

if SPOTFLOW_METRICS_SYSTEM_NETWORK

config SPOTFLOW_METRICS_SYSTEM_NETWORK_MAX_INTERFACES
	int "Maximum number of network interfaces to track"
	range 1 16
	default 4
	help
	  Maximum number of network interfaces for metrics collection.
	  Each interface is tracked with separate TX/RX metrics.

endif # SPOTFLOW_METRICS_SYSTEM_NETWORK

config SPOTFLOW_METRICS_SYSTEM_CPU
	bool "Enable CPU utilization metrics"
	select CPU_LOAD
	default y
	help
	  Collect CPU utilization percentage using Zephyr's cpu_load module.

config SPOTFLOW_METRICS_SYSTEM_CONNECTION
	bool "Enable connection state metrics"
	default y
	help
	  Report MQTT connection state changes (connected=1, disconnected=0).
	  Event-driven metric (not periodic).

config SPOTFLOW_METRICS_SYSTEM_RESET_CAUSE
	bool "Enable reset cause metric"
	select HWINFO
	default y
	help
	  Report device reset cause on boot (power-on, watchdog, etc.).
	  Event-driven metric (reported once on boot, not periodic).
	  Requires HWINFO support in the platform.

config SPOTFLOW_METRICS_SYSTEM_STACK
	bool "Enable thread stack metrics"
	select THREAD_STACK_INFO
	select INIT_STACKS
	imply THREAD_NAME
	default y
	help
	  Collect thread stack usage statistics (free bytes per thread).
	  Requires CONFIG_THREAD_STACK_INFO to be enabled.
	  Uses k_thread_stack_space_get() API to measure unused stack space.
	  Reports metric: thread_stack_free_bytes (labeled by thread name or ID).
	  Recommended to keep CONFIG_THREAD_NAME enabled for easier identification.

if SPOTFLOW_METRICS_SYSTEM_STACK

config SPOTFLOW_METRICS_SYSTEM_STACK_ALL_THREADS
	bool "Automatically track all threads"
	default y
	select THREAD_MONITOR
	help
	  Automatically collect stack metrics for all threads in the system.
	  If disabled, use spotflow_metrics_system_enable_thread_stack() to
	  track specific threads at runtime.

config SPOTFLOW_METRICS_SYSTEM_STACK_MAX_THREADS
	int "Maximum number of tracked threads"
	range 1 128
	default 32
	help
	  Maximum number of threads for stack metrics.
	  This sets the max time series allocated for the metric.
	  When automatic tracking is disabled, also limits the
	  number of threads that can be manually registered.

endif # SPOTFLOW_METRICS_SYSTEM_STACK

config SPOTFLOW_METRICS_SYSTEM_INTERVAL
	int "System metrics collection interval (seconds)"
	default 60
	help
	  How often to collect and report system metrics.
	  Allowed values: 60 (1 minute), 600 (10 minutes), 3600 (1 hour).
	  This also sets the metric aggregation interval (PT1M, PT10M, PT1H).
	  Lower values increase network/CPU overhead.

config HEAP_MEM_POOL_ADD_SIZE_SPOTFLOW_METRICS_SYSTEM
	int "Additional heap memory pool size for system metrics (bytes)"
	default 20480
	range 8192 65536
	help
	  System metrics heap depends on timeseries size (~230 bytes with
	  MAX_LABELS=4) and number of concurrent timeseries per metric.

	  Per-metric heap = 80 + (230 × max_timeseries)

	  Default estimates (all system metrics enabled):
	  - Heap metrics (2 metrics × 1 ts): ~0.6 KB
	  - Network metrics (2 × NETWORK_MAX_INTERFACES=4): ~2 KB
	  - CPU metric (1 ts): ~0.3 KB
	  - Connection metric (1 ts): ~0.3 KB
	  - Stack metrics (2 × STACK_MAX_THREADS=32): ~15 KB (dominates!)

	  Total with defaults: ~18 KB

	  To reduce memory, lower SPOTFLOW_METRICS_SYSTEM_STACK_MAX_THREADS.

	  This is added to CONFIG_HEAP_MEM_POOL_ADD_SIZE_SPOTFLOW_METRICS
	  which is for application metrics.



endif # SPOTFLOW_METRICS_SYSTEM
```

## zephyr/src/net/Kconfig
```kconfig
choice SPOTFLOW_TRANSPORT
	prompt "Spotflow transport"
	default SPOTFLOW_TRANSPORT_MQTT

rsource "Kconfig.mqtt"
rsource "Kconfig.ble"

endchoice
```

## zephyr/tests/metrics/unit/testcase.yaml
```yaml
tests:
  spotflow.metrics.unit:
    tags: spotflow metrics unit
    integration_platforms:
      - native_sim
    harness: ztest
```

## zephyr/tests/ota/cbor/testcase.yaml
```yaml
common:
  tags:
    - spotflow
    - ota
tests:
  spotflow.ota.cbor:
    platform_allow:
      - native_sim
    integration_platforms:
      - native_sim
```

## zephyr/tests/ota/downloader/testcase.yaml
```yaml
common:
  tags:
    - spotflow
    - ota
tests:
  spotflow.ota.downloader:
    platform_allow:
      - native_sim
    integration_platforms:
      - native_sim
```

## zephyr/tests/ota/facade/testcase.yaml
```yaml
common:
  tags:
    - spotflow
    - ota
tests:
  spotflow.ota.facade:
    platform_allow:
      - native_sim
    integration_platforms:
      - native_sim
```

## zephyr/tests/ota/fw_main/testcase.yaml
```yaml
common:
  tags:
    - spotflow
    - ota
tests:
  spotflow.ota.fw_main:
    platform_allow:
      - native_sim
    integration_platforms:
      - native_sim
```

## zephyr/tests/ota/net/testcase.yaml
```yaml
common:
  tags:
    - spotflow
    - ota
tests:
  spotflow.ota.net:
    platform_allow:
      - native_sim
    integration_platforms:
      - native_sim
```

## zephyr/tests/ota/persistence/testcase.yaml
```yaml
common:
  tags:
    - spotflow
    - ota
tests:
  spotflow.ota.persistence:
    platform_allow:
      - native_sim
    integration_platforms:
      - native_sim
```

## zephyr/tests/ota/platform_identity/testcase.yaml
```yaml
common:
  tags:
    - spotflow
    - ota
tests:
  spotflow.ota.platform_identity:
    platform_allow:
      - native_sim
    integration_platforms:
      - native_sim
```

## zephyr/tests/ota/public_api/testcase.yaml
```yaml
common:
  tags:
    - spotflow
    - ota
tests:
  spotflow.ota.public_api:
    platform_allow:
      - native_sim
    integration_platforms:
      - native_sim
```

## zephyr/tests/ota/records_cbor/testcase.yaml
```yaml
common:
  tags:
    - spotflow
    - ota
tests:
  spotflow.ota.records_cbor:
    platform_allow:
      - native_sim
    integration_platforms:
      - native_sim
```

## zephyr/tests/ota/state/testcase.yaml
```yaml
common:
  tags:
    - spotflow
    - ota
tests:
  spotflow.ota.state:
    platform_allow:
      - native_sim
    integration_platforms:
      - native_sim
```

## zephyr/tests/ota/worker/testcase.yaml
```yaml
common:
  tags:
    - spotflow
    - ota
tests:
  spotflow.ota.worker:
    platform_allow:
      - native_sim
    integration_platforms:
      - native_sim
```
