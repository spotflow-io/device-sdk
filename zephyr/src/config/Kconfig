## zephyr/src/config/Kconfig
```kconfig
config SPOTFLOW_CONFIG
	bool
	default y if SPOTFLOW_LOG_BACKEND
	default n
	help
		Spotflow configuration is enabled automatically when needed by any other part of the SDK
		(currently only by the logging backend).
```

## zephyr/src/coredumps/KConfig.coredumps
```kconfig
config SPOTFLOW_CORE_DUMPS
	bool "Enable core dumps upload to Spotflow"
	default n
	select DEBUG_COREDUMP
	select FLASH
# 	depends on DEBUG_COREDUMP_BACKEND_FLASH_PARTITION
	help
		Enable sending core dumps to Spotflow observability platform.


if SPOTFLOW_CORE_DUMPS

# spotflow uses Zephyr's coredump subsystem to upload core dumps
choice DEBUG_COREDUMP_BACKEND
	default DEBUG_COREDUMP_BACKEND_FLASH_PARTITION if SPOTFLOW_CORE_DUMPS
endchoice


endif #SPOTFLOW_CORE_DUMPS
```

## zephyr/src/logging/KConfig
```kconfig
config SPOTFLOW_LOG_BACKEND
	bool "Spotflow logging backend"
	default y if SPOTFLOW
	depends on LOG
	select LOG_OUTPUT

	help
		Enable sending logs to Spotflow cloud.


if SPOTFLOW_LOG_BACKEND

config HEAP_MEM_POOL_ADD_SIZE_SPOTFLOW_LOGGING
	int "Additional heap size required by Spotflow"
	default 6144 if SPOTFLOW_LOG_BACKEND
	help
		Additional heap size required by Spotflow logging backend.
		Increase this value if you experience issues with logs being sent.

config SPOTFLOW_LOG_BACKEND_QUEUE_SIZE
	int "Size of Spotflow log backend queue"
	default 16
	help
		Size of the queue used by Spotflow logging backend to store logs
		before sending them to the server.
		Increase this value if you experience issues with logs being dropped.

config SPOTFLOW_LOG_BUFFER_SIZE
	int "Size of Spotflow log buffer"
	default 512
	help
		Size of the buffer used by Spotflow logging backend to store logs before serialization.
		Make this at least as big as your longest expected log line.
		Increase this value if you experience issues with logs being dropped because of buffer overflow.

config SPOTFLOW_CBOR_LOG_MAX_LEN
	int "Size of Spotflow CBOR log buffer"
	default 1024
	help
		Size of the buffer used by Spotflow logging backend to serialize the logs to CBOR format.
		Increase this value if you experience issues with logs being dropped because of buffer overflow.

config SPOTFLOW_LOGS_PROCESSING_LOG_LEVEL
	int "Spotflow SDK log component log level"
	default SPOTFLOW_MODULE_DEFAULT_LOG_LEVEL
	range 0 4
	help
		Sets log level for Spotflow log component.
		Defaults to SPOTFLOW_MODULE_DEFAULT_LOG_LEVEL.
		Levels are:
		- 0 OFF, do not write
		- 1 ERROR, only write LOG_ERR
		- 2 WARNING, write LOG_WRN in addition to previous level
		- 3 INFO, write LOG_INF in addition to previous level
		- 4 DEBUG, write LOG_DBG in addition to previous level

config SPOTFLOW_DEFAULT_SENT_LOG_LEVEL
	int "Spotflow default sent log level"
	default LOG_MAX_LEVEL
	range 0 LOG_MAX_LEVEL
	help
		Filters the logs sent to Spotflow cloud according to their severity level.
		This is the default value that can be dynamically overridden from the cloud.
		Defaults to LOG_MAX_LEVEL, i.e. the maximal (minimal severity) compiled-in level.
		Levels are:
		- 0 OFF, do not send
		- 1 ERROR, send LOG_ERR
		- 2 WARNING, send LOG_WRN in addition to previous level
		- 3 INFO, send LOG_INF in addition to previous level
		- 4 DEBUG, send LOG_DBG in addition to previous level

config SPOTFLOW_LOG_BACKEND_SET_RUNTIME_FILTERING
	bool "Set runtime filtering when Spotflow log level is set from the cloud"
	default y
	depends on LOG_RUNTIME_FILTERING
	help
		If enabled, the Spotflow module will automatically call log_filter_set() to the
		Spotflow logging backend for all sources when it receives a new log level from the
		cloud. This optimization might help reduce resource usage, because if no backend
		consumes log messages of a certain level, their processing is skipped.

endif #SPOTFLOW_LOG_BACKEND
```

## zephyr/src/logging/KConfig.logging
```kconfig
config SPOTFLOW_LOG_BACKEND
	bool "Spotflow logging backend"
	default y if SPOTFLOW
	depends on LOG
	select LOG_OUTPUT

	help
		Enable sending logs to Spotflow cloud.


if SPOTFLOW_LOG_BACKEND

config HEAP_MEM_POOL_ADD_SIZE_SPOTFLOW
	int "Additional heap size required by Spotflow"
	default 6144 if SPOTFLOW_LOG_BACKEND
	help
		Additional heap size required by Spotflow logging backend.
		Increase this value if you experience issues with logs being sent.

config SPOTFLOW_LOG_BACKEND_QUEUE_SIZE
	int "Size of Spotflow log backend queue"
	default 64
	help
		Size of the queue used by Spotflow logging backend to store logs
		before sending them to the server.
		Increase this value if you experience issues with logs being dropped.

config SPOTFLOW_LOG_BUFFER_SIZE
	int "Size of Spotflow log buffer"
	default 512
	help
		Size of the buffer used by Spotflow logging backend to store logs before serialization.
		Make this at least as big as your longest expected log line.
		Increase this value if you experience issues with logs being dropped because of buffer overflow.

config SPOTFLOW_CBOR_LOG_MAX_LEN
	int "Size of Spotflow CBOR log buffer"
	default 1024
	help
		Size of the buffer used by Spotflow logging backend to serialize the logs to CBOR format.
		Increase this value if you experience issues with logs being dropped because of buffer overflow.

config SPOTFLOW_PROCESSING_BACKEND_LOG_LEVEL
	int "Spotflow library log level"
	default LOG_DEFAULT_LEVEL
	range 0 4
	help
		Sets log level for all Spotflow logging modules. All logs are debug by default.
		Levels are:
		- 0 OFF, do not write
		- 1 ERROR, only write SYS_LOG_ERR
		- 2 WARNING, write SYS_LOG_WRN in addition to previous level
		- 3 INFO, write SYS_LOG_INF in addition to previous level
		- 4 DEBUG, write SYS_LOG_DBG in addition to previous level

endif #SPOTFLOW_LOG_BACKEND
```

## zephyr/src/metrics/Kconfig
```kconfig
menuconfig SPOTFLOW_METRICS
	bool "Enable Spotflow metrics collection and reporting"
	depends on SPOTFLOW
	default n
	help
	  Enable metrics collection and reporting feature for the Spotflow SDK.
	  Allows devices to collect, aggregate, and transmit metrics to the cloud.

if SPOTFLOW_METRICS

config SPOTFLOW_METRICS_QUEUE_SIZE
	int "Metrics message queue size"
	range 4 128
	default 64 if SPOTFLOW_METRICS_SYSTEM
	default 16
	help
	  Maximum number of encoded metric messages buffered before transmission.
	  Messages are dropped if queue is full. Default 64 when system metrics
	  are enabled (to handle burst from multiple time series), otherwise 16.

config SPOTFLOW_METRICS_CBOR_BUFFER_SIZE
	int "CBOR encoding buffer size (bytes)"
	range 256 2048
	default 512
	help
	  Size of stack-allocated buffer for CBOR encoding.
	  Must be large enough for the largest metric message.
	  Default 512 bytes is sufficient for most use cases.

config SPOTFLOW_METRICS_MAX_REGISTERED
	int "Maximum number of registered metrics"
	range 1 128
	default 32
	help
	  Maximum number of metrics that can be registered simultaneously.
	  Each metric consumes heap memory for aggregation context and time series storage.

config SPOTFLOW_METRICS_DEFAULT_AGGREGATION_INTERVAL
	int "Default aggregation interval (seconds)"
	default 60
	help
	  Default aggregation period for metrics registered without explicit interval.
	  Allowed values: 0, 60, 600, 3600 (validated at build time).
	  0 = PT0S (no aggregation, immediate - not recommended for production)
	  60 = PT1M (1 minute, recommended default)
	  600 = PT10M (10 minutes)
	  3600 = PT1H (1 hour)

config SPOTFLOW_METRICS_MAX_LABELS_PER_METRIC
	int "Maximum labels per metric"
	range 1 8
	default 8
	help
	  Maximum number of label key-value pairs per metric report.
	  Affects memory consumption per time series.

config HEAP_MEM_POOL_ADD_SIZE_SPOTFLOW_METRICS
	int "Additional heap memory pool size for metrics (bytes)"
	default 16384
	range 4096 65536
	help
	  Heap memory required for metrics subsystem:
	  - Aggregator context per metric: ~80 bytes
	  - Time series storage: ~420 bytes per timeseries (with MAX_LABELS=8)
	    Note: Timeseries size depends on MAX_LABELS_PER_METRIC config.
	    Size = ~36 + (48 × MAX_LABELS_PER_METRIC) bytes

	  Sizing formula:
	  HEAP_SIZE = 2048 + SUM(80 + 420 × max_timeseries[i]) for all metrics

	  Examples (with MAX_LABELS=8):
	  - 10 dimensionless metrics: 2048 + 10×500 = 7KB
	  - 5 dimensional (max_ts=4): 2048 + 5×(80+420×4) = 10.5KB
	  - 10 dimensional (max_ts=8): 2048 + 10×(80+420×8) = 36KB

	  Default 16KB supports ~30 dimensionless metrics or ~3 dimensional
	  metrics with 4 timeseries each. Adjust based on your needs.

config SPOTFLOW_METRICS_PROCESSING_LOG_LEVEL
	int "Metrics subsystem log level"
  	default SPOTFLOW_MODULE_DEFAULT_LOG_LEVEL
	range 0 4
	help
	  Log level for metrics subsystem:
	  Defaults to SPOTFLOW_MODULE_DEFAULT_LOG_LEVEL.
	  0 = OFF
	  1 = ERROR
	  2 = WARNING (default)
	  3 = INFO
	  4 = DEBUG

config SPOTFLOW_METRICS_HEARTBEAT
	bool "Enable device heartbeat"
	default y
	help
	  Send periodic heartbeat messages with device uptime.
	  Heartbeats have higher priority than regular metrics.

config SPOTFLOW_METRICS_HEARTBEAT_INTERVAL
	int "Heartbeat interval (seconds)"
	depends on SPOTFLOW_METRICS_HEARTBEAT
	default 60
	range 10 3600
	help
	  How often to send heartbeat messages.

endif # SPOTFLOW_METRICS
```

## zephyr/src/metrics/Kconfig.system
```kconfig
menuconfig SPOTFLOW_METRICS_SYSTEM
	bool "Enable Spotflow system metrics auto-collection"
	depends on SPOTFLOW_METRICS
	default n
	help
	  Enable automatic collection of system-level metrics (memory, network, CPU, etc.).
	  These metrics are collected periodically and reported to the cloud without
	  requiring any application code.

if SPOTFLOW_METRICS_SYSTEM

config SPOTFLOW_METRICS_SYSTEM_MEMORY
	bool "Enable memory metrics"
	default y
	help
	  Collect system memory statistics (free/total bytes).
	  Uses Zephyr sys_mem_stats_get() API.

config SPOTFLOW_METRICS_SYSTEM_HEAP
	bool "Enable heap metrics"
	depends on HEAP_MEM_POOL_SIZE > 0
	default y
	help
	  Collect heap memory statistics (free/allocated bytes).
	  Requires heap memory pool to be configured.

config SPOTFLOW_METRICS_SYSTEM_NETWORK
	bool "Enable network metrics"
	depends on NETWORKING && NET_STATISTICS
	default y
	help
	  Collect network traffic statistics (TX/RX bytes).
	  Requires networking and network statistics to be enabled.

config SPOTFLOW_METRICS_SYSTEM_CPU
	bool "Enable CPU utilization metrics"
	select THREAD_RUNTIME_STATS
	select THREAD_RUNTIME_STATS_USE_TIMING_FUNCTIONS
	default n
	help
	  Collect CPU utilization percentage.
	  WARNING: Enabling this adds overhead to thread scheduling.
	  Only enable if CPU utilization monitoring is required.

config SPOTFLOW_METRICS_SYSTEM_CONNECTION
	bool "Enable connection state metrics"
	default y
	help
	  Report MQTT connection state changes (connected=1, disconnected=0).
	  Event-driven metric (not periodic).

config SPOTFLOW_METRICS_SYSTEM_RESET_CAUSE
	bool "Enable reset cause metric"
	depends on HWINFO
	default y
	help
	  Report device reset cause on boot (power-on, watchdog, etc.).
	  Event-driven metric (reported once on boot, not periodic).
	  Requires HWINFO support in the platform.

config SPOTFLOW_METRICS_SYSTEM_INTERVAL
	int "System metrics collection interval (seconds)"
	range 10 3600
	default 60
	help
	  How often to collect and report system metrics (10-3600 seconds).
	  Default is 60 seconds (1 minute).
	  Lower values increase network/CPU overhead.

config HEAP_MEM_POOL_ADD_SIZE_SPOTFLOW_METRICS_SYSTEM
	int "Additional heap memory pool size for system metrics (bytes)"
	default 16384
	range 4096 65536
	help
	  System metrics auto-collection requires heap memory for:
	  - Metric registration (7 metrics × 128 bytes context)
	  - Time series storage (network metrics have 4 time series)
	  - CBOR encoding buffers

	  Default 16KB is sufficient for all system metrics enabled.
	  Reduce if only subset of metrics enabled:
	  - Memory + Connection only: 4KB
	  - Memory + Network: 8KB
	  - All metrics: 16KB (default)

	  This is added to CONFIG_HEAP_MEM_POOL_ADD_SIZE_SPOTFLOW_METRICS
	  which is for application metrics.

endif # SPOTFLOW_METRICS_SYSTEM
```
